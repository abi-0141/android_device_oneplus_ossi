/dts-v1/;

/ {

	fragment@0 {
		target = <0xffffffff>;

		__overlay__ {
			atag,videolfb-fb_base_l = "~`P";
			atag,videolfb-fb_base_h = <0x00>;
			atag,videolfb-islcmfound = <0x01>;
			atag,videolfb-islcm_inited = <0x00>;
			atag,videolfb-fps = <0x1770>;
			atag,videolfb-vramSize = <0x1be0000>;
			atag,videolfb-lcmname = "td4330_fhdp_dsi_cmd_auo_rt4831_drv";
		};
	};

	fragment@1 {
		target = <0xffffffff>;

		__overlay__ {
			pinctrl-names = "irtx_gpio_led_default\0irtx_gpio_led_set";
			pinctrl-0 = <0x01>;
			pinctrl-1 = <0x02>;
			status = "okay";
		};
	};

	fragment@2 {
		target = <0xffffffff>;

		__overlay__ {

			irtx_gpio_led_def@gpio139 {
				phandle = <0x01>;

				pins_cmd_dat {
					pinmux = <0x8b00>;
					slew-rate = <0x01>;
					bias-disable;
					output-low;
					input-schmitt-enable = <0x00>;
				};
			};

			irtx_gpio_led_set@gpio139 {
				phandle = <0x02>;

				pins_cmd_dat {
					pinmux = <0x8b02>;
					slew-rate = <0x01>;
					output-high;
				};
			};
		};
	};

	fragment@3 {
		target = <0xffffffff>;

		__overlay__ {
			mt6360,intr_gpio_num = <0x04>;
			mt6360,intr_gpio = <0xffffffff 0x04 0x00>;
		};
	};

	fragment@4 {
		target = <0xffffffff>;

		__overlay__ {
			pwr_off_seq = <0x4000002>;
		};
	};

	fragment@5 {
		target = <0xffffffff>;

		__overlay__ {
			mt6360pd,intr_gpio_num = <0x05>;
			mt6360pd,intr_gpio = <0xffffffff 0x05 0x00>;
		};
	};

	fragment@6 {
		target = <0xffffffff>;

		__overlay__ {
			status = "okay";

			Focaltech2169E@38 {
				compatible = "focaltech,fts";
				reg = <0x38>;
				chip-name = "FT3518";
				interrupt-parent = <0xffffffff>;
				interrupts = <0x0e 0x2002>;
				vdd_2v8-supply = <0xffffffff>;
				vdd_2v8_volt = <0x2dc6c0>;
				irq-gpio = <0xffffffff 0x0e 0x2002>;
				reset-gpio = <0xffffffff 0x0f 0x01>;
				vid_len = <0x02>;
				tp_type = <0x08>;
				platform_support_project = <0x2169e 0x2169f 0x2162d 0x2162e 0x216c9 0x216ca>;
				platform_support_project_dir = <0x2169e 0x2169f 0x2162d 0x2162e 0x216c9 0x216ca>;
				platform_support_project_commandline = "default_commandline\0default_commandline\0default_commandline\0default_commandline\0default_commandline\0default_commandline\0default_commandline\0default_commandline";
				touchpanel,max-num-support = <0x0a>;
				touchpanel,tx-rx-num = <0x10 0x22>;
				touchpanel,panel-coords = <0x10e0 0x2580>;
				touchpanel,display-coords = <0x438 0x960>;
				touchpanel,touchmajor-limit = <0x00 0xd8>;
				touchpanel,report-rate = <0x78 0xb4>;
				touchpanel,smooth-level = <0xff 0x02 0x0f 0x19 0x2d 0x3c>;
				touchpanel,smooth-level-charging = <0xff 0x0f 0x14 0x19 0x2d 0x3c>;
				touchpanel,sensitive-level = <0xff 0x14 0x10 0x0d 0x0a 0x05>;
				touchpanel,single-optimized-time = <0x08>;
				black_gesture_support;
				fw_edge_limit_support;
				pressure_report_support;
				charger_pump_support;
				game_switch_support;
				smart_gesture_support;
				fw_update_app_support;
				fingerprint_underscreen_support;
				headset_pump_support;
				health_monitor_v2_support;
				high_resolution_support;
				lcd_tp_refresh_support;
				touchpanel,button-type = <0x04>;
				touchpanel.button-TRx = <0x00 0x00>;
			};
		};
	};

	fragment@7 {
		target = <0xffffffff>;

		__overlay__ {

			eintdefault {
				phandle = <0x76>;
			};

			int_active {
				phandle = <0x77>;

				pins_cmd_dat {
					pinmux = <0xe00>;
					slew-rate = <0x00>;
					bias-pull-down = <0x00>;
				};
			};

			reset_active {
				phandle = <0x78>;

				pins_cmd_dat {
					pinmux = <0xf00>;
					slew-rate = <0x01>;
					output-high;
				};
			};

			int_suspend {
				phandle = <0x79>;

				pins_cmd_dat {
					pinmux = <0xe00>;
					slew-rate = <0x01>;
					output-low;
				};
			};

			reset_suspend {
				phandle = <0x7a>;

				pins_cmd_dat {
					pinmux = <0xf00>;
					slew-rate = <0x00>;
					output-low;
				};
			};
		};
	};

	fragment@8 {
		target = <0xffffffff>;

		__overlay__ {

			lcm_led_en1_gpio {
				phandle = <0x03>;

				pins_cmd_dat {
					pinmux = <0x6b00>;
					slew-rate = <0x01>;
					output-high;
				};
			};

			lcm_led_en0_gpio {
				phandle = <0x04>;

				pins_cmd_dat {
					pinmux = <0x6b00>;
					slew-rate = <0x01>;
					output-low;
				};
			};

			lcd_bias_enp1_gpio {
				phandle = <0x05>;

				pins_cmd_dat {
					pinmux = <0x6c00>;
					slew-rate = <0x01>;
					output-high;
				};
			};

			lcd_bias_enp0_gpio {
				phandle = <0x06>;

				pins_cmd_dat {
					pinmux = <0x6c00>;
					slew-rate = <0x01>;
					output-low;
				};
			};

			lcd_bias_enn1_gpio {
				phandle = <0x07>;

				pins_cmd_dat {
					pinmux = <0x6f00>;
					slew-rate = <0x01>;
					output-high;
				};
			};

			lcd_bias_enn0_gpio {
				phandle = <0x08>;

				pins_cmd_dat {
					pinmux = <0x6f00>;
					slew-rate = <0x01>;
					output-low;
				};
			};

			lcm_rst_out1_gpio {
				phandle = <0x09>;

				pins_cmd_dat {
					pinmux = <0x2800>;
					slew-rate = <0x01>;
					output-high;
				};
			};

			lcm_rst_out0_gpio {
				phandle = <0x0a>;

				pins_cmd_dat {
					pinmux = <0x2800>;
					slew-rate = <0x01>;
					output-low;
				};
			};

			lcm_dsi_te {
				phandle = <0x0b>;

				pins_cmd_dat {
					pinmux = <0x2701>;
				};
			};
		};
	};

	fragment@9 {
		target = <0xffffffff>;

		__overlay__ {
			pinctrl-names = "lcm_led_en1_gpio\0lcm_led_en0_gpio\0lcd_bias_enp1_gpio\0lcd_bias_enp0_gpio\0lcd_bias_enn1_gpio\0lcd_bias_enn0_gpio\0lcm_rst_out1_gpio\0lcm_rst_out0_gpio\0mode_te_te";
			pinctrl-0 = <0x03>;
			pinctrl-1 = <0x04>;
			pinctrl-2 = <0x05>;
			pinctrl-3 = <0x06>;
			pinctrl-4 = <0x07>;
			pinctrl-5 = <0x08>;
			pinctrl-6 = <0x09>;
			pinctrl-7 = <0x0a>;
			pinctrl-8 = <0x0b>;
			status = "okay";
		};
	};

	fragment@10 {
		target = <0xffffffff>;

		__overlay__ {
			pinctrl-names = "lcm_rst_out1_gpio\0lcm_rst_out0_gpio\0mode_te_te";
			pinctrl-0 = <0x09>;
			pinctrl-1 = <0x0a>;
			pinctrl-2 = <0x0b>;
			status = "okay";
		};
	};

	fragment@11 {
		target = <0xffffffff>;

		__overlay__ {
			status = "okay";
			#address-cells = <0x01>;
			#size-cells = <0x00>;

			panel2@0 {
				compatible = "oplus2169E_samsung_ams643ag01_1080p_dsi_cmd,lcm";
				reg = <0x00>;
				reset-gpios = <0xffffffff 0x28 0x00>;
				bias-gpios = <0xffffffff 0x6b 0x00>;
				ldo3-supply = <0xffffffff>;
				pinctrl-names = "default";

				port {

					endpoint {
						remote-endpoint = <0x0c>;
						phandle = <0x0d>;
					};
				};
			};

			ports {

				port {

					endpoint {
						remote-endpoint = <0x0d>;
						phandle = <0x0c>;
					};
				};
			};
		};
	};

	fragment@12 {
		target = <0xffffffff>;

		__overlay__ {

			gate_ic@11 {
				status = "disable";
				phandle = <0x7b>;
			};
		};
	};

	fragment@13 {
		target = <0xffffffff>;

		__overlay__ {
			compatible = "mediatek,disp-leds";

			backlight {
				label = "lcd-backlight";
				max-brightness = <0xfff>;
				led-bits = <0x0c>;
				trans-bits = <0x0c>;
				default-state = "on";
			};
		};
	};

	fragment@14 {
		target = <0xffffffff>;

		__overlay__ {

			ldo_vio28 {
				regulator-name = "vio28";
				regulator-min-microvolt = <0x325aa0>;
				regulator-max-microvolt = <0x325aa0>;
				regulator-enable-ramp-delay = <0x780>;
				phandle = <0x7c>;
			};
		};
	};

	fragment@15 {
		target = <0xffffffff>;

		__overlay__ {

			led@0 {
				compatible = "mediatek,red";
				led_mode = <0x00>;
				data = <0x01>;
				pwm_config = <0x00 0x00 0x00 0x00 0x00>;
				phandle = <0x7d>;
			};

			led@1 {
				compatible = "mediatek,green";
				led_mode = <0x00>;
				data = <0x01>;
				pwm_config = <0x00 0x00 0x00 0x00 0x00>;
				phandle = <0x7e>;
			};

			led@2 {
				compatible = "mediatek,blue";
				led_mode = <0x00>;
				data = <0x01>;
				pwm_config = <0x00 0x00 0x00 0x00 0x00>;
				phandle = <0x7f>;
			};

			led@3 {
				compatible = "mediatek,jogball-backlight";
				led_mode = <0x00>;
				data = <0x01>;
				pwm_config = <0x00 0x00 0x00 0x00 0x00>;
				phandle = <0x80>;
			};

			led@4 {
				compatible = "mediatek,keyboard-backlight";
				led_mode = <0x00>;
				data = <0x01>;
				pwm_config = <0x00 0x00 0x00 0x00 0x00>;
				phandle = <0x81>;
			};

			led@5 {
				compatible = "mediatek,button-backlight";
				led_mode = <0x00>;
				data = <0x01>;
				pwm_config = <0x00 0x00 0x00 0x00 0x00>;
				phandle = <0x82>;
			};

			led@6 {
				compatible = "mediatek,lcd-backlight";
				led_mode = <0x04>;
				data = <0x01>;
				pwm_config = <0x00 0x01 0x00 0x00 0x00>;
				phandle = <0x83>;
			};

			vibrator@0 {
				compatible = "mediatek,vibrator";
				vib_timer = <0x19>;
				vib_limit = <0x09>;
				vib_vol = <0x09>;
				phandle = <0x84>;
			};

			oplus_sim_detect {
				compatible = "oplus, sim_detect";
				Hw,sim_det = <0xffffffff 0xb0 0x00>;
			};

			sensor_fb {
				compatible = "oplus,sensor-feedback";
				phandle = <0x85>;
			};

			gsensor_1 {
				status = "okay";
				sensor_name = <0x07>;
				i2c_num = <0x02>;
				i2c_addr = <0x00>;
				direction = <0x02>;
				eint_num = <0x01>;
				step_count_7_en = <0x01>;
				config_miso = <0x01>;
				correct_y_bias = <0x01>;
				phandle = <0x86>;
			};

			gsensor_2 {
				status = "okay";
				sensor_name = <0x06>;
				device_name = "lsm6dso";
				i2c_num = <0x02>;
				i2c_addr = <0x00>;
				direction = <0x05>;
				eint_num = <0x14>;
				gyro_cali_version = <0x02>;
				acc_cali_range = <0xc8 0xc8 0xc8>;
				phandle = <0x87>;
			};

			gsensor_3 {
				status = "okay";
				sensor_name = <0x04>;
				device_name = "lsm6dsm";
				i2c_num = <0x02>;
				i2c_addr = <0x00>;
				direction = <0x03>;
				eint_num = <0x01>;
				gyro_cali_version = <0x02>;
				acc_cali_range = <0x12c 0x12c 0x12c>;
				phandle = <0x88>;
			};

			gsensor_4 {
				status = "okay";
				sensor_name = <0x05>;
				device_name = "bmi2xy";
				i2c_num = <0x02>;
				i2c_addr = <0x00>;
				direction = <0x01>;
				eint_num = <0x01>;
				gyro_cali_version = <0x02>;
				acc_cali_range = <0x12c 0x12c 0x12c>;
				phandle = <0x89>;
			};

			msensor_1 {
				status = "okay";
				sensor_name = <0x00>;
				i2c_num = <0x00>;
				i2c_addr = <0x0c>;
				direction = <0x03>;
				eint_num = <0x00>;
				libname = "akm";
				para_num = <0x02>;
				phandle = <0x8a>;

				mag_para_1 {
					match_projects = <0x2169e 0x54cf 0x216ca>;
					soft-mag-parameter = <0x290e 0x00 0x88 0x01 0x38 0x01 0x21e 0x00 0x2546 0x00 0x91 0x00 0x150 0x00 0x60 0x00 0x27e7 0x00>;
				};

				mag_para_2 {
					match_projects = <0x2169f 0x54d0 0x2162d 0x216c9>;
					soft-mag-parameter = <0x2c8f 0x00 0x6ab 0x00 0x6c 0x00 0x516 0x00 0x2213 0x00 0x9c 0x01 0x434 0x00 0x618 0x01 0x2719 0x00>;
				};
			};

			msensor_2 {
				status = "okay";
				sensor_name = <0x02>;
				i2c_num = <0x00>;
				i2c_addr = <0x30>;
				direction = <0x03>;
				eint_num = <0x00>;
				soft-mag-parameter = <0x2870 0x00 0x3a 0x01 0x4e 0x01 0x3a 0x01 0x242e 0x00 0x41 0x00 0x4e 0x00 0x41 0x01 0x28c0 0x00>;
				phandle = <0x8b>;
			};

			sar_1 {
				status = "okay";
				sensor_name = <0x00>;
				i2c_num = <0x00>;
				i2c_addr = <0x28>;
				direction = <0x04>;
				eint_num = <0x0d>;
				channel_num = <0x02>;
				channel_0_min = <0x00>;
				channel_0_max = <0x11170>;
				channel_1_min = <0x00>;
				channel_1_max = <0x11170>;
				channel_2_min = <0x00>;
				channel_2_max = <0x11170>;
				channel_3_min = <0x00>;
				channel_3_max = <0x11170>;
				reg_table_num = <0x03>;
				phandle = <0x8c>;
			};

			proximity_1 {
				status = "okay";
				sensor_name = <0x06>;
				i2c_num = <0x00>;
				i2c_addr = <0x48>;
				direction = <0x04>;
				eint_num = <0x02>;
				low_step = <0x12c>;
				high_step = <0x190>;
				low_limit = <0x190>;
				high_limit = <0x258>;
				dirty_low_step = <0x12c>;
				dirty_high_step = <0x190>;
				ps_dirty_limit = <0x708>;
				ps_ir_limit = <0x7d0>;
				ps_adjust_min = <0x00>;
				ps_adjust_max = <0x73a>;
				sampling_count = <0x05>;
				step_max = <0x190>;
				step_min = <0x64>;
				step_div = <0x7d0>;
				anti_shake_delta = <0x46>;
				dynamic_cali_max = <0x1388>;
				raw2offset_radio = <0x3e8>;
				offset_max = <0xea60>;
				offset_range_min = <0x00>;
				offset_range_max = <0xffff>;
				force_cali_limit = <0x7d0>;
				cali_jitter_limit = <0x1e>;
				cal_offset_margin = <0xbb8>;
				sensor-reg = <0x03 0x28>;
				is_use_force_cali = <0x01>;
				phandle = <0x8d>;
			};

			light_1 {
				status = "okay";
				sensor_name = <0x06>;
				i2c_num = <0x00>;
				i2c_addr = <0x48>;
				direction = <0x04>;
				eint_num = <0x02>;
				als_buffer_length = <0x08>;
				als_ratio = <0x6e>;
				als_type = <0x02>;
				device_name = "stk32600";
				use_als_c2 = <0x01>;
				phandle = <0x8e>;
			};

			proximity_2 {
				status = "okay";
				sensor_name = <0x05>;
				i2c_num = <0x00>;
				i2c_addr = <0x39>;
				direction = <0x04>;
				eint_num = <0x02>;
				low_step = <0x12c>;
				high_step = <0x190>;
				low_limit = <0x190>;
				high_limit = <0x258>;
				dirty_low_step = <0xb4>;
				dirty_high_step = <0xfa>;
				ps_dirty_limit = <0x3ff>;
				ps_ir_limit = <0x1f4>;
				ps_adjust_min = <0x00>;
				ps_adjust_max = <0x258>;
				sampling_count = <0x05>;
				step_max = <0x190>;
				step_min = <0x6e>;
				step_div = <0x5dc>;
				anti_shake_delta = <0x50>;
				dynamic_cali_max = <0x400>;
				raw2offset_radio = <0x5140>;
				offset_max = <0xfa>;
				offset_range_min = <0xff>;
				offset_range_max = <0xff>;
				force_cali_limit = <0x7d0>;
				cali_jitter_limit = <0x1e>;
				cal_offset_margin = <0x78>;
				phandle = <0x8f>;
			};

			light_2 {
				status = "okay";
				sensor_name = <0x05>;
				i2c_num = <0x00>;
				i2c_addr = <0x39>;
				direction = <0x04>;
				eint_num = <0x02>;
				als_ratio = <0x96>;
				als_buffer_length = <0x0a>;
				als_type = <0x02>;
				device_name = "tcs3701";
				phandle = <0x90>;
			};

			rear_cct_1 {
				status = "okay";
				sensor_name = <0x00>;
				i2c_num = <0x01>;
				i2c_addr = <0x48>;
				direction = <0x00>;
				eint_num = <0x0a>;
				available_sensor = <0x07>;
				gold_rear_cct_3k = <0x2b4b 0x36ec 0x6a4 0x1e8 0x40 0xa498>;
				gold_rear_cct_6k = <0x2128 0x330c 0xf58 0x174 0x40 0xa7d4>;
				device_name = "stk37600";
				cct_coef_Lir = <0x8b1960 0x00 0x3f3b8 0x00 0x1a1b98 0x01 0x702ad8 0x00 0xc474f8 0x00 0x19b9f0 0x00 0x3617a8 0x00 0x64ccb0 0x00 0x311e768 0x00 0x312608 0x01 0x260660 0x01 0x2b1f10 0x01>;
				cct_coef_Hir = <0x2b750 0x01 0xe172d8 0x01 0x2317e30 0x01 0xcec980 0x00 0x179c6f0 0x00 0x1de35e0 0x00 0x31f510 0x01 0x706d40 0x01 0x12e6228 0x00 0x274e8 0x01 0x59d8 0x00 0x5fb40 0x00>;
				phandle = <0x91>;
			};

			rear_cct_2 {
				status = "okay";
				sensor_name = <0x02>;
				i2c_num = <0x01>;
				i2c_addr = <0x39>;
				direction = <0x00>;
				eint_num = <0x0a>;
				available_sensor = <0x07>;
				gold_rear_cct_3k = <0x1414 0xa25 0x53e 0x20dd 0xc08 0x835>;
				gold_rear_cct_6k = <0xd89 0xb45 0x7fe 0x1eda 0xb30 0xf92>;
				device_name = "tcs3408";
				phandle = <0x92>;
			};

			pick_up {
				status = "okay";
				use-proximity = <0x01>;
				phandle = <0x93>;
			};

			lux_aod {
				status = "okay";
				use-proximity = <0x01>;
				phandle = <0x94>;
			};

			alsps_arch {
				status = "okay";
				new-arch-supported = <0x01>;
				phandle = <0x95>;
			};

			cali_arch {
				status = "okay";
				new-arch-supported = <0x01>;
				phandle = <0x96>;
			};

			oplus_project {
				compatible = "oplus,oplus_project";
				phandle = <0x97>;
			};

			oplus_devinfo {
				compatible = "oplus-devinfo";
				pinctrl-names = "default\0aboard_gpio0_sleep\0aboard_gpio0_active\0aboard_gpio0_idle\0aboard_gpio1_sleep\0aboard_gpio1_active\0aboard_gpio1_idle";
				pinctrl-0 = <0x0e>;
				pinctrl-1 = <0x0f>;
				pinctrl-2 = <0x10>;
				pinctrl-3 = <0x11>;
				pinctrl-4 = <0x12>;
				pinctrl-5 = <0x13>;
				pinctrl-6 = <0x14>;
				phandle = <0x98>;

				main-sub {
					use_tristate_gpio;
					compatible = "hw-match, main-sub";
					aboard-gpio0 = <0xffffffff 0x79 0x00>;
					aboard-gpio1 = <0xffffffff 0x8b 0x00>;
					abard-patterns = <0x00 0x01 0x01 0x00>;
					match-projects = <0x2169e 0x2169f 0x216c9 0x216ca>;
				};
			};

			mediatek_mtp_interface {
				phandle = <0x99>;

				mtp_interface {
					compatible = "mediatek,mtp_interface";
					InterfaceClass = <0xff>;
					InterfaceSubClass = <0xff>;
					InterfaceProtocol = <0x00>;
				};
			};

			mediatek_phy_tuning {
				phandle = <0x9a>;

				phy_tuning {
					compatible = "mediatek,phy_tuning";
					u2_vrt_ref = <0x07>;
					u2_term_ref = <0x07>;
					u2_enhance = <0x02>;
					u2_discth = <0x0e>;
					host_u2_vrt_ref = <0x05>;
					host_u2_term_ref = <0x05>;
					host_u2_enhance = <0x03>;
					host_u2_discth = <0x0a>;
				};
			};

			thermal-sensor5 {
				compatible = "mediatek,mtboard-thermistor5";
				io-channels = <0xffffffff 0x04>;
				io-channel-names = "thermistor-ch4";
				phandle = <0x9b>;
			};

			kpd_volume_down {
				compatible = "mediatek, VOLUME_DOWN-eint";
				interrupt-parent = <0xffffffff>;
				interrupts = <0x07 0x02 0x07 0x00>;
				debounce = <0x7d00>;
				status = "okay";
				phandle = <0x9c>;
			};

			nfc_chipset {
				compatible = "oplus-nfc-chipset";
				chipset-2169F = "ST21H";
				chipset-216C9 = "ST21H";
				chipset-21712 = "ST21H";
				phandle = <0x9d>;
			};
		};
	};

	fragment@16 {
		target = <0xffffffff>;

		__overlay__ {
			status = "okay";

			st21nfc@08 {
				compatible = "mediatek,nfc";
				reg = <0x08>;
				interrupt-parent = <0xffffffff>;
				interrupts = <0x0b 0x00>;
				gpio-irq-std = <0xffffffff 0x0b 0x00>;
				gpio-rst-std = <0xffffffff 0xbd 0x00>;
				gpio-clkreq-std = <0xffffffff 0x73 0x00>;
				status = "okay";
				phandle = <0x9e>;
			};
		};
	};

	fragment@17 {
		target = <0xffffffff>;

		__overlay__ {
			compatible = "mediatek, swtp-eint";
			debounce = <0x7d000>;
		};
	};

	fragment@18 {
		target = <0xffffffff>;

		__overlay__ {
			keypad,volume-down = <0xffffffff 0x07 0x00>;
			pinctrl-names = "volume_down_as_int";
			pinctrl-0 = <0x15>;
			status = "okay";
		};
	};

	fragment@19 {
		target = <0xffffffff>;

		__overlay__ {

			volume_down@0 {
				phandle = <0x15>;

				pins_cmd_dat {
					pinmux = <0x700>;
					slew-rate = <0x00>;
					input-enable;
				};
			};
		};
	};

	fragment@20 {
		target = <0xffffffff>;

		__overlay__ {

			default@hw_sub_id {
				phandle = <0x0e>;
			};

			sleep@id0 {
				phandle = <0x0f>;

				pins_cmd_dat {
					pinmux = <0x7900>;
					slew-rate = <0x00>;
					bias-pull-down;
					input-enable;
				};
			};

			active@id0 {
				phandle = <0x10>;

				pins_cmd_dat {
					pinmux = <0x7900>;
					slew-rate = <0x00>;
					bias-pull-up;
					input-enable;
				};
			};

			idle@id0 {
				phandle = <0x11>;

				pins_cmd_dat {
					pinmux = <0x7900>;
					slew-rate = <0x00>;
					bias-disable;
					input-enable;
				};
			};

			sleep@id1 {
				phandle = <0x12>;

				pins_cmd_dat {
					pinmux = <0x8b00>;
					slew-rate = <0x00>;
					bias-pull-down;
					input-enable;
				};
			};

			active@id1 {
				phandle = <0x13>;

				pins_cmd_dat {
					pinmux = <0x8b00>;
					slew-rate = <0x00>;
					bias-pull-up;
					input-enable;
				};
			};

			idle@id1 {
				phandle = <0x14>;

				pins_cmd_dat {
					pinmux = <0x8b00>;
					slew-rate = <0x00>;
					bias-disable;
					input-enable;
				};
			};
		};
	};

	fragment@21 {
		target = <0xffffffff>;

		__overlay__ {
			status = "okay";
			clock-frequency = <0xf4240>;

			aw8697_haptic@5A {
				status = "okay";
				compatible = "awinic,aw8697_haptic";
				reg = <0x5a>;
				reset-gpio = <0xffffffff 0x1f 0x00>;
				irq-gpio = <0xffffffff 0x0d 0x00>;
				qcom,device_id = <0x32f>;
				qcom,aw86927_boost_voltage = [5e];
				pinctrl-names = "default";
				pinctrl-0 = <0x16>;
			};
		};
	};

	fragment@22 {
		target = <0xffffffff>;

		__overlay__ {

			aw_irq_gpio_default {
				phandle = <0x16>;

				pins_cmd_dat {
					pinmux = <0xd00>;
					input-enable;
					slew-rate = <0x00>;
					bias-pull-up;
				};
			};
		};
	};

	fragment@23 {
		target = <0xffffffff>;

		__overlay__ {

			gps_default {
				phandle = <0x17>;
			};

			gps_l1_lna@0 {
				phandle = <0x18>;

				pins_cmd_dat {
					pinmux = <0xbc00>;
					output-low;
				};
			};

			gps_l1_lna@1 {
				phandle = <0x19>;

				pins_cmd_dat {
					pinmux = <0xbc04>;
				};
			};

			gps_l1_lna@2 {
				phandle = <0x1a>;

				pins_cmd_dat {
					pinmux = <0xbc00>;
					output-high;
				};
			};
		};
	};

	fragment@24 {
		target = <0xffffffff>;

		__overlay__ {
			pinctrl-names = "default\0gps_l1_lna_disable\0gps_l1_lna_dsp_ctrl\0gps_l1_lna_enable";
			pinctrl-0 = <0x17>;
			pinctrl-1 = <0x18>;
			pinctrl-2 = <0x19>;
			pinctrl-3 = <0x1a>;
			status = "okay";
		};
	};

	fragment@25 {
		target = <0xffffffff>;

		__overlay__ {
			accdet-mic-vol = <0x08>;
			headset-mode-setting = <0x500 0x500 0x01 0x1f0 0x800 0x800 0x20 0x44 0x04 0x01 0x05 0x03 0x03 0x05 0x0e>;
			accdet-plugout-debounce = <0x01>;
			accdet-mic-mode = <0x02>;
			headset-three-key-threshold = <0x00 0x52 0xaa 0x132>;
			headset-three-key-threshold-CDD = <0x00 0x79 0xc0 0x258>;
			headset-four-key-threshold = <0x00 0x3a 0x79 0xc0 0x190>;
			eint_use_ext_res = <0x00>;
			status = "okay";
		};
	};

	fragment@26 {
		target = <0xffffffff>;

		__overlay__ {
			pinctrl-names = "enable\0disable";
			pinctrl-0 = <0x1b>;
			pinctrl-1 = <0x1c>;
			status = "okay";
		};
	};

	fragment@27 {
		target = <0xffffffff>;

		__overlay__ {
			pinctrl-names = "sel_up\0sel_down";
			pinctrl-0 = <0x1d>;
			pinctrl-1 = <0x1e>;
			status = "okay";
		};
	};

	fragment@28 {
		target = <0xffffffff>;

		__overlay__ {

			ps_enable {
				phandle = <0x1b>;

				pins_cmd_dat {
					pinmux = <0x7900>;
					output-high;
				};
			};

			ps_disable {
				phandle = <0x1c>;

				pins_cmd_dat {
					pinmux = <0x7900>;
					output-low;
				};
			};

			sel_up {
				phandle = <0x1d>;

				pins_cmd_dat {
					pinmux = <0x600>;
					output-low;
				};
			};

			sel_down {
				phandle = <0x1e>;

				pins_cmd_dat {
					pinmux = <0x600>;
					output-high;
				};
			};
		};
	};

	fragment@29 {
		target = <0xffffffff>;

		__overlay__ {
			mtk_spk_i2s_out = <0x03>;
			mtk_spk_i2s_in = <0x09>;

			mediatek,speaker-codec {
				sound-dai = <0x1f 0x20>;
			};
		};
	};

	fragment@30 {
		target = <0xffffffff>;

		__overlay__ {

			speaker_amp1@34 {
				compatible = "nxp,tfa98xx";
				reg = <0x34>;
				reset-gpio = <0xffffffff 0x18 0x00>;
				status = "okay";
				phandle = <0x1f>;
			};

			speaker_amp2@35 {
				compatible = "nxp,tfa98xx";
				reg = <0x35>;
				reset-gpio = <0xffffffff 0xa7 0x00>;
				status = "okay";
				phandle = <0x20>;
			};
		};
	};

	fragment@31 {
		target = <0xffffffff>;

		__overlay__ {
			oplus,speaker-vendor = "nxp";
			oplus,speaker-i2s-id = <0x03>;
			oplus,speaker-i2s-id-in = <0x00>;
			oplus,speaker-codec-name = "tfa98xx.6-0034\0tfa98xx.6-0035";
			oplus,speaker-codec-dai-name = "tfa98xx-aif-6-34\0tfa98xx-aif-6-35";
		};
	};

	fragment@32 {
		target = <0xffffffff>;

		__overlay__ {

			fsa_hs_det {
				phandle = <0x21>;

				pins_cmd_dat {
					pinmux = <0xa900>;
					slew-rate = <0x01>;
					output-high;
				};
			};
		};
	};

	fragment@33 {
		target = <0xffffffff>;

		__overlay__ {

			fsa4480@42 {
				compatible = "qcom,fsa4480-i2c";
				reg = <0x42>;
				pinctrl-names = "default";
				pinctrl-0 = <0x21>;
				fsa4480,hs-det-gpio = <0xffffffff 0xa9 0x00>;
				phandle = <0x9f>;
			};
		};
	};

	fragment@34 {
		target = <0xffffffff>;

		__overlay__ {

			tfa98xx_haptic@34 {
				compatible = "tfa,tfa_haptic";
				reg = <0x34>;
				reset-gpio = <0xffffffff 0x20 0x00>;
				i2s-id = <0x01>;
				status = "okay";
				phandle = <0xa0>;
			};
		};
	};

	fragment@35 {
		target = <0xffffffff>;

		__overlay__ {
			status = "disabled";
		};
	};

	fragment@36 {
		target = <0xffffffff>;

		__overlay__ {
			#address-cells = <0x01>;
			#size-cells = <0x00>;
			status = "okay";

			fingerprint@0 {
				compatible = "oplus,oplus_fp";
				reg = <0x00>;
				spi-max-frequency = <0x2faf080>;
				spi-id = <0x05>;
				spi-irq = <0x16>;
				spi-reg = <0xa822f8>;
				dvdd-supply = <0xffffffff>;
				dvdd-config = <0x325aa0 0x325aa0 0x249f0>;
				power-num = <0x01>;
				status = "okay";
				phandle = <0xa1>;

				power_source_1 {
					power-mode = <0x01>;
					power-name = "dvdd";
					power-config = "dvdd-config";
					delay-time = <0x00>;
				};
			};
		};
	};

	fragment@37 {
		target = <0xffffffff>;

		__overlay__ {
			oplus,fp_gpio_num = <0x01>;
			oplus,fp_gpio = <0x1b>;
			oplus,fp_gpio_0 = <0xffffffff 0x1b 0x00>;
			pinctrl-names = "default";
			pinctrl-0 = <0x22>;

			jiiov_0302 {
				oplus,fp-id = <0x00>;
				vendor-chip = <0x17>;
				eng-menu = "-1,-1";
				chip-name = "JIIOV_0302";
			};
		};
	};

	fragment@38 {
		target = <0xffffffff>;

		__overlay__ {

			gpio_id0_default {
				phandle = <0x22>;

				pins_cmd_dat {
					pinmux = <0x1b00>;
					slew-rate = <0x00>;
					bias-pull-up = <0x00>;
					input-enable;
				};
			};
		};
	};

	fragment@39 {
		target = <0xffffffff>;

		__overlay__ {
			anc,gpio_irq = <0xffffffff 0x16 0x00>;
			anc,gpio_rst = <0xffffffff 0x15 0x00>;
			ldo-supply = <0xffffffff>;
			pinctrl-names = "anc_reset_reset\0anc_reset_active\0anc_irq_active";
			pinctrl-0 = <0x23>;
			pinctrl-1 = <0x24 0x25 0x26 0x27 0x28>;
			pinctrl-2 = <0x28>;
			status = "okay";
		};
	};

	fragment@40 {
		target = <0xffffffff>;

		__overlay__ {

			jiiov_fp_reset_output_low {
				phandle = <0x23>;

				pins_cmd_dat {
					pinmux = <0x1500>;
					slew-rate = <0x01>;
					output-low;
				};
			};

			jiiov_fp_gpio_clk {
				phandle = <0x24>;

				pins_cmd_dat {
					pinmux = <0x6201>;
					drive-strength = <0x02>;
				};
			};

			jiiov_fp_gpio_mosi {
				phandle = <0x25>;

				pins_cmd_dat {
					pinmux = <0x6501>;
					drive-strength = <0x02>;
				};
			};

			jiiov_fp_gpio_miso {
				phandle = <0x26>;

				pins_cmd_dat {
					pinmux = <0x6401>;
					drive-strength = <0x03>;
				};
			};

			jiiov_fp_gpio_cs {
				phandle = <0x27>;

				pins_cmd_dat {
					pinmux = <0x6301>;
					drive-strength = <0x02>;
				};
			};

			jiiov_fp_irq_active {
				phandle = <0x28>;

				pins_cmd_dat {
					pinmux = <0x1600>;
					slew-rate = <0x00>;
					input-enable;
					bias-pull-down;
				};
			};
		};
	};

	fragment@41 {
		target = <0xffffffff>;

		__overlay__ {

			adc_channel@ {
				compatible = "mediatek,adc_channel";
				mediatek,temperature0 = <0x00>;
				mediatek,temperature1 = <0x01>;
				mediatek,adc_fdd_rf_params_dynamic_custom_ch = <0x02>;
				status = "okay";
			};
		};
	};

	fragment@42 {
		target = <0xffffffff>;

		__overlay__ {
			io-channels = <0xffffffff 0x02>;
		};
	};

	fragment@43 {
		target = <0xffffffff>;

		__overlay__ {
			mediatek,clkbuf-quantity = <0x07>;
			mediatek,clkbuf-config = <0x02 0x01 0x01 0x02 0x00 0x00 0x01>;
			mediatek,clkbuf-output-impedance = <0x03 0x04 0x03 0x04 0x00 0x00 0x03>;
			mediatek,clkbuf-controls-for-desense = <0x00 0x04 0x00 0x04 0x00 0x00 0x00>;
			status = "okay";
		};
	};

	fragment@44 {
		target = <0xffffffff>;

		__overlay__ {
			#address-cells = <0x01>;
			#size-cells = <0x00>;
			clock-frequency = <0x61a80>;
			mediatek,use-open-drain;
		};
	};

	fragment@45 {
		target = <0xffffffff>;

		__overlay__ {
			#address-cells = <0x01>;
			#size-cells = <0x00>;
			clock-frequency = <0x61a80>;
			mediatek,use-open-drain;
		};
	};

	fragment@46 {
		target = <0xffffffff>;

		__overlay__ {
			#address-cells = <0x01>;
			#size-cells = <0x00>;
			clock-frequency = <0x61a80>;
			mediatek,use-open-drain;

			camera_main@1a {
				compatible = "mediatek,camera_main";
				reg = <0x1a>;
				status = "okay";
				phandle = <0xa2>;
			};

			camera_main_af@18 {
				compatible = "mediatek,camera_main_af";
				reg = <0x18>;
				status = "okay";
				phandle = <0xa3>;
			};

			camera_sub_two@10 {
				compatible = "mediatek,camera_sub_two";
				reg = <0x10>;
				status = "okay";
				phandle = <0xa4>;
			};
		};
	};

	fragment@47 {
		target = <0xffffffff>;

		__overlay__ {
			#address-cells = <0x01>;
			#size-cells = <0x00>;
			clock-frequency = <0x61a80>;
			mediatek,use-open-drain;
		};
	};

	fragment@48 {
		target = <0xffffffff>;

		__overlay__ {
			#address-cells = <0x01>;
			#size-cells = <0x00>;
			clock-frequency = <0x61a80>;
			mediatek,use-open-drain;

			camera_main_two@11 {
				compatible = "mediatek,camera_main_two";
				reg = <0x11>;
				status = "okay";
				phandle = <0xa5>;
			};

			camera_sub@1a {
				compatible = "mediatek,camera_sub";
				reg = <0x1a>;
				status = "okay";
				phandle = <0xa6>;
			};
		};
	};

	fragment@49 {
		target = <0xffffffff>;

		__overlay__ {
			#address-cells = <0x01>;
			#size-cells = <0x00>;
			clock-frequency = <0x33e140>;
			mediatek,use-push-pull;

			subpmic@34 {
				compatible = "mediatek,subpmic";
				reg = <0x34>;
				status = "okay";
				phandle = <0xa7>;
			};

			usb_type_c@4e {
				compatible = "mediatek,usb_type_c";
				reg = <0x4e>;
				status = "okay";
				phandle = <0xa8>;
			};

			subpmic_pmic@1a {
				compatible = "mediatek,subpmic_pmic";
				reg = <0x1a>;
				status = "okay";
				phandle = <0xa9>;
			};

			subpmic_ldo@64 {
				compatible = "mediatek,subpmic_ldo";
				reg = <0x64>;
				status = "okay";
				phandle = <0xaa>;
			};
		};
	};

	fragment@50 {
		target = <0xffffffff>;

		__overlay__ {
			#address-cells = <0x01>;
			#size-cells = <0x00>;
			clock-frequency = <0x61a80>;
			mediatek,use-open-drain;

			i2c_lcd_bias@11 {
				compatible = "mediatek,i2c_lcd_bias";
				reg = <0x11>;
				status = "okay";
				phandle = <0xab>;
			};
		};
	};

	fragment@51 {
		target = <0xffffffff>;

		__overlay__ {
			#address-cells = <0x01>;
			#size-cells = <0x00>;
			clock-frequency = <0x186a0>;
			mediatek,use-open-drain;
		};
	};

	fragment@52 {
		target = <0xffffffff>;

		__overlay__ {
			#address-cells = <0x01>;
			#size-cells = <0x00>;
			clock-frequency = <0x61a80>;
			mediatek,use-open-drain;

			nfc@28 {
				compatible = "mediatek,nfc";
				reg = <0x28>;
				status = "okay";
				phandle = <0xac>;
			};
		};
	};

	fragment@53 {
		target = <0xffffffff>;

		__overlay__ {
			#address-cells = <0x01>;
			#size-cells = <0x00>;
			clock-frequency = <0x61a80>;
			mediatek,use-open-drain;
		};
	};

	fragment@54 {
		target = <0xffffffff>;

		__overlay__ {
			#address-cells = <0x01>;
			#size-cells = <0x00>;
			clock-frequency = <0x61a80>;
			mediatek,use-open-drain;
		};
	};

	fragment@55 {
		target = <0xffffffff>;

		__overlay__ {
			#address-cells = <0x01>;
			#size-cells = <0x00>;
			clock-frequency = <0x61a80>;
			mediatek,use-open-drain;
		};
	};

	fragment@56 {
		target = <0xffffffff>;

		__overlay__ {
			GPIO_FDD_BAND_SUPPORT_DETECT_1ST_PIN = <0xffffffff 0x47 0x00>;
			GPIO_FDD_BAND_SUPPORT_DETECT_2ND_PIN = <0xffffffff 0x48 0x00>;
			GPIO_FDD_BAND_SUPPORT_DETECT_3RD_PIN = <0xffffffff 0x49 0x00>;
			GPIO_FDD_BAND_SUPPORT_DETECT_4TH_PIN = <0xffffffff 0x4a 0x00>;
			GPIO_RF_PWREN_RST_PIN = <0xffffffff 0x4b 0x00>;
			GPIO_SIM2_SIO = <0xffffffff 0xaa 0x00>;
			GPIO_SIM2_SCLK = <0xffffffff 0xab 0x00>;
			GPIO_SIM2_SRST = <0xffffffff 0xac 0x00>;
			GPIO_SIM1_SRST = <0xffffffff 0xad 0x00>;
			GPIO_SIM1_SCLK = <0xffffffff 0xae 0x00>;
			GPIO_SIM1_SIO = <0xffffffff 0xaf 0x00>;
			GPIO_SIM1_HOT_PLUG = <0xffffffff 0xb0 0x00>;
			GPIO_SIM2_HOT_PLUG = <0xffffffff 0xb1 0x00>;
		};
	};

	fragment@57 {
		target = <0xffffffff>;

		__overlay__ {
			gpio_init_default = <0x00 0x00 0x00 0x00 0x01 0x01 0x01 0x01 0x00 0x00 0x00 0x01 0x00 0x01 0x02 0x00 0x00 0x00 0x01 0x01 0x01 0x03 0x00 0x00 0x00 0x01 0x01 0x01 0x04 0x00 0x00 0x00 0x01 0x01 0x01 0x05 0x00 0x00 0x00 0x01 0x01 0x01 0x06 0x00 0x00 0x00 0x01 0x01 0x01 0x07 0x00 0x00 0x00 0x01 0x01 0x00 0x08 0x00 0x00 0x00 0x01 0x01 0x00 0x09 0x06 0x00 0x00 0x01 0x00 0x00 0x0a 0x00 0x00 0x00 0x01 0x01 0x00 0x0b 0x00 0x00 0x00 0x01 0x00 0x00 0x0c 0x02 0x00 0x00 0x01 0x01 0x00 0x0d 0x02 0x00 0x00 0x01 0x01 0x00 0x0e 0x00 0x00 0x00 0x01 0x01 0x01 0x0f 0x00 0x01 0x00 0x01 0x00 0x01 0x10 0x07 0x00 0x00 0x01 0x01 0x00 0x11 0x07 0x00 0x00 0x01 0x01 0x00 0x12 0x00 0x00 0x00 0x01 0x00 0x00 0x13 0x07 0x00 0x00 0x01 0x01 0x00 0x14 0x00 0x00 0x00 0x01 0x01 0x00 0x15 0x00 0x01 0x01 0x01 0x00 0x00 0x16 0x04 0x00 0x00 0x01 0x01 0x00 0x17 0x07 0x00 0x00 0x01 0x01 0x00 0x18 0x00 0x01 0x00 0x01 0x00 0x00 0x19 0x00 0x01 0x00 0x01 0x00 0x00 0x1a 0x01 0x00 0x00 0x01 0x01 0x00 0x1b 0x00 0x00 0x00 0x01 0x00 0x00 0x1c 0x01 0x00 0x00 0x01 0x01 0x00 0x1d 0x00 0x01 0x00 0x01 0x00 0x00 0x1e 0x00 0x00 0x00 0x00 0x00 0x00 0x1f 0x01 0x00 0x00 0x01 0x01 0x00 0x20 0x00 0x01 0x00 0x01 0x00 0x00 0x21 0x00 0x01 0x00 0x01 0x00 0x00 0x22 0x00 0x01 0x00 0x01 0x00 0x00 0x23 0x00 0x01 0x00 0x01 0x00 0x00 0x24 0x01 0x00 0x00 0x01 0x01 0x01 0x25 0x01 0x00 0x00 0x01 0x01 0x01 0x26 0x01 0x00 0x00 0x01 0x01 0x01 0x27 0x01 0x00 0x00 0x01 0x00 0x01 0x28 0x00 0x01 0x00 0x01 0x00 0x00 0x29 0x01 0x00 0x00 0x00 0x00 0x01 0x2a 0x01 0x00 0x00 0x00 0x00 0x01 0x2b 0x01 0x00 0x00 0x01 0x00 0x01 0x2c 0x01 0x00 0x00 0x01 0x00 0x01 0x2d 0x01 0x00 0x00 0x01 0x01 0x01 0x2e 0x01 0x00 0x00 0x00 0x00 0x00 0x2f 0x01 0x00 0x00 0x00 0x00 0x00 0x30 0x01 0x00 0x00 0x00 0x00 0x00 0x31 0x01 0x00 0x00 0x00 0x00 0x00 0x32 0x01 0x00 0x00 0x01 0x00 0x00 0x33 0x01 0x00 0x00 0x01 0x00 0x00 0x34 0x01 0x00 0x00 0x01 0x00 0x00 0x35 0x01 0x00 0x00 0x01 0x00 0x00 0x36 0x01 0x00 0x00 0x01 0x00 0x01 0x37 0x01 0x00 0x00 0x01 0x00 0x00 0x38 0x01 0x00 0x00 0x01 0x00 0x00 0x39 0x01 0x00 0x00 0x01 0x00 0x00 0x3a 0x01 0x00 0x00 0x01 0x00 0x00 0x3b 0x01 0x00 0x00 0x01 0x00 0x00 0x3c 0x01 0x00 0x00 0x00 0x00 0x01 0x3d 0x01 0x00 0x00 0x00 0x00 0x01 0x3e 0x01 0x00 0x00 0x00 0x00 0x01 0x3f 0x01 0x00 0x00 0x00 0x00 0x01 0x40 0x01 0x00 0x00 0x01 0x01 0x01 0x41 0x01 0x00 0x00 0x01 0x01 0x01 0x42 0x01 0x00 0x00 0x01 0x00 0x01 0x43 0x01 0x00 0x00 0x01 0x00 0x01 0x44 0x01 0x00 0x00 0x00 0x00 0x00 0x45 0x01 0x00 0x00 0x01 0x00 0x00 0x46 0x01 0x00 0x00 0x01 0x00 0x01 0x47 0x00 0x00 0x00 0x01 0x00 0x00 0x48 0x00 0x00 0x00 0x01 0x00 0x00 0x49 0x00 0x00 0x00 0x01 0x00 0x00 0x4a 0x00 0x00 0x00 0x01 0x00 0x00 0x4b 0x00 0x01 0x01 0x01 0x00 0x01 0x4c 0x01 0x00 0x00 0x00 0x00 0x01 0x4d 0x01 0x00 0x00 0x00 0x00 0x01 0x4e 0x01 0x00 0x00 0x00 0x00 0x01 0x4f 0x01 0x00 0x00 0x00 0x00 0x01 0x50 0x01 0x00 0x00 0x00 0x00 0x01 0x51 0x01 0x00 0x00 0x00 0x00 0x01 0x52 0x01 0x00 0x00 0x00 0x00 0x00 0x53 0x01 0x00 0x00 0x01 0x00 0x00 0x54 0x01 0x00 0x00 0x00 0x00 0x00 0x55 0x01 0x00 0x00 0x01 0x00 0x00 0x56 0x01 0x00 0x00 0x01 0x00 0x01 0x57 0x01 0x00 0x00 0x00 0x00 0x01 0x58 0x01 0x00 0x00 0x00 0x00 0x01 0x59 0x01 0x00 0x00 0x00 0x00 0x01 0x5a 0x01 0x00 0x00 0x00 0x00 0x01 0x5b 0x01 0x00 0x00 0x00 0x00 0x01 0x5c 0x01 0x00 0x00 0x00 0x00 0x01 0x5d 0x01 0x00 0x00 0x00 0x00 0x01 0x5e 0x01 0x00 0x00 0x00 0x00 0x01 0x5f 0x01 0x00 0x00 0x00 0x00 0x01 0x60 0x01 0x00 0x00 0x00 0x00 0x01 0x61 0x01 0x00 0x00 0x00 0x00 0x01 0x62 0x01 0x00 0x00 0x00 0x00 0x00 0x63 0x00 0x01 0x00 0x01 0x00 0x00 0x64 0x01 0x00 0x00 0x01 0x00 0x00 0x65 0x01 0x00 0x00 0x00 0x00 0x00 0x66 0x01 0x00 0x00 0x01 0x01 0x00 0x67 0x01 0x00 0x00 0x01 0x01 0x00 0x68 0x01 0x00 0x00 0x01 0x01 0x00 0x69 0x01 0x00 0x00 0x01 0x01 0x00 0x6a 0x01 0x00 0x00 0x01 0x01 0x00 0x6b 0x00 0x01 0x00 0x01 0x00 0x01 0x6c 0x00 0x01 0x00 0x01 0x00 0x01 0x6d 0x00 0x01 0x00 0x01 0x00 0x00 0x6e 0x00 0x01 0x00 0x01 0x00 0x00 0x6f 0x00 0x01 0x00 0x01 0x00 0x00 0x70 0x01 0x00 0x00 0x01 0x01 0x00 0x71 0x00 0x00 0x00 0x01 0x01 0x00 0x72 0x01 0x00 0x00 0x01 0x01 0x00 0x73 0x02 0x00 0x00 0x01 0x00 0x00 0x74 0x01 0x00 0x00 0x01 0x01 0x01 0x75 0x00 0x00 0x00 0x00 0x00 0x00 0x76 0x00 0x01 0x00 0x01 0x00 0x00 0x77 0x00 0x01 0x00 0x01 0x00 0x00 0x78 0x01 0x00 0x00 0x01 0x01 0x00 0x79 0x00 0x00 0x00 0x01 0x01 0x00 0x7a 0x02 0x00 0x00 0x01 0x01 0x01 0x7b 0x02 0x00 0x00 0x01 0x01 0x00 0x7c 0x02 0x00 0x00 0x01 0x00 0x00 0x7d 0x02 0x00 0x00 0x01 0x01 0x00 0x7e 0x02 0x00 0x00 0x01 0x00 0x00 0x7f 0x02 0x00 0x00 0x01 0x00 0x00 0x80 0x02 0x00 0x00 0x01 0x01 0x01 0x81 0x02 0x00 0x00 0x01 0x00 0x01 0x82 0x02 0x00 0x00 0x01 0x01 0x01 0x83 0x02 0x00 0x00 0x01 0x01 0x01 0x84 0x01 0x00 0x00 0x01 0x01 0x01 0x85 0x01 0x00 0x00 0x01 0x01 0x01 0x86 0x01 0x00 0x00 0x01 0x01 0x01 0x87 0x01 0x00 0x00 0x01 0x01 0x01 0x88 0x01 0x00 0x00 0x01 0x01 0x01 0x89 0x01 0x00 0x00 0x01 0x01 0x01 0x8a 0x04 0x00 0x00 0x01 0x01 0x00 0x8b 0x04 0x00 0x00 0x01 0x01 0x00 0x8c 0x00 0x01 0x00 0x01 0x00 0x01 0x8d 0x00 0x01 0x00 0x01 0x00 0x01 0x8e 0x00 0x01 0x00 0x01 0x00 0x00 0x8f 0x01 0x00 0x00 0x01 0x01 0x01 0x90 0x01 0x00 0x00 0x01 0x01 0x01 0x91 0x01 0x00 0x00 0x01 0x01 0x01 0x92 0x01 0x00 0x00 0x01 0x01 0x01 0x93 0x01 0x00 0x00 0x01 0x01 0x01 0x94 0x01 0x00 0x00 0x01 0x01 0x01 0x95 0x01 0x00 0x00 0x00 0x00 0x00 0x96 0x01 0x00 0x00 0x00 0x00 0x00 0x97 0x01 0x00 0x00 0x00 0x00 0x00 0x98 0x00 0x01 0x00 0x01 0x00 0x00 0x99 0x01 0x00 0x00 0x00 0x00 0x00 0x9a 0x00 0x01 0x00 0x01 0x00 0x00 0x9b 0x00 0x01 0x00 0x01 0x00 0x00 0x9c 0x00 0x00 0x00 0x01 0x01 0x00 0x9d 0x00 0x01 0x00 0x01 0x00 0x00 0x9e 0x00 0x00 0x00 0x01 0x01 0x00 0x9f 0x00 0x01 0x00 0x01 0x00 0x00 0xa0 0x00 0x00 0x00 0x01 0x01 0x00 0xa1 0x00 0x01 0x00 0x01 0x00 0x00 0xa2 0x00 0x00 0x00 0x01 0x01 0x00 0xa3 0x00 0x00 0x00 0x01 0x01 0x00 0xa4 0x01 0x00 0x00 0x01 0x01 0x00 0xa5 0x01 0x00 0x00 0x00 0x00 0x00 0xa6 0x01 0x00 0x00 0x01 0x01 0x00 0xa7 0x00 0x01 0x00 0x01 0x00 0x00 0xa8 0x00 0x01 0x00 0x01 0x00 0x00 0xa9 0x00 0x01 0x00 0x01 0x00 0x00 0xaa 0x01 0x00 0x00 0x01 0x01 0x01 0xab 0x01 0x00 0x00 0x00 0x00 0x01 0xac 0x01 0x00 0x00 0x00 0x00 0x01 0xad 0x01 0x00 0x00 0x00 0x00 0x01 0xae 0x01 0x00 0x00 0x00 0x00 0x01 0xaf 0x01 0x00 0x00 0x01 0x01 0x01 0xb0 0x01 0x00 0x00 0x01 0x01 0x01 0xb1 0x01 0x00 0x00 0x01 0x01 0x01 0xb2 0x01 0x00 0x00 0x01 0x00 0x00 0xb3 0x01 0x00 0x00 0x01 0x00 0x00 0xb4 0x00 0x00 0x00 0x00 0x00 0x01 0xb5 0x00 0x00 0x00 0x00 0x00 0x01 0xb6 0x01 0x00 0x00 0x01 0x01 0x00 0xb7 0x01 0x00 0x00 0x01 0x01 0x00 0xb8 0x01 0x00 0x00 0x01 0x01 0x00 0xb9 0x01 0x00 0x00 0x01 0x01 0x00 0xba 0x03 0x00 0x00 0x01 0x01 0x01 0xbb 0x03 0x00 0x00 0x01 0x01 0x01 0xbc 0x00 0x01 0x00 0x01 0x00 0x00 0xbd 0x00 0x01 0x00 0x01 0x00 0x00 0xbe 0x01 0x00 0x00 0x01 0x01 0x00 0xbf 0x05 0x00 0x00 0x00 0x00 0x00 0xc0 0x05 0x00 0x00 0x00 0x00 0x00 0xc1 0x00 0x00 0x00 0x01 0x01 0x00 0xc2 0x00 0x00 0x00 0x01 0x01 0x00 0xc3 0x00 0x00 0x00 0x01 0x01 0x00 0xc4 0x00 0x00 0x00 0x01 0x00 0x00 0xc5 0x00 0x00 0x00 0x01 0x00 0x00 0xc6 0x00 0x00 0x00 0x01 0x00 0x00 0xc7 0x00 0x00 0x00 0x01 0x00 0x00 0xc8 0x00 0x00 0x00 0x01 0x00 0x00 0xc9 0x00 0x00 0x00 0x01 0x00 0x00 0xca 0x00 0x00 0x00 0x01 0x00 0x00 0xcb 0x00 0x00 0x00 0x01 0x00 0x00 0xcc 0x00 0x00 0x00 0x01 0x00 0x00 0xcd 0x00 0x00 0x00 0x01 0x00 0x00 0xce 0x00 0x00 0x00 0x01 0x00 0x00 0xcf 0x00 0x00 0x00 0x01 0x00 0x00 0xd0 0x00 0x00 0x00 0x01 0x00 0x00>;
		};
	};

	fragment@58 {
		target = <0xffffffff>;

		__overlay__ {
			interrupt-parent = <0xffffffff>;
			interrupts = <0x00 0x08>;
			status = "okay";
		};
	};

	fragment@59 {
		target = <0xffffffff>;

		__overlay__ {
			interrupt-parent = <0xffffffff>;
			interrupts = <0x04 0x02>;
			status = "okay";
		};
	};

	fragment@60 {
		target = <0xffffffff>;

		__overlay__ {
			interrupt-parent = <0xffffffff>;
			interrupts = <0x08 0x04>;
			status = "okay";
		};
	};

	fragment@61 {
		target = <0xffffffff>;

		__overlay__ {
			interrupt-parent = <0xffffffff>;
			interrupts = <0x0e 0x08>;
			status = "okay";
		};
	};

	fragment@62 {
		target = <0xffffffff>;

		__overlay__ {
			interrupt-parent = <0xffffffff>;
			interrupts = <0x14 0x04>;
			deb-gpios = <0xffffffff 0x14 0x00>;
			debounce = <0x7d000>;
			status = "okay";
		};
	};

	fragment@63 {
		target = <0xffffffff>;

		__overlay__ {
			interrupt-parent = <0xffffffff>;
			interrupts = <0x25 0x01>;
			status = "okay";
		};
	};

	fragment@64 {
		target = <0xffffffff>;

		__overlay__ {
			compatible = "mediatek,md1_sim1_hot_plug_eint-eint";
			interrupts = <0x00 0x08>;
			debounce = <0x00 0x2710>;
			dedicated = <0x00 0x00>;
			src_pin = <0x00 0x01>;
			sockettype = <0x00 0x00>;
			status = "okay";
		};
	};

	fragment@65 {
		target = <0xffffffff>;

		__overlay__ {
			regulator-name = "vcamio";
			regulator-default-on = <0x01>;
			status = "okay";
		};
	};

	fragment@66 {
		target = <0xffffffff>;

		__overlay__ {
			regulator-name = "vtp";
			regulator-default-on = <0x01>;
			status = "okay";
		};
	};

	fragment@67 {
		target = <0xffffffff>;

		__overlay__ {
			vcamio-supply = <0xffffffff>;
			vcamio_sub-supply = <0xffffffff>;
			vcamio_main2-supply = <0xffffffff>;
			vcamio_sub2-supply = <0xffffffff>;
			status = "okay";
		};
	};

	fragment@68 {
		target = <0xffffffff>;

		__overlay__ {
			vtouch-supply = <0xffffffff>;
			status = "okay";
		};
	};

	fragment@69 {
		target = <0xffffffff>;

		__overlay__ {
			mediatek,kpd-key-debounce = <0x400>;
			mediatek,kpd-sw-pwrkey = <0x74>;
			mediatek,kpd-hw-pwrkey = <0x08>;
			mediatek,kpd-sw-rstkey = <0x73>;
			mediatek,kpd-hw-rstkey = <0x11>;
			mediatek,kpd-use-extend-type = <0x00>;
			mediatek,kpd-hw-map-num = <0x48>;
			mediatek,kpd-hw-init-map = <0x72 0x00 0x00 0x00 0x00 0x00 0x00 0x00 0x00 0x00 0x00 0x00 0x00 0x00 0x00 0x00 0x00 0x00 0x00 0x00 0x00 0x00 0x00 0x00 0x00 0x00 0x00 0x00 0x00 0x00 0x00 0x00 0x00 0x00 0x00 0x00 0x00 0x00 0x00 0x00 0x00 0x00 0x00 0x00 0x00 0x00 0x00 0x00 0x00 0x00 0x00 0x00 0x00 0x00 0x00 0x00 0x00 0x00 0x00 0x00 0x00 0x00 0x00 0x00 0x00 0x00 0x00 0x00 0x00 0x00 0x00 0x00>;
			mediatek,kpd-pwrkey-eint-gpio = <0x00>;
			mediatek,kpd-pwkey-gpio-din = <0x00>;
			mediatek,kpd-hw-dl-key0 = <0x11>;
			mediatek,kpd-hw-dl-key1 = <0x00>;
			mediatek,kpd-hw-dl-key2 = <0x08>;
			mediatek,kpd-hw-recovery-key = <0x11>;
			mediatek,kpd-hw-factory-key = <0x00>;
			status = "okay";
		};
	};

	fragment@70 {
		target = <0xffffffff>;

		__overlay__ {

			chg {
				compatible = "mediatek,mt6360_pmu_chg";
				interrupt-parent = <0xffffffff>;
				interrupts = <0x04 0x00 0x06 0x00 0x07 0x00 0x09 0x00 0x0c 0x00 0x0d 0x00 0x0e 0x00 0x0f 0x00 0x1b 0x00 0x1d 0x00 0x1e 0x00 0x20 0x00 0x23 0x00 0x28 0x00 0x30 0x00 0x3c 0x00 0x35 0x00>;
				interrupt-names = "chg_treg_evt\0chg_mivr_evt\0pwr_rdy_evt\0chg_batsysuv_evt\0chg_vsysuv_evt\0chg_vsysov_evt\0chg_vbatov_evt\0chg_vbusov_evt\0chg_tmri\0chg_adpbadi\0chg_rvpi\0chg_aiccmeasl\0wdtmri\0pumpx_donei\0attachi\0chrdet_ext_evt\0hvdcp_det";
				io-channels = <0xffffffff 0x00 0xffffffff 0x01 0xffffffff 0x03 0xffffffff 0x04 0xffffffff 0x05 0xffffffff 0x06 0xffffffff 0x08 0xffffffff 0x0a>;
				io-channel-names = "USBID\0VBUSDIV5\0VSYS\0VBAT\0IBUS\0IBAT\0TEMP_JC\0TS";
				chg_name = "primary_chg";
				ichg = <0x1e8480>;
				aicr = <0x7a120>;
				mivr = <0x432380>;
				cv = <0x426030>;
				ieoc = <0x249f0>;
				safety_timer = <0x0c>;
				ircmp_resistor = <0x61a8>;
				ircmp_vclamp = <0x7d00>;
				en_te = <0x01>;
				en_wdt = <0x01>;
				aicc_once = <0x01>;
				post_aicc = <0x01>;
				batoc_notify = <0x00>;
			};
		};
	};

	fragment@71 {
		target = <0xffffffff>;

		__overlay__ {

			sc8547-charger-slave@6F {
				status = "okay";
				compatible = "sc,sc8547-slave";
				reg = <0x6f 0x00>;
			};
		};
	};

	fragment@72 {
		target = <0xffffffff>;

		__overlay__ {

			core {
				sda_sizesel = <0x03>;
				sda_drvsrsel = <0x01>;
			};

			chg {
				support_hvdcp;
			};
		};
	};

	fragment@73 {
		target = <0xffffffff>;

		__overlay__ {
			pinctrl-names = "i2c-state\0output-low-state";
			pinctrl-0 = <0x29>;
			pinctrl-1 = <0x2a>;
		};
	};

	fragment@74 {
		target = <0xffffffff>;

		__overlay__ {

			i2c7_sda_i2c_state {
				phandle = <0x29>;

				pins_cmd_dat {
					pinmux = <0x8701>;
					slew-rate = <0x00>;
					bias-disable;
				};
			};

			i2c7_sda_output_low_state {
				phandle = <0x2a>;

				pins_cmd_dat {
					pinmux = <0x8700>;
					slew-rate = <0x01>;
					output-low;
				};
			};
		};
	};

	fragment@75 {
		target = <0xffffffff>;

		__overlay__ {

			sc8547-charger@6F {
				status = "okay";
				compatible = "sc,sc8547-master";
				reg = <0x6f 0x00>;
				qcom,irq_gpio = <0xffffffff 0x06 0x00>;
				interrupt-parent = <0xffffffff>;
				interrupts = <0x06 0x00>;
				pinctrl-names = "switch1_act_switch2_act\0switch1_sleep_switch2_sleep\0charging_inter_active\0charging_inter_sleep";
				pinctrl-0 = <0x2b>;
				pinctrl-1 = <0x2c>;
				pinctrl-2 = <0x2d>;
				pinctrl-3 = <0x2e>;
				qcom,charging_switch1-gpio = <0xffffffff 0x17 0x00>;
				qcom,voocphy_dual_cp_support;
				qcom,slave_cp_enable_thr = <0x76c>;
				qcom,slave_cp_disable_thr_high = <0x640>;
				qcom,voocphy_current_default = <0x3c>;
				qcom,svooc_cool_down_current_limit = <0x78 0x14 0x14 0x14 0x1e 0x28 0x32 0x3c 0x46 0x50 0x5a 0x64>;
				qcom,vooc_cool_down_current_limit = <0x3c 0x14 0x14 0x14 0x1e 0x28 0x32 0x3c>;
				qcom,vooc_multistep_initial_batt_temp = <0x3e8>;
				qcom,vooc_little_cool_temp = <0xa0>;
				qcom,vooc_cool_temp = <0x78>;
				qcom,vooc_little_cold_temp = <0x32>;
				qcom,vooc_normal_low_temp = <0x15e>;
				qcom,vooc_strategy_normal_current = <0x78>;
				qcom,vooc_normal_to_little_cool_current = <0x64>;
				qcom,vooc_batt_over_high_temp = <0x1b8>;
				qcom,vooc_batt_over_low_temp = <0x00>;
				qcom,vooc_strategy1_batt_high_temp0 = <0x18b>;
				qcom,vooc_strategy1_batt_high_temp1 = <0x1a4>;
				qcom,vooc_strategy1_batt_high_temp2 = <0x1b8>;
				qcom,vooc_strategy1_batt_low_temp2 = <0x1ae>;
				qcom,vooc_strategy1_batt_low_temp1 = <0x19a>;
				qcom,vooc_strategy1_batt_low_temp0 = <0x186>;
				qcom,vooc_strategy1_high_current0 = <0x3c>;
				qcom,vooc_strategy1_high_current1 = <0x28>;
				qcom,vooc_strategy1_high_current2 = <0x14>;
				qcom,vooc_strategy1_low_current2 = <0x28>;
				qcom,vooc_strategy1_low_current1 = <0x3c>;
				qcom,vooc_strategy1_low_current0 = <0x50>;
				qcom,voocphy_freq_mincore = <0xe1d48>;
				qcom,voocphy_freq_midcore = <0x145ed8>;
				qcom,voocphy_freq_maxcore = <0x149970>;
				qcom,voocphy_current_change_timeout = <0x64>;
				qcom,voocphy_ibat_over_current = <0x34bc>;
				qcom,voocphy_cp_max_ibus = <0xdac>;
				qcom,vooc_little_cold_full_voltage = <0x114e>;
				qcom,vooc_cool_full_voltage = <0x114e>;
				qcom,vooc_1time_full_voltage = <0x118a>;
				qcom,vooc_ntime_full_voltage = <0x118a>;
				qcom,low_curr_full_t1 = <0x78>;
				qcom,low_curr_full_t2 = <0x15e>;
				qcom,low_curr_full_t3 = <0x1ae>;
				qcom,range1_low_curr_full = <0x5aa 0x118a 0x578 0x1185 0x4b0 0x1176 0x3e8 0x116c 0x320 0x1162>;
				qcom,range2_low_curr_full = <0x640 0x118a 0x60e 0x1185 0x546 0x1176 0x47e 0x116c 0x3b6 0x1162>;
				svooc_batt_sys_curve = <0x00 0x01 0x00 0x01 0x00 0x00 0x00 0x01 0x01 0x01 0x01 0x00 0x00 0x00 0x00 0x00 0x01 0x01 0x00 0x01 0x00 0x01 0x01 0x01 0x01 0x00 0x00 0x00 0x00 0x00 0x00 0x01 0x00 0x01 0x01 0x01 0x01 0x01 0x01 0x00 0x00 0x00>;
				vooc_batt_sys_curve = <0x00 0x01 0x00 0x01 0x00 0x00 0x00 0x01 0x01 0x01 0x01 0x00 0x00 0x00 0x00 0x00 0x01 0x01 0x00 0x01 0x00 0x01 0x01 0x01 0x01 0x00 0x00 0x00 0x00 0x00 0x00 0x01 0x00 0x01 0x01 0x01 0x01 0x01 0x01 0x00 0x00 0x00>;

				svooc_charge_strategy {

					strategy_soc_0_to_50 {
						strategy_temp_little_cold = <0x1144 0x0e 0x00 0x00 0x00 0x114e 0x0a 0x00 0x00 0x00>;
						strategy_temp_cool = <0x1054 0x14 0x00 0x00 0x00 0x1144 0x0f 0x00 0x00 0x00 0x114e 0x0a 0x00 0x00 0x00>;
						strategy_temp_little_cool = <0x1054 0x28 0x00 0x00 0x00 0x10fe 0x1e 0x00 0x00 0x00 0x10fe 0x19 0x00 0x00 0x00 0x1180 0x14 0x00 0x00 0x00 0x1180 0x0f 0x00 0x00 0x00 0x118a 0x0a 0x00 0x00 0x00>;
						strategy_temp_normal_low = <0x1068 0x3c 0x00 0xf0 0x00 0x1068 0x32 0x00 0x258 0x00 0x10fe 0x28 0x00 0x258 0x00 0x1162 0x1e 0x00 0x00 0x00 0x1162 0x19 0x00 0x00 0x00 0x1180 0x14 0x00 0x00 0x00 0x1180 0x0f 0x00 0x00 0x00 0x118a 0x0a 0x00 0x00 0x00>;
						strategy_temp_normal_high = <0x1068 0x3c 0x00 0xf0 0x00 0x1068 0x32 0x00 0x258 0x00 0x10fe 0x28 0x00 0x258 0x00 0x1162 0x1e 0x00 0x00 0x00 0x1162 0x19 0x00 0x00 0x00 0x1180 0x14 0x00 0x00 0x00 0x1180 0x0f 0x00 0x00 0x00 0x118a 0x0a 0x00 0x00 0x00>;
					};

					strategy_soc_50_to_75 {
						strategy_temp_little_cold = <0x114e 0x0a 0x00 0x00 0x00>;
						strategy_temp_cool = <0x1144 0x0f 0x00 0x00 0x00 0x114e 0x0a 0x00 0x00 0x00>;
						strategy_temp_little_cool = <0x1180 0x14 0x00 0x00 0x00 0x1180 0x0f 0x00 0x00 0x00 0x118a 0x0a 0x00 0x00 0x00>;
						strategy_temp_normal_low = <0x1162 0x19 0x00 0x00 0x00 0x1180 0x14 0x00 0x00 0x00 0x1180 0x0f 0x00 0x00 0x00 0x118a 0x0a 0x00 0x00 0x00>;
						strategy_temp_normal_high = <0x1162 0x19 0x00 0x00 0x00 0x1180 0x14 0x00 0x00 0x00 0x1180 0x0f 0x00 0x00 0x00 0x118a 0x0a 0x00 0x00 0x00>;
					};

					strategy_soc_75_to_85 {
						strategy_temp_little_cold = <0x114e 0x0a 0x00 0x00 0x00>;
						strategy_temp_cool = <0x114e 0x0a 0x00 0x00 0x00>;
						strategy_temp_little_cool = <0x118a 0x0a 0x00 0x00 0x00>;
						strategy_temp_normal_low = <0x1180 0x0f 0x00 0x00 0x00 0x118a 0x0a 0x00 0x00 0x00>;
						strategy_temp_normal_high = <0x1180 0x0f 0x00 0x00 0x00 0x118a 0x0a 0x00 0x00 0x00>;
					};

					strategy_soc_85_to_90 {
						strategy_temp_little_cold = <0x114e 0x0a 0x00 0x00 0x00>;
						strategy_temp_cool = <0x114e 0x0a 0x00 0x00 0x00>;
						strategy_temp_little_cool = <0x118a 0x0a 0x00 0x00 0x00>;
						strategy_temp_normal_low = <0x118a 0x0a 0x00 0x00 0x00>;
						strategy_temp_normal_high = <0x118a 0x0a 0x00 0x00 0x00>;
					};
				};

				vooc_charge_strategy {

					strategy_soc_0_to_50 {
						strategy_temp_little_cold = <0x1144 0x1c 0x00 0x00 0x00 0x114e 0x14 0x00 0x00 0x00>;
						strategy_temp_cool = <0x1054 0x28 0x00 0x00 0x00 0x1144 0x1e 0x00 0x00 0x00 0x114e 0x14 0x00 0x00 0x00>;
						strategy_temp_little_cool = <0x10fe 0x3b 0x00 0x708 0x00 0x10fe 0x32 0x00 0x00 0x00 0x1180 0x28 0x00 0x00 0x00 0x1180 0x1e 0x00 0x00 0x00 0x118a 0x14 0x00 0x00 0x00>;
						strategy_temp_normal_low = <0x1162 0x3b 0x00 0x708 0x00 0x1162 0x32 0x00 0x00 0x00 0x1180 0x28 0x00 0x00 0x00 0x1180 0x1e 0x00 0x00 0x00 0x118a 0x14 0x00 0x00 0x00>;
						strategy_temp_normal_high = <0x1162 0x3b 0x00 0x708 0x00 0x1162 0x32 0x00 0x00 0x00 0x1180 0x28 0x00 0x00 0x00 0x1180 0x1e 0x00 0x00 0x00 0x118a 0x14 0x00 0x00 0x00>;
					};

					strategy_soc_50_to_75 {
						strategy_temp_little_cold = <0x114e 0x14 0x00 0x00 0x00>;
						strategy_temp_cool = <0x1144 0x1e 0x00 0x00 0x00 0x114e 0x14 0x00 0x00 0x00>;
						strategy_temp_little_cool = <0x117b 0x28 0x00 0x00 0x00 0x1180 0x1e 0x00 0x00 0x00 0x118a 0x14 0x00 0x00 0x00>;
						strategy_temp_normal_low = <0x1162 0x32 0x00 0x00 0x00 0x1180 0x28 0x00 0x00 0x00 0x1180 0x1e 0x00 0x00 0x00 0x118a 0x14 0x00 0x00 0x00>;
						strategy_temp_normal_high = <0x1162 0x32 0x00 0x00 0x00 0x1180 0x28 0x00 0x00 0x00 0x1180 0x1e 0x00 0x00 0x00 0x118a 0x14 0x00 0x00 0x00>;
					};

					strategy_soc_75_to_85 {
						strategy_temp_little_cold = <0x114e 0x14 0x00 0x00 0x00>;
						strategy_temp_cool = <0x114e 0x14 0x00 0x00 0x00>;
						strategy_temp_little_cool = <0x118a 0x14 0x00 0x00 0x00>;
						strategy_temp_normal_low = <0x1180 0x1e 0x00 0x00 0x00 0x118a 0x14 0x00 0x00 0x00>;
						strategy_temp_normal_high = <0x1180 0x1e 0x00 0x00 0x00 0x118a 0x14 0x00 0x00 0x00>;
					};

					strategy_soc_85_to_90 {
						strategy_temp_little_cold = <0x114e 0x14 0x00 0x00 0x00>;
						strategy_temp_cool = <0x114e 0x14 0x00 0x00 0x00>;
						strategy_temp_little_cool = <0x118a 0x14 0x00 0x00 0x00>;
						strategy_temp_normal_low = <0x118a 0x14 0x00 0x00 0x00>;
						strategy_temp_normal_high = <0x118a 0x14 0x00 0x00 0x00>;
					};
				};
			};
		};
	};

	fragment@76 {
		target = <0xffffffff>;

		__overlay__ {
			status = "disabled";
		};
	};

	fragment@77 {
		target = <0xffffffff>;

		__overlay__ {
			status = "disabled";
		};
	};

	fragment@78 {
		target = <0xffffffff>;

		__overlay__ {
			status = "disabled";
		};
	};

	fragment@79 {
		target = <0xffffffff>;

		__overlay__ {

			charging_switch1_active {
				phandle = <0x2b>;

				pins_cmd_dat {
					pinmux = <0x1700>;
					slew-rate = <0x01>;
					output-high;
				};
			};

			charging_switch1_sleep {
				phandle = <0x2c>;

				pins_cmd_dat {
					pinmux = <0x1700>;
					slew-rate = <0x01>;
					output-low;
				};
			};

			charging_inter_active {
				phandle = <0x2d>;

				pins_cmd_dat {
					pinmux = <0x600>;
					slew-rate = <0x00>;
				};
			};

			charging_inter_sleep {
				phandle = <0x2e>;

				pins_cmd_dat {
					pinmux = <0x600>;
					slew-rate = <0x00>;
				};
			};

			charger_gpio_as_output_low {
				phandle = <0x32>;

				pins_cmd_dat {
					pinmux = <0x1900>;
					slew-rate = <0x01>;
					output-low;
				};
			};

			charger_gpio_as_output_high {
				phandle = <0x33>;

				pins_cmd_dat {
					pinmux = <0x1900>;
					slew-rate = <0x01>;
					output-high;
				};
			};
		};
	};

	fragment@80 {
		target = <0xffffffff>;

		__overlay__ {
			io-channels = <0xffffffff 0x05 0xffffffff 0x06 0xffffffff 0x07 0xffffffff 0x08>;
			io-channel-names = "auxadc6-subboard_temp\0auxadc3-chargeric_temp\0auxadc4-usb_temp_v_l\0auxadc5-usb_temp_v_r";
			pinctrl-names = "default\0dischg_enable\0dischg_disable\0charger_gpio_as_output_low\0charger_gpio_as_output_high";
			pinctrl-0 = <0x2f>;
			pinctrl-1 = <0x30>;
			pinctrl-2 = <0x31>;
			pinctrl-3 = <0x32>;
			pinctrl-4 = <0x33>;
			qcom,pd_input_current_charger_ma = <0x7d0>;
			qcom,qc_input_current_charger_ma = <0x7d0>;
			qcom,input_current_charger_ma = <0x7d0>;
			qcom,input_current_usb_ma = <0x1f4>;
			qcom,input_current_cdp_ma = <0x5dc>;
			qcom,input_current_camera_ma = <0x4b0>;
			qcom,input_current_calling_ma = <0x5dc>;
			qcom,led_warm_bat_decidegc = <0x15e>;
			qcom,led_high_bat_decidegc = <0x172>;
			qcom,input_current_led_ma = <0x4b0>;
			qcom,input_current_led_ma_high = <0x4b0>;
			qcom,input_current_led_ma_warm = <0x5dc>;
			qcom,input_current_led_ma_normal = <0x8fc>;
			qcom,input_current_led_ma_forcmcc = <0x1f4>;
			qcom,input_current_led_ma_limit_high = <0x4b0>;
			qcom,vooc_temp_bat_normal_decidegc = <0x15e>;
			qcom,vooc_temp_bat_warm_decidegc = <0x172>;
			qcom,vooc_temp_bat_hot_decidegc = <0x1b8>;
			qcom,input_current_vooc_led_ma_high = <0x4b0>;
			qcom,input_current_vooc_led_ma_warm = <0x708>;
			qcom,input_current_vooc_led_ma_normal = <0xe10>;
			qcom,input_current_vooc_ma_normal = <0xe10>;
			qcom,input_current_vooc_ma_warm = <0xc80>;
			qcom,input_current_vooc_ma_high = <0x898>;
			qcom,overtemp_bat_decidegc = <0x15e>;
			qcom,iterm_disabled = <0x00>;
			qcom,iterm_ma = <0xe6>;
			qcom,recharge-mv = <0x64>;
			qcom,batt_capacity_mah = <0x1194>;
			qcom,usb_high_than_bat_decidegc = <0xa8>;
			qcom,removed_bat_decidegc = <0x96>;
			qcom,cold_bat_decidegc = <0x14>;
			qcom,temp_cold_vfloat_mv = <0xf8c>;
			qcom,temp_cold_fastchg_current_ma = <0x1f4>;
			qcom,little_cold_bat_decidegc = <0x00>;
			qcom,temp_little_cold_vfloat_mv = <0x1153>;
			qcom,temp_little_cold_fastchg_current_ma_high = <0x898>;
			qcom,temp_little_cold_fastchg_current_ma_low = <0x898>;
			qcom,temp_little_cold_fastchg_current_ma = <0x434>;
			qcom,qc_temp_little_cold_fastchg_current_ma_high = <0xa22>;
			qcom,qc_temp_little_cold_fastchg_current_ma_low = <0xce4>;
			qcom,pd_temp_little_cold_fastchg_current_ma_high = <0xa22>;
			qcom,pd_temp_little_cold_fastchg_current_ma_low = <0xce4>;
			qcom,cool_bat_decidegc = <0x32>;
			qcom,temp_cool_vfloat_mv = <0x1153>;
			qcom,temp_cool_fastchg_current_ma_high = <0x898>;
			qcom,temp_cool_fastchg_current_ma_low = <0x898>;
			qcom,qc_temp_cool_fastchg_current_ma_high = <0xce4>;
			qcom,qc_temp_cool_fastchg_current_ma_low = <0xce4>;
			qcom,pd_temp_cool_fastchg_current_ma_high = <0xce4>;
			qcom,pd_temp_cool_fastchg_current_ma_low = <0xce4>;
			qcom,little_cool_bat_decidegc = <0x78>;
			qcom,temp_little_cool_vfloat_mv = <0x1153>;
			qcom,temp_little_cool_fastchg_current_ma = <0x898>;
			qcom,pd_temp_little_cool_fastchg_current_ma = <0xce4>;
			qcom,qc_temp_little_cool_fastchg_current_ma = <0xce4>;
			qcom,normal_bat_decidegc = <0xa0>;
			qcom,temp_normal_vfloat_mv = <0x1153>;
			qcom,temp_normal_fastchg_current_ma = <0x898>;
			qcom,pd_temp_normal_fastchg_current_ma = <0xce4>;
			qcom,qc_temp_normal_fastchg_current_ma = <0xce4>;
			qcom,warm_bat_decidegc = <0x1c2>;
			qcom,temp_warm_vfloat_mv = <0x1022>;
			qcom,temp_warm_fastchg_current_ma = <0x546>;
			qcom,pd_temp_warm_fastchg_current_ma = <0x546>;
			qcom,qc_temp_warm_fastchg_current_ma = <0x546>;
			qcom,temp_warm_fastchg_current_ma_led_on = <0x1f4>;
			qcom,hot_bat_decidegc = <0x212>;
			qcom,non_standard_vfloat_mv = <0xf8c>;
			qcom,non_standard_fastchg_current_ma = <0x200>;
			qcom,short_c_bat_cv_mv = <0x10ea>;
			qcom,short_c_bat_vfloat_mv = <0xed8>;
			qcom,short_c_bat_fastchg_current_ma = <0x200>;
			qcom,short_c_bat_vfloat_sw_limit = <0xea6>;
			qcom,cold_vfloat_sw_limit = <0xf5a>;
			qcom,little_cold_vfloat_sw_limit = <0x1121>;
			qcom,cool_vfloat_sw_limit = <0x1121>;
			qcom,little_cool_vfloat_sw_limit = <0x1121>;
			qcom,normal_vfloat_sw_limit = <0x1121>;
			qcom,warm_vfloat_sw_limit = <0xff0>;
			qcom,non_standard_vfloat_sw_limit = <0xf5a>;
			qcom,max_chg_time_sec = <0x11280>;
			qcom,charger_hv_thr = <0x2710>;
			qcom,charger_recv_thr = <0x2648>;
			qcom,charger_lv_thr = <0xd48>;
			qcom,vbatt_full_thr = <0x1130>;
			qcom,vbatt_hv_thr = <0x11c6>;
			qcom,vfloat_step_mv = <0x08>;
			qcom,non_standard_vfloat_over_sw_limit = <0xf8c>;
			qcom,cold_vfloat_over_sw_limit = <0xf8c>;
			qcom,little_cold_vfloat_over_sw_limit = <0x1158>;
			qcom,cool_vfloat_over_sw_limit = <0x1158>;
			qcom,little_cool_vfloat_over_sw_limit = <0x1158>;
			qcom,normal_vfloat_over_sw_limit = <0x1158>;
			qcom,warm_vfloat_over_sw_limit = <0x1022>;
			qcom,vbatt_power_off = <0xce4>;
			qcom,vbatt_soc_1 = <0xd52>;
			qcom,vooc_project = <0x04>;
			qcom,vbatt_num = <0x01>;
			qcom,new_ui_warning_support;
			qcom,smart_charging_screenoff;
			qcom,smart_charge_version = <0x01>;
			qcom,normal_vterm_hw_inc = <0x12>;
			qcom,non_normal_vterm_hw_inc = <0x12>;
			qcom,usbtemp_batttemp_gap = <0x12>;
			qcom,ff1_normal_fastchg_ma = <0x60e>;
			qcom,ff1_warm_fastchg_ma = <0x6a4>;
			qcom,ff1_exit_step_ma = <0x12c>;
			qcom,ff1_warm_exit_step_ma = <0x64>;
			qcom,ffc2_normal_fastchg_ma = <0x60e>;
			qcom,ffc2_warm_fastchg_ma = <0x6a4>;
			qcom,ffc2_temp_warm_decidegc = <0x15e>;
			qcom,ffc2_temp_high_decidegc = <0x190>;
			qcom,ffc2_temp_low_decidegc = <0xa0>;
			qcom,ffc2_exit_step_ma = <0x12c>;
			qcom,ffc2_warm_exit_step_ma = <0xc8>;
			qcom,ffc_normal_vfloat_sw_limit = <0x1185>;
			qcom,ffc2_normal_vfloat_sw_limit = <0x1185>;
			qcom,ffc_temp_normal_vfloat_mv = <0x11c6>;
			qcom,ffc_normal_vfloat_over_sw_limit = <0x11c6>;
			qcom,default_iterm_ma = <0xe6>;
			qcom,default_temp_normal_fastchg_current_ma = <0x898>;
			qcom,default_normal_vfloat_sw_limit = <0x1121>;
			qcom,default_temp_normal_vfloat_mv = <0x1153>;
			qcom,default_normal_vfloat_over_sw_limit = <0x1158>;
			qcom,default_temp_little_cool_fastchg_current_ma = <0x898>;
			qcom,default_little_cool_vfloat_sw_limit = <0x1121>;
			qcom,default_temp_little_cool_vfloat_mv = <0x1153>;
			qcom,default_little_cool_vfloat_over_sw_limit = <0x115d>;
			qcom,vbatt_pdqc_to_5v_thr = <0x1194>;
			qcom,vbatt_pdqc_to_9v_thr = <0x1194>;
			qcom,check_batt_full_by_sw;
			qcom,chg_ctrl_by_lcd;
			qcom,chg_ctrl_by_camera;
			qcom,chg_ctrl_by_calling;
			qcom,sw_vfloat_over_protect_enable;
			qcom,ffc_support;
			qcom,chargerid_vol_disable;
			qcom,support_ntc_01c_precision;
			qcom,voocphy_support = <0x03>;
			voocphy_support_display_vooc;
			qcom,external_authenticate;
			qcom,chargerid_support;
			qcom,vooc_show_ui_soc_decimal;
			qcom,ui_soc_decimal_speedmin = <0x14>;
			qcom,chargerid_switch-gpio = <0xffffffff 0x19 0x00>;
			qcom,dischg-gpio = <0xffffffff 0xa9 0x00>;
			qcom,g_rap_pull_up_r0 = <0x5f370>;
		};
	};

	fragment@81 {
		target = <0xffffffff>;

		__overlay__ {
			support_tuv_authentication;
			for_mtk_battery_temp_support;
		};
	};

	fragment@82 {
		target = <0xffffffff>;

		__overlay__ {
			FUELGAGUE_APPLY = <0x01>;
			FOR_MTK_60W_SUPPORT = <0x01>;
			IS_4450MV_BATTERY_SUPPORT = <0x01>;
			IS_SUBBOARD_TEMP_SUPPORT = <0x01>;
			R_FG_VALUE = <0x05>;
			g_FG_PSEUDO100_T0 = <0x62>;
			g_FG_PSEUDO100_T1 = <0x60>;
			g_FG_PSEUDO100_T2 = <0x5c>;
			g_FG_PSEUDO100_T3 = <0x57>;
			g_FG_PSEUDO100_T4 = <0x57>;
			battery0_profile_t0_num = <0x64>;
			battery0_profile_t0_col = <0x06>;
			battery0_profile_t0 = <0x00 0xad48 0x1f4 0x1f4 0x190 0x15e 0x1cd 0xac98 0x1f4 0x1f4 0x190 0x15e 0x399 0xac18 0x1b1 0x1b1 0x15a 0x12f 0x566 0xaba2 0x190 0x190 0x140 0x118 0x732 0xab31 0x190 0x190 0x140 0x118 0x8ff 0xaac6 0x196 0x196 0x145 0x11c 0xacc 0xaa61 0x1b1 0x1b1 0x15a 0x12f 0xc98 0xa9f4 0x1b1 0x1b1 0x15a 0x12f 0xe65 0xa987 0x1b1 0x1b1 0x15a 0x12f 0x1031 0xa91a 0x1c3 0x1c3 0x169 0x13c 0x11fe 0xa8a6 0x1ba 0x1ba 0x162 0x135 0x13cb 0xa82a 0x197 0x197 0x146 0x11d 0x1597 0xa7b5 0x1b3 0x1b3 0x15c 0x131 0x1764 0xa740 0x1cf 0x1cf 0x172 0x144 0x1930 0xa6c3 0x1bb 0x1bb 0x162 0x136 0x1afd 0xa646 0x1b1 0x1b1 0x15a 0x12f 0x1cca 0xa5cc 0x1bf 0x1bf 0x166 0x139 0x1e96 0xa554 0x1cb 0x1cb 0x16f 0x141 0x2063 0xa4d7 0x1b1 0x1b1 0x15a 0x12f 0x2230 0xa459 0x1b1 0x1b1 0x15a 0x12f 0x23fc 0xa3e3 0x1b1 0x1b1 0x15a 0x12f 0x25c9 0xa368 0x1b1 0x1b1 0x15a 0x12f 0x2795 0xa2ef 0x1bf 0x1bf 0x166 0x139 0x2962 0xa279 0x1d3 0x1d3 0x176 0x147 0x2b2f 0xa204 0x1d3 0x1d3 0x176 0x147 0x2cfb 0xa18f 0x1d3 0x1d3 0x176 0x147 0x2ec8 0xa11a 0x1d3 0x1d3 0x176 0x147 0x3094 0xa0a4 0x1be 0x1be 0x165 0x138 0x3261 0xa034 0x1c0 0x1c0 0x166 0x13a 0x342e 0x9fc7 0x1d3 0x1d3 0x176 0x147 0x35fa 0x9f5a 0x1d3 0x1d3 0x176 0x147 0x37c7 0x9eed 0x1d3 0x1d3 0x176 0x147 0x3993 0x9e80 0x1d3 0x1d3 0x176 0x147 0x3b60 0x9e1a 0x1e8 0x1e8 0x186 0x156 0x3d2d 0x9db5 0x1f4 0x1f4 0x190 0x15e 0x3ef9 0x9d51 0x1f4 0x1f4 0x190 0x15e 0x40c6 0x9cee 0x1f9 0x1f9 0x194 0x162 0x4292 0x9c92 0x215 0x215 0x1aa 0x175 0x445f 0x9c2d 0x215 0x215 0x1aa 0x175 0x462c 0x9bcf 0x241 0x241 0x1ce 0x194 0x47f8 0x9b69 0x258 0x258 0x1e0 0x1a4 0x49c5 0x9af2 0x24d 0x24d 0x1d7 0x19c 0x4b91 0x9a65 0x225 0x225 0x1b7 0x180 0x4d5e 0x99be 0x1d2 0x1d2 0x175 0x146 0x4f2b 0x9941 0x1b6 0x1b6 0x15e 0x133 0x50f7 0x98df 0x1b1 0x1b1 0x15a 0x12f 0x52c4 0x988d 0x1b1 0x1b1 0x15a 0x12f 0x5490 0x9842 0x1b1 0x1b1 0x15a 0x12f 0x565d 0x97f8 0x1b1 0x1b1 0x15a 0x12f 0x582a 0x97b5 0x1b1 0x1b1 0x15a 0x12f 0x59f6 0x9772 0x1b1 0x1b1 0x15a 0x12f 0x5bc3 0x9736 0x1b1 0x1b1 0x15a 0x12f 0x5d90 0x96fc 0x1b1 0x1b1 0x15a 0x12f 0x5f5c 0x96c1 0x1b1 0x1b1 0x15a 0x12f 0x6129 0x9689 0x1b9 0x1b9 0x161 0x135 0x62f5 0x9656 0x1d1 0x1d1 0x174 0x146 0x64c2 0x961b 0x1b5 0x1b5 0x15e 0x132 0x668f 0x95e8 0x1b1 0x1b1 0x15a 0x12f 0x685b 0x95bb 0x1c4 0x1c4 0x16a 0x13c 0x6a28 0x958d 0x1c5 0x1c5 0x16a 0x13d 0x6bf4 0x955e 0x1b1 0x1b1 0x15a 0x12f 0x6dc1 0x9534 0x1b4 0x1b4 0x15d 0x131 0x6f8e 0x950a 0x1d0 0x1d0 0x173 0x145 0x715a 0x94e8 0x1d3 0x1d3 0x176 0x147 0x7327 0x94c0 0x1d3 0x1d3 0x176 0x147 0x74f3 0x949b 0x1e1 0x1e1 0x181 0x151 0x76c0 0x9476 0x1fd 0x1fd 0x197 0x164 0x788d 0x944a 0x212 0x212 0x1a8 0x173 0x7a59 0x9410 0x1f6 0x1f6 0x192 0x15f 0x7c26 0x93b6 0x1c0 0x1c0 0x166 0x13a 0x7df2 0x9360 0x1b1 0x1b1 0x15a 0x12f 0x7fbf 0x931e 0x1c1 0x1c1 0x167 0x13a 0x818c 0x92e9 0x1c9 0x1c9 0x16e 0x140 0x8358 0x92b0 0x1b6 0x1b6 0x15e 0x133 0x8525 0x927e 0x1d2 0x1d2 0x175 0x146 0x86f1 0x9244 0x1b8 0x1b8 0x160 0x134 0x88be 0x9217 0x1c6 0x1c6 0x16b 0x13e 0x8a8b 0x91e8 0x1c3 0x1c3 0x169 0x13c 0x8c57 0x91b9 0x1bb 0x1bb 0x162 0x136 0x8e24 0x9189 0x1ce 0x1ce 0x172 0x143 0x8ff0 0x913e 0x1b2 0x1b2 0x15b 0x130 0x91bd 0x90fb 0x1cd 0x1cd 0x171 0x143 0x938a 0x90b8 0x1bd 0x1bd 0x164 0x138 0x9556 0x9070 0x1c2 0x1c2 0x168 0x13b 0x9723 0x9024 0x1d3 0x1d3 0x176 0x147 0x98f0 0x8fe5 0x1cd 0x1cd 0x171 0x143 0x9abc 0x8fd4 0x1b1 0x1b1 0x15a 0x12f 0x9c89 0x8fcc 0x1cd 0x1cd 0x171 0x143 0x9e55 0x8fbc 0x1d3 0x1d3 0x176 0x147 0xa022 0x8fa7 0x1e4 0x1e4 0x183 0x153 0xa1ef 0x8f78 0x1f4 0x1f4 0x190 0x15e 0xa3bb 0x8efb 0x1fa 0x1fa 0x195 0x162 0xa588 0x8dd0 0x215 0x215 0x1aa 0x175 0xa754 0x8bf2 0x215 0x215 0x1aa 0x175 0xa921 0x8988 0x244 0x244 0x1d0 0x196 0xaaee 0x8630 0x27c 0x27c 0x1fd 0x1bd 0xacba 0x80cc 0x3d6 0x3d6 0x312 0x2af 0xae87 0x76e5 0xb46 0xb46 0x905 0x7e4 0xb053 0x6ed2 0x535 0x535 0x42a 0x3a5 0xb220 0x6ed2 0x535 0x535 0x42a 0x3a5>;
			battery0_profile_t1_num = <0x64>;
			battery0_profile_t1_col = <0x06>;
			battery0_profile_t1 = <0x00 0xad48 0x302 0x28f 0x1ce 0x268 0x1cd 0xacca 0x2ff 0x28c 0x1cc 0x266 0x399 0xac5a 0x2ff 0x28c 0x1cc 0x266 0x566 0xabed 0x2ee 0x27e 0x1c2 0x258 0x732 0xab84 0x2dd 0x26f 0x1b8 0x24a 0x8ff 0xab20 0x2dd 0x26f 0x1b8 0x24a 0xacc 0xaabb 0x2de 0x270 0x1b8 0x24b 0xc98 0xaa57 0x2fa 0x288 0x1c9 0x262 0xe65 0xa9eb 0x2e7 0x278 0x1be 0x252 0x1031 0xa979 0x2cb 0x260 0x1ad 0x23c 0x11fe 0xa907 0x2c8 0x25d 0x1ab 0x23a 0x13cb 0xa898 0x2dd 0x26f 0x1b8 0x24a 0x1597 0xa823 0x2dc 0x26e 0x1b7 0x24a 0x1764 0xa7a5 0x2c0 0x256 0x1a6 0x233 0x1930 0xa72f 0x2d4 0x267 0x1b2 0x243 0x1afd 0xa6b4 0x2dd 0x26f 0x1b8 0x24a 0x1cca 0xa636 0x2d0 0x264 0x1b0 0x240 0x1e96 0xa5b8 0x2c4 0x25a 0x1a9 0x236 0x2063 0xa53b 0x2db 0x26d 0x1b7 0x249 0x2230 0xa4bd 0x2bf 0x256 0x1a6 0x232 0x23fc 0xa440 0x2bc 0x253 0x1a4 0x230 0x25c9 0xa3c8 0x2d0 0x264 0x1b0 0x240 0x2795 0xa353 0x2dd 0x26f 0x1b8 0x24a 0x2962 0xa2db 0x2d5 0x268 0x1b3 0x244 0x2b2f 0xa25e 0x2bf 0x256 0x1a6 0x232 0x2cfb 0xa1e9 0x2db 0x26d 0x1b7 0x249 0x2ec8 0xa174 0x2dd 0x26f 0x1b8 0x24a 0x3094 0xa104 0x2f2 0x281 0x1c4 0x25b 0x3261 0xa093 0x2ff 0x28c 0x1cc 0x266 0x342e 0xa021 0x2ff 0x28c 0x1cc 0x266 0x35fa 0x9fb3 0x2fb 0x289 0x1ca 0x262 0x37c7 0x9f3d 0x2df 0x271 0x1b9 0x24c 0x3993 0x9ed8 0x313 0x29d 0x1d8 0x276 0x3b60 0x9e74 0x335 0x2ba 0x1ed 0x291 0x3d2d 0x9e0a 0x341 0x2c4 0x1f4 0x29a 0x3ef9 0x9da1 0x341 0x2c4 0x1f4 0x29a 0x40c6 0x9d3c 0x346 0x2c8 0x1f7 0x29e 0x4292 0x9cd8 0x362 0x2e0 0x208 0x2b5 0x445f 0x9c7b 0x39a 0x310 0x229 0x2e2 0x462c 0x9c19 0x3bb 0x32c 0x23d 0x2fc 0x47f8 0x9bb4 0x3d7 0x344 0x24e 0x312 0x49c5 0x9b49 0x3e8 0x352 0x258 0x320 0x4b91 0x9acd 0x3d7 0x344 0x24e 0x312 0x4d5e 0x9a36 0x383 0x2fc 0x21b 0x2cf 0x4f2b 0x999f 0x313 0x29d 0x1d8 0x276 0x50f7 0x9924 0x2d1 0x265 0x1b1 0x241 0x52c4 0x98be 0x2ab 0x245 0x19a 0x222 0x5490 0x9866 0x29b 0x237 0x190 0x216 0x565d 0x9816 0x29b 0x237 0x190 0x216 0x582a 0x97d3 0x29b 0x237 0x190 0x216 0x59f6 0x9790 0x29b 0x237 0x190 0x216 0x5bc3 0x9754 0x2b2 0x24b 0x19e 0x228 0x5d90 0x971a 0x2bc 0x253 0x1a4 0x230 0x5f5c 0x96df 0x2bc 0x253 0x1a4 0x230 0x6129 0x96a4 0x2b5 0x24d 0x1a0 0x22a 0x62f5 0x966a 0x29d 0x239 0x191 0x217 0x64c2 0x9638 0x2b9 0x250 0x1a2 0x22e 0x668f 0x9606 0x2bc 0x253 0x1a4 0x230 0x685b 0x95d9 0x2bc 0x253 0x1a4 0x230 0x6a28 0x95ab 0x2ae 0x247 0x19c 0x225 0x6bf4 0x957c 0x2a3 0x23e 0x195 0x21c 0x6dc1 0x9553 0x2bf 0x256 0x1a6 0x232 0x6f8e 0x9531 0x2db 0x26d 0x1b7 0x249 0x715a 0x9508 0x2dd 0x26f 0x1b8 0x24a 0x7327 0x94e4 0x2f1 0x280 0x1c4 0x25a 0x74f3 0x94c3 0x2ff 0x28c 0x1cc 0x266 0x76c0 0x949e 0x2ff 0x28c 0x1cc 0x266 0x788d 0x9476 0x2ff 0x28c 0x1cc 0x266 0x7a59 0x9454 0x2ff 0x28c 0x1cc 0x266 0x7c26 0x942b 0x2ff 0x28c 0x1cc 0x266 0x7df2 0x9401 0x2ff 0x28c 0x1cc 0x266 0x7fbf 0x93ce 0x2e0 0x272 0x1ba 0x24d 0x818c 0x9396 0x2bc 0x253 0x1a4 0x230 0x8358 0x9364 0x2bc 0x253 0x1a4 0x230 0x8525 0x9332 0x2bc 0x253 0x1a4 0x230 0x86f1 0x9300 0x2bc 0x253 0x1a4 0x230 0x88be 0x92ce 0x2bc 0x253 0x1a4 0x230 0x8a8b 0x92a1 0x2ac 0x245 0x19a 0x223 0x8c57 0x9277 0x2a5 0x23f 0x196 0x21e 0x8e24 0x924c 0x2bc 0x253 0x1a4 0x230 0x8ff0 0x9219 0x2bc 0x253 0x1a4 0x230 0x91bd 0x91d7 0x2a1 0x23c 0x194 0x21a 0x938a 0x9194 0x2b0 0x249 0x19d 0x226 0x9556 0x9156 0x2bc 0x253 0x1a4 0x230 0x9723 0x9111 0x2bc 0x253 0x1a4 0x230 0x98f0 0x90bf 0x2bc 0x253 0x1a4 0x230 0x9abc 0x9074 0x2bc 0x253 0x1a4 0x230 0x9c89 0x9063 0x2bc 0x253 0x1a4 0x230 0x9e55 0x9052 0x2bc 0x253 0x1a4 0x230 0xa022 0x9042 0x2bc 0x253 0x1a4 0x230 0xa1ef 0x902d 0x2c8 0x25d 0x1ab 0x23a 0xa3bb 0x900d 0x2dd 0x26f 0x1b8 0x24a 0xa588 0x8fcb 0x2dd 0x26f 0x1b8 0x24a 0xa754 0x8ebf 0x2dd 0x26f 0x1b8 0x24a 0xa921 0x8cfc 0x30c 0x297 0x1d4 0x270 0xaaee 0x8aaa 0x344 0x2c7 0x1f6 0x29d 0xacba 0x8785 0x3a2 0x317 0x22e 0x2e8 0xae87 0x827e 0x520 0x45b 0x313 0x41a 0xb053 0x791d 0xa5f 0x8d1 0x639 0x84c 0xb220 0x6f18 0x5bb 0x4df 0x370 0x496>;
			battery0_profile_t2_num = <0x64>;
			battery0_profile_t2_col = <0x06>;
			battery0_profile_t2 = <0x00 0xad7a 0x686 0x686 0x538 0x538 0x1cd 0xacfc 0x683 0x683 0x536 0x536 0x399 0xac8c 0x699 0x699 0x547 0x547 0x566 0xac2a 0x6a4 0x6a4 0x550 0x550 0x732 0xabca 0x698 0x698 0x546 0x546 0x8ff 0xab67 0x67c 0x67c 0x530 0x530 0xacc 0xab0b 0x661 0x661 0x51a 0x51a 0xc98 0xaaa7 0x645 0x645 0x504 0x504 0xe65 0xaa42 0x640 0x640 0x500 0x500 0x1031 0xa9de 0x640 0x640 0x500 0x500 0x11fe 0xa972 0x627 0x627 0x4ec 0x4ec 0x13cb 0xa8fe 0x5fd 0x5fd 0x4ca 0x4ca 0x1597 0xa891 0x5fc 0x5fc 0x4ca 0x4ca 0x1764 0xa81c 0x5e0 0x5e0 0x4b3 0x4b3 0x1930 0xa79f 0x5c4 0x5c4 0x49d 0x49d 0x1afd 0xa727 0x5bb 0x5bb 0x496 0x496 0x1cca 0xa6ae 0x5ad 0x5ad 0x48a 0x48a 0x1e96 0xa630 0x599 0x599 0x47a 0x47a 0x2063 0xa5b3 0x597 0x597 0x479 0x479 0x2230 0xa535 0x57b 0x57b 0x462 0x462 0x23fc 0xa4b8 0x55f 0x55f 0x44c 0x44c 0x25c9 0xa440 0x56a 0x56a 0x455 0x455 0x2795 0xa3c6 0x56a 0x56a 0x455 0x455 0x2962 0xa34b 0x55f 0x55f 0x44c 0x44c 0x2b2f 0xa2d5 0x575 0x575 0x45e 0x45e 0x2cfb 0xa258 0x559 0x559 0x447 0x447 0x2ec8 0xa1e9 0x570 0x570 0x45a 0x45a 0x3094 0xa170 0x564 0x564 0x450 0x450 0x3261 0xa0fc 0x566 0x566 0x452 0x452 0x342e 0xa08c 0x578 0x578 0x460 0x460 0x35fa 0xa018 0x57c 0x57c 0x463 0x463 0x37c7 0x9fab 0x598 0x598 0x47a 0x47a 0x3993 0x9f3e 0x599 0x599 0x47a 0x47a 0x3b60 0x9ed8 0x5c4 0x5c4 0x49d 0x49d 0x3d2d 0x9e6e 0x5ec 0x5ec 0x4bd 0x4bd 0x3ef9 0x9e02 0x608 0x608 0x4d3 0x4d3 0x40c6 0x9d95 0x624 0x624 0x4ea 0x4ea 0x4292 0x9d28 0x640 0x640 0x500 0x500 0x445f 0x9cbb 0x640 0x640 0x500 0x500 0x462c 0x9c55 0x656 0x656 0x512 0x512 0x47f8 0x9beb 0x661 0x661 0x51a 0x51a 0x49c5 0x9b78 0x64b 0x64b 0x509 0x509 0x4b91 0x9af6 0x60d 0x60d 0x4d7 0x4d7 0x4d5e 0x9a68 0x5b9 0x5b9 0x494 0x494 0x4f2b 0x99da 0x54a 0x54a 0x43b 0x43b 0x50f7 0x9960 0x508 0x508 0x406 0x406 0x52c4 0x98f5 0x4d0 0x4d0 0x3da 0x3da 0x5490 0x9898 0x4b0 0x4b0 0x3c0 0x3c0 0x565d 0x9846 0x4b0 0x4b0 0x3c0 0x3c0 0x582a 0x97fb 0x4af 0x4af 0x3bf 0x3bf 0x59f6 0x97af 0x493 0x493 0x3a9 0x3a9 0x5bc3 0x9772 0x48f 0x48f 0x3a6 0x3a6 0x5d90 0x9732 0x48f 0x48f 0x3a6 0x3a6 0x5f5c 0x96f3 0x48f 0x48f 0x3a6 0x3a6 0x6129 0x96b8 0x48f 0x48f 0x3a6 0x3a6 0x62f5 0x967e 0x48d 0x48d 0x3a4 0x3a4 0x64c2 0x9643 0x471 0x471 0x38e 0x38e 0x668f 0x9610 0x46d 0x46d 0x38a 0x38a 0x685b 0x95de 0x46d 0x46d 0x38a 0x38a 0x6a28 0x95af 0x47b 0x47b 0x396 0x396 0x6bf4 0x9586 0x497 0x497 0x3ac 0x3ac 0x6dc1 0x955b 0x4ad 0x4ad 0x3be 0x3be 0x6f8e 0x9529 0x491 0x491 0x3a7 0x3a7 0x715a 0x9506 0x4a8 0x4a8 0x3ba 0x3ba 0x7327 0x94de 0x4b0 0x4b0 0x3c0 0x3c0 0x74f3 0x94b9 0x4bf 0x4bf 0x3cc 0x3cc 0x76c0 0x9494 0x4d1 0x4d1 0x3da 0x3da 0x788d 0x946c 0x4d1 0x4d1 0x3da 0x3da 0x7a59 0x944a 0x4d1 0x4d1 0x3da 0x3da 0x7c26 0x9429 0x4d1 0x4d1 0x3da 0x3da 0x7df2 0x9407 0x4d1 0x4d1 0x3da 0x3da 0x7fbf 0x93e6 0x4d1 0x4d1 0x3da 0x3da 0x818c 0x93c1 0x4c7 0x4c7 0x3d2 0x3d2 0x8358 0x9397 0x4b0 0x4b0 0x3c0 0x3c0 0x8525 0x936d 0x4b0 0x4b0 0x3c0 0x3c0 0x86f1 0x9334 0x47b 0x47b 0x396 0x396 0x88be 0x9300 0x46d 0x46d 0x38a 0x38a 0x8a8b 0x92d3 0x46d 0x46d 0x38a 0x38a 0x8c57 0x92a9 0x463 0x463 0x382 0x382 0x8e24 0x927f 0x455 0x455 0x377 0x377 0x8ff0 0x9255 0x48d 0x48d 0x3a4 0x3a4 0x91bd 0x9213 0x473 0x473 0x38f 0x38f 0x938a 0x91d0 0x483 0x483 0x39c 0x39c 0x9556 0x9192 0x48f 0x48f 0x3a6 0x3a6 0x9723 0x9150 0x49a 0x49a 0x3ae 0x3ae 0x98f0 0x9102 0x4b0 0x4b0 0x3c0 0x3c0 0x9abc 0x90a6 0x4b0 0x4b0 0x3c0 0x3c0 0x9c89 0x907c 0x4b0 0x4b0 0x3c0 0x3c0 0x9e55 0x9066 0x4c7 0x4c7 0x3d2 0x3d2 0xa022 0x9056 0x4f4 0x4f4 0x3f6 0x3f6 0xa1ef 0x9041 0x520 0x520 0x41a 0x41a 0xa3bb 0x9026 0x548 0x548 0x43a 0x43a 0xa588 0x9001 0x59b 0x59b 0x47c 0x47c 0xa754 0x8f7b 0x5d3 0x5d3 0x4a9 0x4a9 0xa921 0x8e0d 0x5f3 0x5f3 0x4c2 0x4c2 0xaaee 0x8c01 0x645 0x645 0x504 0x504 0xacba 0x8949 0x6e8 0x6e8 0x586 0x586 0xae87 0x8577 0x825 0x825 0x684 0x684 0xb053 0x7f61 0xb5d 0xb5d 0x917 0x917 0xb220 0x6fae 0x813 0x813 0x676 0x676>;
			battery0_profile_t3_num = <0x64>;
			battery0_profile_t3_col = <0x06>;
			battery0_profile_t3 = <0x00 0xad5c 0xb72 0xb72 0x928 0x928 0x1cd 0xacd6 0xb75 0xb75 0x92a 0x92a 0x399 0xac64 0xb75 0xb75 0x92a 0x92a 0x566 0xabf7 0xb53 0xb53 0x90f 0x90f 0x732 0xab8e 0xb27 0xb27 0x8ec 0x8ec 0x8ff 0xab2b 0xb11 0xb11 0x8da 0x8da 0xacc 0xaacf 0xb11 0xb11 0x8da 0x8da 0xc98 0xaa6b 0xaf5 0xaf5 0x8c4 0x8c4 0xe65 0xaa06 0xad9 0xad9 0x8ae 0x8ae 0x1031 0xa99c 0xabd 0xabd 0x897 0x897 0x11fe 0xa92f 0xaa1 0xaa1 0x881 0x881 0x13cb 0xa8c0 0xa85 0xa85 0x86a 0x86a 0x1597 0xa84b 0xa67 0xa67 0x852 0x852 0x1764 0xa7d6 0xa30 0xa30 0x826 0x826 0x1930 0xa761 0xa10 0xa10 0x80d 0x80d 0x1afd 0xa6e6 0x9ce 0x9ce 0x7d8 0x7d8 0x1cca 0xa668 0x988 0x988 0x7a0 0x7a0 0x1e96 0xa5ed 0x960 0x960 0x780 0x780 0x2063 0xa577 0x95e 0x95e 0x77e 0x77e 0x2230 0xa4f9 0x942 0x942 0x768 0x768 0x23fc 0xa47c 0x926 0x926 0x752 0x752 0x25c9 0xa404 0x91d 0x91d 0x74a 0x74a 0x2795 0xa38a 0x91d 0x91d 0x74a 0x74a 0x2962 0xa30f 0x91d 0x91d 0x74a 0x74a 0x2b2f 0xa29a 0x91d 0x91d 0x74a 0x74a 0x2cfb 0xa225 0x91d 0x91d 0x74a 0x74a 0x2ec8 0xa1b0 0x937 0x937 0x75f 0x75f 0x3094 0xa13a 0x93f 0x93f 0x766 0x766 0x3261 0xa0c5 0x93f 0x93f 0x766 0x766 0x342e 0xa053 0x948 0x948 0x76d 0x76d 0x35fa 0x9fe6 0x960 0x960 0x780 0x780 0x37c7 0x9f79 0x960 0x960 0x780 0x780 0x3993 0x9f0c 0x97b 0x97b 0x796 0x796 0x3b60 0x9e9f 0x9ac 0x9ac 0x7bd 0x7bd 0x3d2d 0x9e32 0x9d4 0x9d4 0x7dd 0x7dd 0x3ef9 0x9dc2 0x9e5 0x9e5 0x7ea 0x7ea 0x40c6 0x9d4f 0x9ea 0x9ea 0x7ee 0x7ee 0x4292 0x9ce2 0xa06 0xa06 0x805 0x805 0x445f 0x9c6d 0x9eb 0x9eb 0x7ef 0x7ef 0x462c 0x9bf7 0x9cf 0x9cf 0x7d9 0x7d9 0x47f8 0x9b7d 0x992 0x992 0x7a8 0x7a8 0x49c5 0x9afc 0x933 0x933 0x75c 0x75c 0x4b91 0x9a76 0x8c9 0x8c9 0x707 0x707 0x4d5e 0x99f0 0x876 0x876 0x6c5 0x6c5 0x4f2b 0x9973 0x822 0x822 0x682 0x682 0x50f7 0x990a 0x7fc 0x7fc 0x663 0x663 0x52c4 0x98aa 0x7e0 0x7e0 0x64d 0x64d 0x5490 0x9852 0x7c4 0x7c4 0x636 0x636 0x565d 0x9800 0x7af 0x7af 0x626 0x626 0x582a 0x97b5 0x7b0 0x7b0 0x626 0x626 0x59f6 0x9772 0x7cc 0x7cc 0x63d 0x63d 0x5bc3 0x972f 0x7d0 0x7d0 0x640 0x640 0x5d90 0x96f2 0x7e2 0x7e2 0x64e 0x64e 0x5f5c 0x96b7 0x7f1 0x7f1 0x65a 0x65a 0x6129 0x967c 0x7f1 0x7f1 0x65a 0x65a 0x62f5 0x9642 0x7f1 0x7f1 0x65a 0x65a 0x64c2 0x9610 0x7f1 0x7f1 0x65a 0x65a 0x668f 0x95d7 0x7f1 0x7f1 0x65a 0x65a 0x685b 0x95a7 0x804 0x804 0x66a 0x66a 0x6a28 0x9579 0x813 0x813 0x676 0x676 0x6bf4 0x954a 0x81b 0x81b 0x67c 0x67c 0x6dc1 0x9520 0x837 0x837 0x692 0x692 0x6f8e 0x94f6 0x853 0x853 0x6a9 0x6a9 0x715a 0x94cc 0x855 0x855 0x6aa 0x6aa 0x7327 0x94a8 0x869 0x869 0x6ba 0x6ba 0x74f3 0x9482 0x868 0x868 0x6ba 0x6ba 0x76c0 0x945e 0x868 0x868 0x6ba 0x6ba 0x788d 0x9444 0x898 0x898 0x6e0 0x6e0 0x7a59 0x9422 0x898 0x898 0x6e0 0x6e0 0x7c26 0x9401 0x898 0x898 0x6e0 0x6e0 0x7df2 0x93df 0x898 0x898 0x6e0 0x6e0 0x7fbf 0x93c2 0x898 0x898 0x6e0 0x6e0 0x818c 0x93a9 0x8a2 0x8a2 0x6e8 0x6e8 0x8358 0x938f 0x8be 0x8be 0x6fe 0x6fe 0x8525 0x936d 0x8da 0x8da 0x715 0x715 0x86f1 0x9344 0x8db 0x8db 0x716 0x716 0x88be 0x931b 0x8f0 0x8f0 0x726 0x726 0x8a8b 0x92f1 0x90c 0x90c 0x73d 0x73d 0x8c57 0x92c4 0x927 0x927 0x752 0x752 0x8e24 0x9290 0x943 0x943 0x769 0x769 0x8ff0 0x9255 0x95f 0x95f 0x77f 0x77f 0x91bd 0x9213 0x9b2 0x9b2 0x7c2 0x7c2 0x938a 0x91c9 0x9f0 0x9f0 0x7f3 0x7f3 0x9556 0x9183 0xa38 0xa38 0x82d 0x82d 0x9723 0x9139 0xa8c 0xa8c 0x870 0x870 0x98f0 0x90e4 0xae5 0xae5 0x8b7 0x8b7 0x9abc 0x9088 0xb55 0xb55 0x911 0x911 0x9c89 0x905e 0xbc4 0xbc4 0x96a 0x96a 0x9e55 0x9042 0xc61 0xc61 0x9e7 0x9e7 0xa022 0x9023 0xd09 0xd09 0xa6e 0xa6e 0xa1ef 0x9002 0xddf 0xddf 0xb19 0xb19 0xa3bb 0x8fd9 0xf0a 0xf0a 0xc08 0xc08 0xa588 0x8f91 0x1075 0x1075 0xd2a 0xd2a 0xa754 0x8ebf 0x11fc 0x11fc 0xe63 0xe63 0xa921 0x8d06 0x13f8 0x13f8 0xffa 0xffa 0xaaee 0x8aa9 0x1719 0x1719 0x127a 0x127a 0xacba 0x8778 0x1c3c 0x1c3c 0x1696 0x1696 0xae87 0x82c5 0x266f 0x266f 0x1ebf 0x1ebf 0xb053 0x7a5f 0x2b6f 0x2b6f 0x22bf 0x22bf 0xb220 0x722e 0x1004 0x1004 0xcd0 0xcd0>;
			battery0_profile_t4_num = <0x64>;
			battery0_profile_t4_col = <0x06>;
			battery0_profile_t4 = <0x00 0xad34 0x514 0x514 0x410 0x410 0x1cd 0xacd8 0x514 0x514 0x410 0x410 0x399 0xac46 0x1216 0x1216 0xe78 0xe78 0x566 0xabb6 0x1837 0x1837 0x135f 0x135f 0x732 0xab37 0x180b 0x180b 0x133c 0x133c 0x8ff 0xaac2 0x17dc 0x17dc 0x1316 0x1316 0xacc 0xaa4d 0x176e 0x176e 0x12be 0x12be 0xc98 0xa9d7 0x171a 0x171a 0x127b 0x127b 0xe65 0xa962 0x16c6 0x16c6 0x1238 0x1238 0x1031 0xa8f2 0x163d 0x163d 0x11ca 0x11ca 0x11fe 0xa882 0x1595 0x1595 0x1144 0x1144 0x13cb 0xa80e 0x1511 0x1511 0x10da 0x10da 0x1597 0xa7a1 0x14f0 0x14f0 0x10c0 0x10c0 0x1764 0xa72c 0x1480 0x1480 0x1066 0x1066 0x1930 0xa6b7 0x1429 0x1429 0x1021 0x1021 0x1afd 0xa641 0x13e8 0x13e8 0xfed 0xfed 0x1cca 0xa5cc 0x13cb 0x13cb 0xfd6 0xfd6 0x1e96 0xa557 0x13cb 0x13cb 0xfd6 0xfd6 0x2063 0xa4e1 0x13c6 0x13c6 0xfd2 0xfd2 0x2230 0xa463 0x138e 0x138e 0xfa5 0xfa5 0x23fc 0xa3ed 0x1388 0x1388 0xfa0 0xfa0 0x25c9 0xa378 0x1374 0x1374 0xf90 0xf90 0x2795 0xa303 0x1359 0x1359 0xf7a 0xf7a 0x2962 0xa28d 0x1345 0x1345 0xf6a 0xf6a 0x2b2f 0xa219 0x1345 0x1345 0xf6a 0xf6a 0x2cfb 0xa1ac 0x1345 0x1345 0xf6a 0xf6a 0x2ec8 0xa138 0x1312 0x1312 0xf42 0xf42 0x3094 0xa0c2 0x12ee 0x12ee 0xf25 0xf25 0x3261 0xa052 0x12e1 0x12e1 0xf1a 0xf1a 0x342e 0x9fe8 0x12f4 0x12f4 0xf2a 0xf2a 0x35fa 0x9f82 0x1328 0x1328 0xf53 0xf53 0x37c7 0x9f15 0x1344 0x1344 0xf6a 0xf6a 0x3993 0x9ea0 0x1360 0x1360 0xf80 0xf80 0x3b60 0x9e25 0x1367 0x1367 0xf86 0xf86 0x3d2d 0x9da2 0x1347 0x1347 0xf6c 0xf6c 0x3ef9 0x9d1f 0x130f 0x130f 0xf3f 0xf3f 0x40c6 0x9ca2 0x12dc 0x12dc 0xf16 0xf16 0x4292 0x9c24 0x12c0 0x12c0 0xf00 0xf00 0x445f 0x9ba6 0x126e 0x126e 0xebe 0xebe 0x462c 0x9b29 0x121a 0x121a 0xe7b 0xe7b 0x47f8 0x9ab0 0x11d7 0x11d7 0xe46 0xe46 0x49c5 0x9a3e 0x11b5 0x11b5 0xe2a 0xe2a 0x4b91 0x99d0 0x11a4 0x11a4 0xe1d 0xe1d 0x4d5e 0x995b 0x1151 0x1151 0xdda 0xdda 0x4f2b 0x98f6 0x1135 0x1135 0xdc4 0xdc4 0x50f7 0x9899 0x1119 0x1119 0xdae 0xdae 0x52c4 0x983c 0x10fd 0x10fd 0xd97 0xd97 0x5490 0x97e8 0x10f9 0x10f9 0xd94 0xd94 0x565d 0x979c 0x1108 0x1108 0xda0 0xda0 0x582a 0x9751 0x10ef 0x10ef 0xd8c 0xd8c 0x59f6 0x970e 0x110a 0x110a 0xda2 0xda2 0x5bc3 0x96cb 0x110f 0x110f 0xda6 0xda6 0x5d90 0x968e 0x1121 0x1121 0xdb4 0xdb4 0x5f5c 0x9653 0x113d 0x113d 0xdca 0xdca 0x6129 0x9618 0x1151 0x1151 0xdda 0xdda 0x62f5 0x95de 0x1153 0x1153 0xddc 0xddc 0x64c2 0x95ac 0x116f 0x116f 0xdf2 0xdf2 0x668f 0x957a 0x118b 0x118b 0xe09 0xe09 0x685b 0x9548 0x11a7 0x11a7 0xe1f 0xe1f 0x6a28 0x951e 0x11d1 0x11d1 0xe41 0xe41 0x6bf4 0x94f7 0x1200 0x1200 0xe66 0xe66 0x6dc1 0x94c7 0x121c 0x121c 0xe7d 0xe7d 0x6f8e 0x94a5 0x1238 0x1238 0xe93 0xe93 0x715a 0x947c 0x1254 0x1254 0xeaa 0xeaa 0x7327 0x945e 0x1284 0x1284 0xed0 0xed0 0x74f3 0x9441 0x12ad 0x12ad 0xef1 0xef1 0x76c0 0x9425 0x12db 0x12db 0xf16 0xf16 0x788d 0x9413 0x132b 0x132b 0xf56 0xf56 0x7a59 0x93fa 0x1363 0x1363 0xf82 0xf82 0x7c26 0x93e8 0x13cf 0x13cf 0xfd9 0xfd9 0x7df2 0x93d1 0x1416 0x1416 0x1012 0x1012 0x7fbf 0x93b8 0x146c 0x146c 0x1056 0x1056 0x818c 0x939f 0x14dc 0x14dc 0x10b0 0x10b0 0x8358 0x9385 0x154b 0x154b 0x1109 0x1109 0x8525 0x9363 0x15bb 0x15bb 0x1162 0x1162 0x86f1 0x933a 0x160e 0x160e 0x11a5 0x11a5 0x88be 0x9311 0x16a1 0x16a1 0x121a 0x121a 0x8a8b 0x92e2 0x1738 0x1738 0x1293 0x1293 0x8c57 0x92b0 0x17d8 0x17d8 0x1313 0x1313 0x8e24 0x927b 0x1897 0x1897 0x13ac 0x13ac 0x8ff0 0x9238 0x193e 0x193e 0x1432 0x1432 0x91bd 0x91ed 0x1a1c 0x1a1c 0x14e3 0x14e3 0x938a 0x91a1 0x1afc 0x1afc 0x1596 0x1596 0x9556 0x9156 0x1bfc 0x1bfc 0x1663 0x1663 0x9723 0x9104 0x1d13 0x1d13 0x1742 0x1742 0x98f0 0x90a9 0x1e35 0x1e35 0x182a 0x182a 0x9abc 0x9056 0x1f84 0x1f84 0x1936 0x1936 0x9c89 0x9024 0x210b 0x210b 0x1a6f 0x1a6f 0x9e55 0x8ff8 0x22a9 0x22a9 0x1bba 0x1bba 0xa022 0x8fce 0x24a2 0x24a2 0x1d4e 0x1d4e 0xa1ef 0x8fa1 0x270b 0x270b 0x1f3c 0x1f3c 0xa3bb 0x8f69 0x2a04 0x2a04 0x219d 0x219d 0xa588 0x8f18 0x2dde 0x2dde 0x24b2 0x24b2 0xa754 0x8e36 0x32aa 0x32aa 0x2888 0x2888 0xa921 0x8c81 0x39a9 0x39a9 0x2e21 0x2e21 0xaaee 0x8a1c 0x466e 0x466e 0x3858 0x3858 0xacba 0x8714 0x536a 0x536a 0x42bb 0x42bb 0xae87 0x82fd 0x480e 0x480e 0x39a5 0x39a5 0xb053 0x808e 0x4074 0x4074 0x3390 0x3390 0xb220 0x808e 0x4074 0x4074 0x3390 0x3390>;
			g_PMIC_MIN_VOL_row = <0x04>;
			g_PMIC_MIN_VOL_col = <0x0a>;
			g_PMIC_MIN_VOL = <0x82dc 0x82dc 0x82dc 0x82dc 0x80e8 0x80e8 0x80e8 0x80e8 0x82dc 0x82dc 0x82dc 0x82dc 0x7dc8 0x7dc8 0x7dc8 0x7dc8 0x7918 0x7918 0x7918 0x7918 0x7b0c 0x7b0c 0x7b0c 0x7b0c 0x7918 0x7918 0x7918 0x7918 0x7918 0x7918 0x7918 0x7918 0x7918 0x7918 0x7918 0x7918 0x7918 0x7918 0x7918 0x79e0>;
			g_PON_SYS_IBOOT_row = <0x04>;
			g_PON_SYS_IBOOT_col = <0x0a>;
			g_PON_SYS_IBOOT = <0x1388 0x1388 0x1388 0x1388 0x1388 0x1388 0x1388 0x1388 0x1388 0x1388 0x1388 0x1388 0x1388 0x1388 0x1388 0x1388 0x1388 0x1388 0x1388 0x1388 0x1388 0x1388 0x1388 0x1388 0x1388 0x1388 0x1388 0x1388 0x1388 0x1388 0x1388 0x1388 0x1388 0x1388 0x1388 0x1388 0x1388 0x1388 0x1388 0x1388>;
			g_QMAX_SYS_VOL_row = <0x04>;
			g_QMAX_SYS_VOL_col = <0x0a>;
			g_QMAX_SYS_VOL = <0x8886 0x8886 0x8886 0x8886 0x8886 0x8886 0x8886 0x8886 0x87be 0x85ca 0x85ca 0x85ca 0x87be 0x85ca 0x85ca 0x85ca 0x85ca 0x85ca 0x85ca 0x85ca 0x7ef4 0x7ef4 0x7ef4 0x7ef4 0x8020 0x8020 0x8020 0x8020 0x8020 0x8020 0x8020 0x8020 0x8020 0x8020 0x8020 0x8020 0x8020 0x8020 0x8020 0x8020>;
			g_FG_PSEUDO100_row = <0x04>;
			g_FG_PSEUDO100_col = <0x0a>;
			g_FG_PSEUDO100 = <0x62 0x64 0x64 0x64 0x60 0x64 0x64 0x64 0x5c 0x64 0x64 0x64 0x57 0x64 0x64 0x64 0x57 0x64 0x64 0x64 0x64 0x64 0x64 0x64 0x64 0x64 0x64 0x64 0x64 0x64 0x64 0x64 0x64 0x64 0x64 0x64 0x64 0x64 0x64 0x64>;
		};
	};

	fragment@83 {
		target = <0xffffffff>;

		__overlay__ {

			eint0default {
				phandle = <0x2f>;
			};

			dischg_enable {
				phandle = <0x30>;

				pins_cmd_dat {
					pinmux = <0xa900>;
					slew-rate = <0x01>;
					output-high;
				};
			};

			dischg_disable {
				phandle = <0x31>;

				pins_cmd_dat {
					pinmux = <0xa900>;
					slew-rate = <0x01>;
					output-low;
				};
			};
		};
	};

	fragment@84 {
		target = <0xffffffff>;

		__overlay__ {
			pinctrl-names = "uart0_rx_gpio\0uart0_tx_gpio";
			pinctrl-0 = <0x34>;
			pinctrl-1 = <0x35>;
			status = "okay";
		};
	};

	fragment@85 {
		target = <0xffffffff>;

		__overlay__ {

			uart0_rx_gpio@gpio179 {
				phandle = <0x34>;

				pins_cmd_dat {
					pinmux = <0xb300>;
					input-enable;
					slew-rate = <0x00>;
					bias-disable;
				};
			};

			uart0_tx_gpio@gpio178 {
				phandle = <0x35>;

				pins_cmd_dat {
					pinmux = <0xb200>;
					input-enable;
					slew-rate = <0x00>;
					bias-disable;
				};
			};
		};
	};

	fragment@86 {
		target = <0xffffffff>;

		__overlay__ {

			optiga {
				compatible = "oplus-optiga";
				status = "ok";
				pinctrl-names = "optiga_active";
				pinctrl-0 = <0x36>;
				data-gpio = <0xffffffff 0x8a 0x00>;
				cpu-id = <0x07>;
				key-id = <0x01>;
				vusb-supply = <0xffffffff>;
			};
		};
	};

	fragment@87 {
		target = <0xffffffff>;

		__overlay__ {

			optiga_active {
				phandle = <0x36>;

				pins_cmd_dat {
					pinmux = <0x8a00>;
					bias-pull-up;
				};
			};
		};
	};

	fragment@88 {
		target = <0xffffffff>;

		__overlay__ {
			clock-frequency = <0x61a80>;
			pinctrl-names = "default\0ts_int_active\0ts_reset_active\0ts_int_suspend\0ts_reset_suspend\0ts_i2c_mode";
			pinctrl-0 = <0x37>;
			pinctrl-1 = <0x38>;
			pinctrl-2 = <0x39>;
			pinctrl-3 = <0x3a>;
			pinctrl-4 = <0x3b>;
			pinctrl-5 = <0x3c>;

			gt9886@5d {
				compatible = "goodix,gt9886";
				reg = <0x5d>;
				status = "ok";
				interrupt-parent = <0xffffffff>;
				interrupts = <0x0e 0x02 0x0e 0x00>;
				vtouch-supply = <0xffffffff>;
				goodix,irq-gpio = <0xffffffff 0x0e 0x00>;
				goodix,reset-gpio = <0xffffffff 0x0f 0x00>;
				goodix,irq-flags = <0x02>;
				goodix,panel-max-id = <0x0a>;
				goodix,panel-max-x = <0x438>;
				goodix,panel-max-y = <0x8e8>;
				goodix,panel-max-w = <0x100>;
				goodix,panel-max-p = <0x100>;
				goodix,input-max-x = <0x438>;
				goodix,input-max-y = <0x8e8>;
				goodix,panel-key-map = <0x9e 0xac 0xd9>;
				goodix,power-on-delay-us = <0x2710>;
				goodix,power-off-delay-us = <0x1388>;
				goodix,firmware-version = "6877v01";
				goodix,config-version = "6877v01";
				goodix,pen-enable;
				goodix,key-of-pen = <0x14b 0x14c>;
				tpd-filter-enable = <0x00>;
				tpd-filter-pixel-density = <0xa1>;
				tpd-filter-custom-prameters = <0x00 0x00 0x00 0x00 0x00 0x00 0x00 0x00 0x00 0x00 0x00 0x00>;
				tpd-filter-custom-speed = <0x00 0x00 0x00>;
			};
		};
	};

	fragment@89 {
		target = <0xffffffff>;

		__overlay__ {
			status = "okay";
			#address-cells = <0x01>;
			#size-cells = <0x00>;
			pinctrl-names = "default\0gt9896s_int_active\0gt9896s_reset_active\0gt9896s_int_suspend\0gt9896s_reset_suspend\0gt9896s_spi_mode";
			pinctrl-0 = <0x3d>;
			pinctrl-1 = <0x3e>;
			pinctrl-2 = <0x3f>;
			pinctrl-3 = <0x40>;
			pinctrl-4 = <0x41>;
			pinctrl-5 = <0x42>;

			gt9896s@0 {
				compatible = "goodix,gt9896s";
				reg = <0x00>;
				spi-max-frequency = <0xf4240>;
				goodix,avdd-name = "vtouch";
				vtouch-supply = <0xffffffff>;
				goodix,irq-gpio = <0xffffffff 0x0e 0x00>;
				goodix,reset-gpio = <0xffffffff 0x0f 0x00>;
				goodix,irq-flags = <0x02>;
				goodix,panel-max-id = <0x0a>;
				goodix,panel-max-x = <0x438>;
				goodix,panel-max-y = <0x8fc>;
				goodix,panel-max-w = <0x100>;
				goodix,panel-max-p = <0x100>;
				goodix,input-max-x = <0x438>;
				goodix,input-max-y = <0x8fc>;
				goodix,panel-key-map = <0x9e 0xac 0xd9>;
				goodix,power-on-delay-us = <0x2710>;
				goodix,power-off-delay-us = <0x1388>;
				goodix,firmware-version = "6877v01";
				goodix,config-version = "6877v01";
				goodix,pen-enable;
				tpd-filter-enable = <0x00>;
				tpd-filter-pixel-density = <0xa1>;
				tpd-filter-custom-prameters = <0x00 0x00 0x00 0x00 0x00 0x00 0x00 0x00 0x00 0x00 0x00 0x00>;
				tpd-filter-custom-speed = <0x00 0x00 0x00>;
			};
		};
	};

	fragment@90 {
		target = <0xffffffff>;

		__overlay__ {

			eintdefault {
				phandle = <0x37>;
			};

			pins_default {
				phandle = <0x3d>;
			};

			int_active {
				phandle = <0x38>;

				pins_cmd_dat {
					pinmux = <0xe00>;
					input-enable;
				};
			};

			reset_active {
				phandle = <0x39>;

				pins_cmd_dat {
					pinmux = <0xf00>;
					output-high;
				};
			};

			int_suspend {
				phandle = <0x3a>;

				pins_cmd_dat {
					pinmux = <0xe00>;
					output-low;
				};
			};

			reset_suspend {
				phandle = <0x3b>;

				pins_cmd_dat {
					pinmux = <0xf00>;
					output-low;
				};
			};

			i2cmode_default {
				phandle = <0x3c>;

				pins_cmd_dat {
					pinmux = <0x4001 0x4101>;
				};
			};

			int_high {
				phandle = <0xad>;

				pins_cmd_dat {
					pinmux = <0xe00>;
					output-high;
				};
			};

			int1_active {
				phandle = <0x3e>;

				pins_cmd_dat {
					pinmux = <0xe00>;
					input-enable;
				};
			};

			reset1_active {
				phandle = <0x3f>;

				pins_cmd_dat {
					pinmux = <0xf00>;
					output-high;
				};
			};

			int1_suspend {
				phandle = <0x40>;

				pins_cmd_dat {
					pinmux = <0xe00>;
					output-low;
				};
			};

			reset1_suspend {
				phandle = <0x41>;

				pins_cmd_dat {
					pinmux = <0xf00>;
					output-low;
				};
			};

			spimode_default {
				phandle = <0x42>;

				pins_cmd_dat {
					pinmux = <0xc02 0xd02 0x4002 0x4102>;
					drive-strength = <0x02>;
				};
			};
		};
	};

	fragment@91 {
		target = <0xffffffff>;

		__overlay__ {

			cam0@0 {
				phandle = <0x44>;

				pins_cmd_dat {
					pinmux = <0x9d00>;
					slew-rate = <0x01>;
					output-low;
				};
			};

			cam0@1 {
				phandle = <0x45>;

				pins_cmd_dat {
					pinmux = <0x9d00>;
					slew-rate = <0x01>;
					output-high;
				};
			};

			cam1@0 {
				phandle = <0x46>;

				pins_cmd_dat {
					pinmux = <0x9b00>;
					slew-rate = <0x01>;
					output-low;
				};
			};

			cam1@1 {
				phandle = <0x47>;

				pins_cmd_dat {
					pinmux = <0x9b00>;
					slew-rate = <0x01>;
					output-high;
				};
			};

			cam2@0 {
				phandle = <0x48>;

				pins_cmd_dat {
					pinmux = <0x9f00>;
					slew-rate = <0x01>;
					output-low;
				};
			};

			cam2@1 {
				phandle = <0x49>;

				pins_cmd_dat {
					pinmux = <0x9f00>;
					slew-rate = <0x01>;
					output-high;
				};
			};

			cam3@0 {
				phandle = <0x4a>;

				pins_cmd_dat {
					pinmux = <0x9a00>;
					slew-rate = <0x01>;
					output-low;
				};
			};

			cam3@1 {
				phandle = <0x4b>;

				pins_cmd_dat {
					pinmux = <0x9a00>;
					slew-rate = <0x01>;
					output-high;
				};
			};

			cam0@vcam0 {
				phandle = <0x4c>;

				pins_cmd_dat {
					pinmux = <0x6d00>;
					slew-rate = <0x01>;
					output-low;
				};
			};

			cam0@vcam1 {
				phandle = <0x4d>;

				pins_cmd_dat {
					pinmux = <0x6d00>;
					slew-rate = <0x01>;
					output-high;
				};
			};

			cam0@vcam2 {
				phandle = <0x4e>;

				pins_cmd_dat {
					pinmux = <0x6e00>;
					slew-rate = <0x01>;
					output-low;
				};
			};

			cam0@vcam3 {
				phandle = <0x4f>;

				pins_cmd_dat {
					pinmux = <0x6e00>;
					slew-rate = <0x01>;
					output-high;
				};
			};

			cam0@vcam4 {
				phandle = <0x50>;

				pins_cmd_dat {
					pinmux = <0xa800>;
					slew-rate = <0x01>;
					output-low;
				};
			};

			cam0@vcam5 {
				phandle = <0x51>;

				pins_cmd_dat {
					pinmux = <0xa800>;
					slew-rate = <0x01>;
					output-high;
				};
			};

			cam1@vcam0 {
				phandle = <0x52>;

				pins_cmd_dat {
					pinmux = <0x6c00>;
					slew-rate = <0x01>;
					output-low;
				};
			};

			cam1@vcam1 {
				phandle = <0x53>;

				pins_cmd_dat {
					pinmux = <0x6c00>;
					slew-rate = <0x01>;
					output-high;
				};
			};

			cam1@vcam2 {
				phandle = <0x54>;

				pins_cmd_dat {
					pinmux = <0x1d00>;
					slew-rate = <0x01>;
					output-low;
				};
			};

			cam1@vcam3 {
				phandle = <0x55>;

				pins_cmd_dat {
					pinmux = <0x1d00>;
					slew-rate = <0x01>;
					output-high;
				};
			};

			cam1@vcam4 {
				phandle = <0x56>;

				pins_cmd_dat {
					pinmux = <0x2300>;
					input-enable;
					slew-rate = <0x00>;
					bias-disable;
				};
			};

			cam1@vcam5 {
				phandle = <0x57>;

				pins_cmd_dat {
					pinmux = <0x2300>;
					slew-rate = <0x01>;
					output-low;
				};
			};

			cam2@vcam0 {
				phandle = <0x58>;

				pins_cmd_dat {
					pinmux = <0x6c00>;
					slew-rate = <0x01>;
					output-low;
				};
			};

			cam2@vcam1 {
				phandle = <0x59>;

				pins_cmd_dat {
					pinmux = <0x6c00>;
					slew-rate = <0x01>;
					output-high;
				};
			};

			cam2@vcam2 {
				phandle = <0x5a>;

				pins_cmd_dat {
					pinmux = <0x1d00>;
					slew-rate = <0x01>;
					output-low;
				};
			};

			cam2@vcam3 {
				phandle = <0x5b>;

				pins_cmd_dat {
					pinmux = <0x1d00>;
					slew-rate = <0x01>;
					output-high;
				};
			};

			cam2@vcam4 {
				phandle = <0x5c>;

				pins_cmd_dat {
					pinmux = <0x7500>;
					input-enable;
					slew-rate = <0x00>;
					bias-disable;
				};
			};

			cam2@vcam5 {
				phandle = <0x5d>;

				pins_cmd_dat {
					pinmux = <0x7500>;
					slew-rate = <0x01>;
					output-low;
				};
			};

			cam3@vcam0 {
				phandle = <0x5e>;

				pins_cmd_dat {
					pinmux = <0x6e00>;
					slew-rate = <0x01>;
					output-low;
				};
			};

			cam3@vcam1 {
				phandle = <0x5f>;

				pins_cmd_dat {
					pinmux = <0x6e00>;
					slew-rate = <0x01>;
					output-high;
				};
			};

			camera_pins_cam0_mclk_off {
				phandle = <0x60>;

				pins_cmd_dat {
					pinmux = <0x9500>;
					drive-strength = <0x01>;
				};
			};

			camera_pins_cam0_mclk_2ma {
				phandle = <0x61>;

				pins_cmd_dat {
					pinmux = <0x9501>;
					drive-strength = <0x00>;
				};
			};

			camera_pins_cam0_mclk_4ma {
				phandle = <0x62>;

				pins_cmd_dat {
					pinmux = <0x9501>;
					drive-strength = <0x01>;
				};
			};

			camera_pins_cam0_mclk_6ma {
				phandle = <0x63>;

				pins_cmd_dat {
					pinmux = <0x9501>;
					drive-strength = <0x02>;
				};
			};

			camera_pins_cam0_mclk_8ma {
				phandle = <0x64>;

				pins_cmd_dat {
					pinmux = <0x9501>;
					drive-strength = <0x03>;
				};
			};

			camera_pins_cam1_mclk_off {
				phandle = <0x65>;

				pins_cmd_dat {
					pinmux = <0x9900>;
					drive-strength = <0x01>;
				};
			};

			camera_pins_cam1_mclk_2ma {
				phandle = <0x66>;

				pins_cmd_dat {
					pinmux = <0x9901>;
					drive-strength = <0x00>;
				};
			};

			camera_pins_cam1_mclk_4ma {
				phandle = <0x67>;

				pins_cmd_dat {
					pinmux = <0x9901>;
					drive-strength = <0x01>;
				};
			};

			camera_pins_cam1_mclk_6ma {
				phandle = <0x68>;

				pins_cmd_dat {
					pinmux = <0x9901>;
					drive-strength = <0x02>;
				};
			};

			camera_pins_cam1_mclk_8ma {
				phandle = <0x69>;

				pins_cmd_dat {
					pinmux = <0x9901>;
					drive-strength = <0x03>;
				};
			};

			camera_pins_cam2_mclk_off {
				phandle = <0x6a>;

				pins_cmd_dat {
					pinmux = <0x9600>;
					drive-strength = <0x01>;
				};
			};

			camera_pins_cam2_mclk_2ma {
				phandle = <0x6b>;

				pins_cmd_dat {
					pinmux = <0x9601>;
					drive-strength = <0x00>;
				};
			};

			camera_pins_cam2_mclk_4ma {
				phandle = <0x6c>;

				pins_cmd_dat {
					pinmux = <0x9601>;
					drive-strength = <0x01>;
				};
			};

			camera_pins_cam2_mclk_6ma {
				phandle = <0x6d>;

				pins_cmd_dat {
					pinmux = <0x9601>;
					drive-strength = <0x02>;
				};
			};

			camera_pins_cam2_mclk_8ma {
				phandle = <0x6e>;

				pins_cmd_dat {
					pinmux = <0x9601>;
					drive-strength = <0x03>;
				};
			};

			camera_pins_cam3_mclk_off {
				phandle = <0x6f>;

				pins_cmd_dat {
					pinmux = <0x9700>;
					drive-strength = <0x01>;
				};
			};

			camera_pins_cam3_mclk_2ma {
				phandle = <0x70>;

				pins_cmd_dat {
					pinmux = <0x9701>;
					drive-strength = <0x00>;
				};
			};

			camera_pins_cam3_mclk_4ma {
				phandle = <0x71>;

				pins_cmd_dat {
					pinmux = <0x9701>;
					drive-strength = <0x01>;
				};
			};

			camera_pins_cam3_mclk_6ma {
				phandle = <0x72>;

				pins_cmd_dat {
					pinmux = <0x9701>;
					drive-strength = <0x02>;
				};
			};

			camera_pins_cam3_mclk_8ma {
				phandle = <0x73>;

				pins_cmd_dat {
					pinmux = <0x9701>;
					drive-strength = <0x03>;
				};
			};

			camera_pins_cam0_vcamois_1@gpio9 {
				phandle = <0x74>;

				pins_cmd_dat {
					pinmux = <0x900>;
					slew-rate = <0x01>;
					output-low;
				};
			};

			camera_pins_cam0_vcamois_0@gpio9 {
				phandle = <0x75>;

				pins_cmd_dat {
					pinmux = <0x900>;
					slew-rate = <0x01>;
					output-high;
				};
			};

			camdefault {
				phandle = <0x43>;
			};
		};
	};

	fragment@92 {
		target = <0xffffffff>;

		__overlay__ {
			pinctrl-names = "default\0cam0_rst0\0cam0_rst1\0cam1_rst0\0cam1_rst1\0cam2_rst0\0cam2_rst1\0cam3_rst0\0cam3_rst1\0cam0_ldo_vcamd_0\0cam0_ldo_vcamd_1\0cam0_ldo_vcama_0\0cam0_ldo_vcama_1\0cam0_ldo_vcama1_0\0cam0_ldo_vcama1_1\0cam1_ldo_vcamd_0\0cam1_ldo_vcamd_1\0cam1_ldo_vcama_0\0cam1_ldo_vcama_1\0cam1_ldo_vcamd1_0\0cam1_ldo_vcamd1_1\0cam2_ldo_vcamd_0\0cam2_ldo_vcamd_1\0cam2_ldo_vcama_0\0cam2_ldo_vcama_1\0cam2_ldo_vcamd1_0\0cam2_ldo_vcamd1_1\0cam3_ldo_vcama_0\0cam3_ldo_vcama_1\0cam0_mclk_off\0cam0_mclk_2mA\0cam0_mclk_4mA\0cam0_mclk_6mA\0cam0_mclk_8mA\0cam1_mclk_off\0cam1_mclk_2mA\0cam1_mclk_4mA\0cam1_mclk_6mA\0cam1_mclk_8mA\0cam2_mclk_off\0cam2_mclk_2mA\0cam2_mclk_4mA\0cam2_mclk_6mA\0cam2_mclk_8mA\0cam3_mclk_off\0cam3_mclk_2mA\0cam3_mclk_4mA\0cam3_mclk_6mA\0cam3_mclk_8mA\0cam0_ldo_vcamois_0\0cam0_ldo_vcamois_1";
			pinctrl-0 = <0x43>;
			pinctrl-1 = <0x44>;
			pinctrl-2 = <0x45>;
			pinctrl-3 = <0x46>;
			pinctrl-4 = <0x47>;
			pinctrl-5 = <0x48>;
			pinctrl-6 = <0x49>;
			pinctrl-7 = <0x4a>;
			pinctrl-8 = <0x4b>;
			pinctrl-9 = <0x4c>;
			pinctrl-10 = <0x4d>;
			pinctrl-11 = <0x4e>;
			pinctrl-12 = <0x4f>;
			pinctrl-13 = <0x50>;
			pinctrl-14 = <0x51>;
			pinctrl-15 = <0x52>;
			pinctrl-16 = <0x53>;
			pinctrl-17 = <0x54>;
			pinctrl-18 = <0x55>;
			pinctrl-19 = <0x56>;
			pinctrl-20 = <0x57>;
			pinctrl-21 = <0x58>;
			pinctrl-22 = <0x59>;
			pinctrl-23 = <0x5a>;
			pinctrl-24 = <0x5b>;
			pinctrl-25 = <0x5c>;
			pinctrl-26 = <0x5d>;
			pinctrl-27 = <0x5e>;
			pinctrl-28 = <0x5f>;
			pinctrl-29 = <0x60>;
			pinctrl-30 = <0x61>;
			pinctrl-31 = <0x62>;
			pinctrl-32 = <0x63>;
			pinctrl-33 = <0x64>;
			pinctrl-34 = <0x65>;
			pinctrl-35 = <0x66>;
			pinctrl-36 = <0x67>;
			pinctrl-37 = <0x68>;
			pinctrl-38 = <0x69>;
			pinctrl-39 = <0x6a>;
			pinctrl-40 = <0x6b>;
			pinctrl-41 = <0x6c>;
			pinctrl-42 = <0x6d>;
			pinctrl-43 = <0x6e>;
			pinctrl-44 = <0x6f>;
			pinctrl-45 = <0x70>;
			pinctrl-46 = <0x71>;
			pinctrl-47 = <0x72>;
			pinctrl-48 = <0x73>;
			pinctrl-49 = <0x74>;
			pinctrl-50 = <0x75>;
			cam0_vcamio-supply = <0xffffffff>;
			cam0_vcamd1-supply = <0xffffffff>;
			vcamaf-supply = <0xffffffff>;
			cam1_vcamio-supply = <0xffffffff>;
			cam2_vcamio-supply = <0xffffffff>;
			cam3_vcamio-supply = <0xffffffff>;
			cam0_enable_sensor = "imx766_mossmipi_raw s5kgm1st_mossamipi_raw";
			cam1_enable_sensor = "imx471_mossmipi_raw";
			cam2_enable_sensor = "imx355_mossmipi_raw";
			cam3_enable_sensor = "gc02m1_mossmipi_raw gc02m1_mossamipi_raw";
			status = "okay";
		};
	};

	fragment@93 {
		target = <0xffffffff>;

		__overlay__ {

			camera_eeprom0@50 {
				compatible = "mediatek,camera_eeprom";
				reg = <0x50>;
				status = "okay";
				phandle = <0xae>;
			};

			camera_main_af@18 {
				compatible = "mediatek,camera_main_af";
				reg = <0x18>;
				status = "okay";
				phandle = <0xaf>;
			};

			camera_eeprom3@52 {
				compatible = "mediatek,camera_eeprom";
				reg = <0x52>;
				status = "okay";
				phandle = <0xb0>;
			};
		};
	};

	fragment@94 {
		target = <0xffffffff>;

		__overlay__ {

			camera_eeprom2@51 {
				compatible = "mediatek,camera_eeprom";
				reg = <0x51>;
				status = "okay";
				phandle = <0xb1>;
			};

			camera_eeprom1@54 {
				compatible = "mediatek,camera_eeprom";
				reg = <0x54>;
				status = "okay";
				phandle = <0xb2>;
			};
		};
	};

	__symbols__ {
		irtx_gpio_led_default = "/fragment@2/__overlay__/irtx_gpio_led_def@gpio139";
		irtx_gpio_led_set = "/fragment@2/__overlay__/irtx_gpio_led_set@gpio139";
		ctp_pins_default_t = "/fragment@7/__overlay__/eintdefault";
		ctp_ts_int_active_t = "/fragment@7/__overlay__/int_active";
		ctp_ts_reset_active_t = "/fragment@7/__overlay__/reset_active";
		ctp_ts_int_suspend_t = "/fragment@7/__overlay__/int_suspend";
		ctp_ts_reset_suspend_t = "/fragment@7/__overlay__/reset_suspend";
		mtkfb_pins_lcm_led_en1 = "/fragment@8/__overlay__/lcm_led_en1_gpio";
		mtkfb_pins_lcm_led_en0 = "/fragment@8/__overlay__/lcm_led_en0_gpio";
		mtkfb_pins_lcd_bias_enp1 = "/fragment@8/__overlay__/lcd_bias_enp1_gpio";
		mtkfb_pins_lcd_bias_enp0 = "/fragment@8/__overlay__/lcd_bias_enp0_gpio";
		mtkfb_pins_lcd_bias_enn1 = "/fragment@8/__overlay__/lcd_bias_enn1_gpio";
		mtkfb_pins_lcd_bias_enn0 = "/fragment@8/__overlay__/lcd_bias_enn0_gpio";
		mtkfb_pins_lcm_rst_out1_gpio = "/fragment@8/__overlay__/lcm_rst_out1_gpio";
		mtkfb_pins_lcm_rst_out0_gpio = "/fragment@8/__overlay__/lcm_rst_out0_gpio";
		mtkfb_pins_lcm_dsi_te = "/fragment@8/__overlay__/lcm_dsi_te";
		panel_in2 = "/fragment@11/__overlay__/panel2@0/port/endpoint";
		dsi_out = "/fragment@11/__overlay__/ports/port/endpoint";
		gate_ic = "/fragment@12/__overlay__/gate_ic@11";
		mt_pmic_vio28_ldo_reg = "/fragment@14/__overlay__/ldo_vio28";
		led0 = "/fragment@15/__overlay__/led@0";
		led1 = "/fragment@15/__overlay__/led@1";
		led2 = "/fragment@15/__overlay__/led@2";
		led3 = "/fragment@15/__overlay__/led@3";
		led4 = "/fragment@15/__overlay__/led@4";
		led5 = "/fragment@15/__overlay__/led@5";
		led6 = "/fragment@15/__overlay__/led@6";
		vibrator0 = "/fragment@15/__overlay__/vibrator@0";
		sensor_fb = "/fragment@15/__overlay__/sensor_fb";
		gsensor_1 = "/fragment@15/__overlay__/gsensor_1";
		gsensor_2 = "/fragment@15/__overlay__/gsensor_2";
		sensor_3 = "/fragment@15/__overlay__/gsensor_3";
		sensor_4 = "/fragment@15/__overlay__/gsensor_4";
		msensor_1 = "/fragment@15/__overlay__/msensor_1";
		msensor_2 = "/fragment@15/__overlay__/msensor_2";
		sar_1 = "/fragment@15/__overlay__/sar_1";
		proximity_1 = "/fragment@15/__overlay__/proximity_1";
		light_1 = "/fragment@15/__overlay__/light_1";
		proximity_2 = "/fragment@15/__overlay__/proximity_2";
		light_2 = "/fragment@15/__overlay__/light_2";
		rear_cct_1 = "/fragment@15/__overlay__/rear_cct_1";
		rear_cct_2 = "/fragment@15/__overlay__/rear_cct_2";
		pick_up = "/fragment@15/__overlay__/pick_up";
		lux_aod = "/fragment@15/__overlay__/lux_aod";
		alsps_arch = "/fragment@15/__overlay__/alsps_arch";
		cali_arch = "/fragment@15/__overlay__/cali_arch";
		oplus_project = "/fragment@15/__overlay__/oplus_project";
		oplus_devinfo = "/fragment@15/__overlay__/oplus_devinfo";
		mediatek_mtp_interface = "/fragment@15/__overlay__/mediatek_mtp_interface";
		mediatek_phy_tuning = "/fragment@15/__overlay__/mediatek_phy_tuning";
		tboard_thermistor5 = "/fragment@15/__overlay__/thermal-sensor5";
		kpd_volume_down = "/fragment@15/__overlay__/kpd_volume_down";
		nfc_chipset = "/fragment@15/__overlay__/nfc_chipset";
		st21nfc = "/fragment@16/__overlay__/st21nfc@08";
		volume_down_gpio_eint = "/fragment@19/__overlay__/volume_down@0";
		hw_pins_default = "/fragment@20/__overlay__/default@hw_sub_id";
		aboard_pin_gpio0_sleep = "/fragment@20/__overlay__/sleep@id0";
		aboard_pin_gpio0_active = "/fragment@20/__overlay__/active@id0";
		aboard_pin_gpio0_idle = "/fragment@20/__overlay__/idle@id0";
		aboard_pin_gpio1_sleep = "/fragment@20/__overlay__/sleep@id1";
		aboard_pin_gpio1_active = "/fragment@20/__overlay__/active@id1";
		aboard_pin_gpio1_idle = "/fragment@20/__overlay__/idle@id1";
		aw_irq_gpio_default = "/fragment@22/__overlay__/aw_irq_gpio_default";
		gps_pins_default = "/fragment@23/__overlay__/gps_default";
		gps_l1_lna_pins_ol = "/fragment@23/__overlay__/gps_l1_lna@0";
		gps_l1_lna_pins_dsp_ctrl = "/fragment@23/__overlay__/gps_l1_lna@1";
		gps_l1_lna_pins_oh = "/fragment@23/__overlay__/gps_l1_lna@2";
		ps_enable = "/fragment@28/__overlay__/ps_enable";
		ps_disable = "/fragment@28/__overlay__/ps_disable";
		sel_up = "/fragment@28/__overlay__/sel_up";
		sel_down = "/fragment@28/__overlay__/sel_down";
		speaker_amp1 = "/fragment@30/__overlay__/speaker_amp1@34";
		speaker_amp2 = "/fragment@30/__overlay__/speaker_amp2@35";
		fsa_hs_det = "/fragment@32/__overlay__/fsa_hs_det";
		fsa4480 = "/fragment@33/__overlay__/fsa4480@42";
		tfa98xx_haptic = "/fragment@34/__overlay__/tfa98xx_haptic@34";
		oplus_fp = "/fragment@36/__overlay__/fingerprint@0";
		gpio_id0_default = "/fragment@38/__overlay__/gpio_id0_default";
		jiiov_fp_reset_output_low = "/fragment@40/__overlay__/jiiov_fp_reset_output_low";
		jiiov_fp_gpio_clk = "/fragment@40/__overlay__/jiiov_fp_gpio_clk";
		jiiov_fp_gpio_mosi = "/fragment@40/__overlay__/jiiov_fp_gpio_mosi";
		jiiov_fp_gpio_miso = "/fragment@40/__overlay__/jiiov_fp_gpio_miso";
		jiiov_fp_gpio_cs = "/fragment@40/__overlay__/jiiov_fp_gpio_cs";
		jiiov_fp_irq_active = "/fragment@40/__overlay__/jiiov_fp_irq_active";
		camera_main_mtk = "/fragment@46/__overlay__/camera_main@1a";
		camera_main_af_mtk = "/fragment@46/__overlay__/camera_main_af@18";
		camera_sub_two_mtk = "/fragment@46/__overlay__/camera_sub_two@10";
		camera_main_two_mtk = "/fragment@48/__overlay__/camera_main_two@11";
		camera_sub_mtk = "/fragment@48/__overlay__/camera_sub@1a";
		subpmic_mtk = "/fragment@49/__overlay__/subpmic@34";
		usb_type_c_mtk = "/fragment@49/__overlay__/usb_type_c@4e";
		subpmic_pmic_mtk = "/fragment@49/__overlay__/subpmic_pmic@1a";
		subpmic_ldo_mtk = "/fragment@49/__overlay__/subpmic_ldo@64";
		i2c_lcd_bias_mtk = "/fragment@50/__overlay__/i2c_lcd_bias@11";
		nfc_mtk = "/fragment@52/__overlay__/nfc@28";
		i2c7_i2c_state = "/fragment@74/__overlay__/i2c7_sda_i2c_state";
		i2c7_output_low_state = "/fragment@74/__overlay__/i2c7_sda_output_low_state";
		charging_switch1_active = "/fragment@79/__overlay__/charging_switch1_active";
		charging_switch1_sleep = "/fragment@79/__overlay__/charging_switch1_sleep";
		charging_inter_active = "/fragment@79/__overlay__/charging_inter_active";
		charging_inter_sleep = "/fragment@79/__overlay__/charging_inter_sleep";
		charger_pins_eint_output0 = "/fragment@79/__overlay__/charger_gpio_as_output_low";
		charger_pins_eint_output1 = "/fragment@79/__overlay__/charger_gpio_as_output_high";
		charger_pins_default = "/fragment@83/__overlay__/eint0default";
		dischg_enable = "/fragment@83/__overlay__/dischg_enable";
		dischg_disable = "/fragment@83/__overlay__/dischg_disable";
		uart0_rx_gpio_input = "/fragment@85/__overlay__/uart0_rx_gpio@gpio179";
		uart0_tx_gpio_input = "/fragment@85/__overlay__/uart0_tx_gpio@gpio178";
		optiga_active = "/fragment@87/__overlay__/optiga_active";
		ctp_pins_default = "/fragment@90/__overlay__/eintdefault";
		ctp_gt9896s_pins_default = "/fragment@90/__overlay__/pins_default";
		ctp_ts_int_active = "/fragment@90/__overlay__/int_active";
		ctp_ts_reset_active = "/fragment@90/__overlay__/reset_active";
		ctp_ts_int_suspend = "/fragment@90/__overlay__/int_suspend";
		ctp_ts_reset_suspend = "/fragment@90/__overlay__/reset_suspend";
		ctp_ts_i2c_mode = "/fragment@90/__overlay__/i2cmode_default";
		ctp_ts_int_as_gpio = "/fragment@90/__overlay__/int_high";
		ctp_gt9896s_int_active = "/fragment@90/__overlay__/int1_active";
		ctp_gt9896s_reset_active = "/fragment@90/__overlay__/reset1_active";
		ctp_gt9896s_int_suspend = "/fragment@90/__overlay__/int1_suspend";
		ctp_gt9896s_reset_suspend = "/fragment@90/__overlay__/reset1_suspend";
		ctp_gt9896s_spi_mode = "/fragment@90/__overlay__/spimode_default";
		camera_pins_cam0_rst_0 = "/fragment@91/__overlay__/cam0@0";
		camera_pins_cam0_rst_1 = "/fragment@91/__overlay__/cam0@1";
		camera_pins_cam1_rst_0 = "/fragment@91/__overlay__/cam1@0";
		camera_pins_cam1_rst_1 = "/fragment@91/__overlay__/cam1@1";
		camera_pins_cam2_rst_0 = "/fragment@91/__overlay__/cam2@0";
		camera_pins_cam2_rst_1 = "/fragment@91/__overlay__/cam2@1";
		camera_pins_cam3_rst_0 = "/fragment@91/__overlay__/cam3@0";
		camera_pins_cam3_rst_1 = "/fragment@91/__overlay__/cam3@1";
		camera_pins_cam0_vcamd_0 = "/fragment@91/__overlay__/cam0@vcam0";
		camera_pins_cam0_vcamd_1 = "/fragment@91/__overlay__/cam0@vcam1";
		camera_pins_cam0_vcama_0 = "/fragment@91/__overlay__/cam0@vcam2";
		camera_pins_cam0_vcama_1 = "/fragment@91/__overlay__/cam0@vcam3";
		camera_pins_cam0_vcama1_0 = "/fragment@91/__overlay__/cam0@vcam4";
		camera_pins_cam0_vcama1_1 = "/fragment@91/__overlay__/cam0@vcam5";
		camera_pins_cam1_vcamd_0 = "/fragment@91/__overlay__/cam1@vcam0";
		camera_pins_cam1_vcamd_1 = "/fragment@91/__overlay__/cam1@vcam1";
		camera_pins_cam1_vcama_0 = "/fragment@91/__overlay__/cam1@vcam2";
		camera_pins_cam1_vcama_1 = "/fragment@91/__overlay__/cam1@vcam3";
		camera_pins_cam1_vcamd1_0 = "/fragment@91/__overlay__/cam1@vcam4";
		camera_pins_cam1_vcamd1_1 = "/fragment@91/__overlay__/cam1@vcam5";
		camera_pins_cam2_vcamd_0 = "/fragment@91/__overlay__/cam2@vcam0";
		camera_pins_cam2_vcamd_1 = "/fragment@91/__overlay__/cam2@vcam1";
		camera_pins_cam2_vcama_0 = "/fragment@91/__overlay__/cam2@vcam2";
		camera_pins_cam2_vcama_1 = "/fragment@91/__overlay__/cam2@vcam3";
		camera_pins_cam2_vcamd1_0 = "/fragment@91/__overlay__/cam2@vcam4";
		camera_pins_cam2_vcamd1_1 = "/fragment@91/__overlay__/cam2@vcam5";
		camera_pins_cam3_vcama_0 = "/fragment@91/__overlay__/cam3@vcam0";
		camera_pins_cam3_vcama_1 = "/fragment@91/__overlay__/cam3@vcam1";
		camera_pins_cam0_mclk_off = "/fragment@91/__overlay__/camera_pins_cam0_mclk_off";
		camera_pins_cam0_mclk_2ma = "/fragment@91/__overlay__/camera_pins_cam0_mclk_2ma";
		camera_pins_cam0_mclk_4ma = "/fragment@91/__overlay__/camera_pins_cam0_mclk_4ma";
		camera_pins_cam0_mclk_6ma = "/fragment@91/__overlay__/camera_pins_cam0_mclk_6ma";
		camera_pins_cam0_mclk_8ma = "/fragment@91/__overlay__/camera_pins_cam0_mclk_8ma";
		camera_pins_cam1_mclk_off = "/fragment@91/__overlay__/camera_pins_cam1_mclk_off";
		camera_pins_cam1_mclk_2ma = "/fragment@91/__overlay__/camera_pins_cam1_mclk_2ma";
		camera_pins_cam1_mclk_4ma = "/fragment@91/__overlay__/camera_pins_cam1_mclk_4ma";
		camera_pins_cam1_mclk_6ma = "/fragment@91/__overlay__/camera_pins_cam1_mclk_6ma";
		camera_pins_cam1_mclk_8ma = "/fragment@91/__overlay__/camera_pins_cam1_mclk_8ma";
		camera_pins_cam2_mclk_off = "/fragment@91/__overlay__/camera_pins_cam2_mclk_off";
		camera_pins_cam2_mclk_2ma = "/fragment@91/__overlay__/camera_pins_cam2_mclk_2ma";
		camera_pins_cam2_mclk_4ma = "/fragment@91/__overlay__/camera_pins_cam2_mclk_4ma";
		camera_pins_cam2_mclk_6ma = "/fragment@91/__overlay__/camera_pins_cam2_mclk_6ma";
		camera_pins_cam2_mclk_8ma = "/fragment@91/__overlay__/camera_pins_cam2_mclk_8ma";
		camera_pins_cam3_mclk_off = "/fragment@91/__overlay__/camera_pins_cam3_mclk_off";
		camera_pins_cam3_mclk_2ma = "/fragment@91/__overlay__/camera_pins_cam3_mclk_2ma";
		camera_pins_cam3_mclk_4ma = "/fragment@91/__overlay__/camera_pins_cam3_mclk_4ma";
		camera_pins_cam3_mclk_6ma = "/fragment@91/__overlay__/camera_pins_cam3_mclk_6ma";
		camera_pins_cam3_mclk_8ma = "/fragment@91/__overlay__/camera_pins_cam3_mclk_8ma";
		camera_pins_cam0_vcamois_0 = "/fragment@91/__overlay__/camera_pins_cam0_vcamois_1@gpio9";
		camera_pins_cam0_vcamois_1 = "/fragment@91/__overlay__/camera_pins_cam0_vcamois_0@gpio9";
		camera_pins_default = "/fragment@91/__overlay__/camdefault";
		mtk_camera_eeprom0 = "/fragment@93/__overlay__/camera_eeprom0@50";
		camera_main_af = "/fragment@93/__overlay__/camera_main_af@18";
		mtk_camera_eeprom3 = "/fragment@93/__overlay__/camera_eeprom3@52";
		mtk_camera_eeprom2 = "/fragment@94/__overlay__/camera_eeprom2@51";
		mtk_camera_eeprom1 = "/fragment@94/__overlay__/camera_eeprom1@54";
	};

	__fixups__ {
		chosen = "/fragment@0:target:0";
		irtx_pwm = "/fragment@1:target:0";
		pio = "/fragment@2:target:0\0/fragment@3/__overlay__:mt6360,intr_gpio:0\0/fragment@5/__overlay__:mt6360pd,intr_gpio:0\0/fragment@6/__overlay__/Focaltech2169E@38:interrupt-parent:0\0/fragment@6/__overlay__/Focaltech2169E@38:irq-gpio:0\0/fragment@6/__overlay__/Focaltech2169E@38:reset-gpio:0\0/fragment@7:target:0\0/fragment@8:target:0\0/fragment@11/__overlay__/panel2@0:reset-gpios:0\0/fragment@11/__overlay__/panel2@0:bias-gpios:0\0/fragment@15/__overlay__/oplus_sim_detect:Hw,sim_det:0\0/fragment@15/__overlay__/oplus_devinfo/main-sub:aboard-gpio0:0\0/fragment@15/__overlay__/oplus_devinfo/main-sub:aboard-gpio1:0\0/fragment@15/__overlay__/kpd_volume_down:interrupt-parent:0\0/fragment@16/__overlay__/st21nfc@08:interrupt-parent:0\0/fragment@16/__overlay__/st21nfc@08:gpio-irq-std:0\0/fragment@16/__overlay__/st21nfc@08:gpio-rst-std:0\0/fragment@16/__overlay__/st21nfc@08:gpio-clkreq-std:0\0/fragment@18/__overlay__:keypad,volume-down:0\0/fragment@19:target:0\0/fragment@20:target:0\0/fragment@21/__overlay__/aw8697_haptic@5A:reset-gpio:0\0/fragment@21/__overlay__/aw8697_haptic@5A:irq-gpio:0\0/fragment@22:target:0\0/fragment@23:target:0\0/fragment@28:target:0\0/fragment@30/__overlay__/speaker_amp1@34:reset-gpio:0\0/fragment@30/__overlay__/speaker_amp2@35:reset-gpio:0\0/fragment@32:target:0\0/fragment@33/__overlay__/fsa4480@42:fsa4480,hs-det-gpio:0\0/fragment@34/__overlay__/tfa98xx_haptic@34:reset-gpio:0\0/fragment@37/__overlay__:oplus,fp_gpio_0:0\0/fragment@38:target:0\0/fragment@39/__overlay__:anc,gpio_irq:0\0/fragment@39/__overlay__:anc,gpio_rst:0\0/fragment@40:target:0\0/fragment@56/__overlay__:GPIO_FDD_BAND_SUPPORT_DETECT_1ST_PIN:0\0/fragment@56/__overlay__:GPIO_FDD_BAND_SUPPORT_DETECT_2ND_PIN:0\0/fragment@56/__overlay__:GPIO_FDD_BAND_SUPPORT_DETECT_3RD_PIN:0\0/fragment@56/__overlay__:GPIO_FDD_BAND_SUPPORT_DETECT_4TH_PIN:0\0/fragment@56/__overlay__:GPIO_RF_PWREN_RST_PIN:0\0/fragment@56/__overlay__:GPIO_SIM2_SIO:0\0/fragment@56/__overlay__:GPIO_SIM2_SCLK:0\0/fragment@56/__overlay__:GPIO_SIM2_SRST:0\0/fragment@56/__overlay__:GPIO_SIM1_SRST:0\0/fragment@56/__overlay__:GPIO_SIM1_SCLK:0\0/fragment@56/__overlay__:GPIO_SIM1_SIO:0\0/fragment@56/__overlay__:GPIO_SIM1_HOT_PLUG:0\0/fragment@56/__overlay__:GPIO_SIM2_HOT_PLUG:0\0/fragment@58/__overlay__:interrupt-parent:0\0/fragment@59/__overlay__:interrupt-parent:0\0/fragment@60/__overlay__:interrupt-parent:0\0/fragment@61/__overlay__:interrupt-parent:0\0/fragment@62/__overlay__:interrupt-parent:0\0/fragment@62/__overlay__:deb-gpios:0\0/fragment@63/__overlay__:interrupt-parent:0\0/fragment@74:target:0\0/fragment@75/__overlay__/sc8547-charger@6F:qcom,irq_gpio:0\0/fragment@75/__overlay__/sc8547-charger@6F:interrupt-parent:0\0/fragment@75/__overlay__/sc8547-charger@6F:qcom,charging_switch1-gpio:0\0/fragment@79:target:0\0/fragment@80/__overlay__:qcom,chargerid_switch-gpio:0\0/fragment@80/__overlay__:qcom,dischg-gpio:0\0/fragment@83:target:0\0/fragment@85:target:0\0/fragment@86/__overlay__/optiga:data-gpio:0\0/fragment@87:target:0\0/fragment@88/__overlay__/gt9886@5d:interrupt-parent:0\0/fragment@88/__overlay__/gt9886@5d:goodix,irq-gpio:0\0/fragment@88/__overlay__/gt9886@5d:goodix,reset-gpio:0\0/fragment@89/__overlay__/gt9896s@0:goodix,irq-gpio:0\0/fragment@89/__overlay__/gt9896s@0:goodix,reset-gpio:0\0/fragment@90:target:0\0/fragment@91:target:0";
		mt6360_pmu = "/fragment@3:target:0\0/fragment@70:target:0\0/fragment@70/__overlay__/chg:interrupt-parent:0\0/fragment@72:target:0";
		mt6360_pmic = "/fragment@4:target:0";
		mt6360_typec = "/fragment@5:target:0";
		i2c0 = "/fragment@6:target:0\0/fragment@44:target:0\0/fragment@88:target:0";
		mt_pmic_vtp_ldo_reg = "/fragment@6/__overlay__/Focaltech2169E@38:vdd_2v8-supply:0\0/fragment@66:target:0\0/fragment@68/__overlay__:vtouch-supply:0\0/fragment@88/__overlay__/gt9886@5d:vtouch-supply:0\0/fragment@89/__overlay__/gt9896s@0:vtouch-supply:0";
		mtkfb = "/fragment@9:target:0";
		dispsys_config = "/fragment@10:target:0";
		dsi0 = "/fragment@11:target:0";
		mt_pmic_vmc_ldo_reg = "/fragment@11/__overlay__/panel2@0:ldo3-supply:0";
		i2c6 = "/fragment@12:target:0\0/fragment@30:target:0\0/fragment@33:target:0\0/fragment@50:target:0\0/fragment@71:target:0";
		disp_leds = "/fragment@13:target:0";
		mt6359regulator = "/fragment@14:target:0";
		odm = "/fragment@15:target:0\0/fragment@86:target:0";
		auxadc = "/fragment@15/__overlay__/thermal-sensor5:io-channels:0\0/fragment@41:target:0\0/fragment@42/__overlay__:io-channels:0\0/fragment@80/__overlay__:io-channels:0\0/fragment@80/__overlay__:io-channels:8\0/fragment@80/__overlay__:io-channels:16\0/fragment@80/__overlay__:io-channels:24";
		i2c8 = "/fragment@16:target:0\0/fragment@52:target:0";
		swtp = "/fragment@17:target:0\0/fragment@62:target:0";
		keypad = "/fragment@18:target:0\0/fragment@69:target:0";
		i2c9 = "/fragment@21:target:0\0/fragment@34:target:0\0/fragment@53:target:0";
		gps = "/fragment@24:target:0";
		accdet = "/fragment@25:target:0";
		ps5169 = "/fragment@26:target:0\0/fragment@77:target:0";
		fusb340 = "/fragment@27:target:0\0/fragment@78:target:0";
		sound = "/fragment@29:target:0";
		audio_extend = "/fragment@31:target:0";
		apuart1 = "/fragment@35:target:0";
		spi5 = "/fragment@36:target:0";
		mt_pmic_vmch_ldo_reg = "/fragment@36/__overlay__/fingerprint@0:dvdd-supply:0\0/fragment@39/__overlay__:ldo-supply:0";
		oplus_fp_common = "/fragment@37:target:0";
		jiiov_fp = "/fragment@39:target:0";
		md_auxadc = "/fragment@42:target:0";
		pmic_clock_buffer_ctrl = "/fragment@43:target:0";
		i2c1 = "/fragment@45:target:0";
		i2c2 = "/fragment@46:target:0\0/fragment@93:target:0";
		i2c3 = "/fragment@47:target:0";
		i2c4 = "/fragment@48:target:0\0/fragment@94:target:0";
		i2c5 = "/fragment@49:target:0";
		i2c7 = "/fragment@51:target:0\0/fragment@73:target:0\0/fragment@75:target:0";
		i2c10 = "/fragment@54:target:0";
		i2c11 = "/fragment@55:target:0";
		gpio_usage_mapping = "/fragment@56:target:0";
		gpio = "/fragment@57:target:0";
		mrdump_ext_rst = "/fragment@58:target:0";
		subpmic_pmu_eint = "/fragment@59:target:0";
		irq_nfc = "/fragment@60:target:0";
		touch_panel = "/fragment@61:target:0";
		dsi_te = "/fragment@63:target:0";
		md1_sim1_hot_plug_eint = "/fragment@64:target:0";
		mt_pmic_vcamio_ldo_reg = "/fragment@65:target:0\0/fragment@67/__overlay__:vcamio-supply:0\0/fragment@67/__overlay__:vcamio_sub-supply:0\0/fragment@67/__overlay__:vcamio_main2-supply:0\0/fragment@67/__overlay__:vcamio_sub2-supply:0\0/fragment@92/__overlay__:cam0_vcamio-supply:0\0/fragment@92/__overlay__:cam1_vcamio-supply:0\0/fragment@92/__overlay__:cam2_vcamio-supply:0\0/fragment@92/__overlay__:cam3_vcamio-supply:0";
		kd_camera_hw1 = "/fragment@67:target:0\0/fragment@92:target:0";
		touch = "/fragment@68:target:0";
		adc = "/fragment@70/__overlay__/chg:io-channels:0\0/fragment@70/__overlay__/chg:io-channels:8\0/fragment@70/__overlay__/chg:io-channels:16\0/fragment@70/__overlay__/chg:io-channels:24\0/fragment@70/__overlay__/chg:io-channels:32\0/fragment@70/__overlay__/chg:io-channels:40\0/fragment@70/__overlay__/chg:io-channels:48\0/fragment@70/__overlay__/chg:io-channels:56";
		typec_mux_switch = "/fragment@76:target:0";
		charger = "/fragment@80:target:0";
		lk_charger = "/fragment@81:target:0";
		bat_gm30 = "/fragment@82:target:0";
		apuart0 = "/fragment@84:target:0";
		mt_pmic_vusb_ldo_reg = "/fragment@86/__overlay__/optiga:vusb-supply:0";
		spi4 = "/fragment@89:target:0";
		mt6315_3_vbuck3 = "/fragment@92/__overlay__:cam0_vcamd1-supply:0";
		mt_pmic_vfp_ldo_reg = "/fragment@92/__overlay__:vcamaf-supply:0";
	};

	__local_fixups__ {

		fragment@1 {

			__overlay__ {
				pinctrl-0 = <0x00>;
				pinctrl-1 = <0x00>;
			};
		};

		fragment@9 {

			__overlay__ {
				pinctrl-0 = <0x00>;
				pinctrl-1 = <0x00>;
				pinctrl-2 = <0x00>;
				pinctrl-3 = <0x00>;
				pinctrl-4 = <0x00>;
				pinctrl-5 = <0x00>;
				pinctrl-6 = <0x00>;
				pinctrl-7 = <0x00>;
				pinctrl-8 = <0x00>;
			};
		};

		fragment@10 {

			__overlay__ {
				pinctrl-0 = <0x00>;
				pinctrl-1 = <0x00>;
				pinctrl-2 = <0x00>;
			};
		};

		fragment@11 {

			__overlay__ {

				panel2@0 {

					port {

						endpoint {
							remote-endpoint = <0x00>;
						};
					};
				};

				ports {

					port {

						endpoint {
							remote-endpoint = <0x00>;
						};
					};
				};
			};
		};

		fragment@15 {

			__overlay__ {

				oplus_devinfo {
					pinctrl-0 = <0x00>;
					pinctrl-1 = <0x00>;
					pinctrl-2 = <0x00>;
					pinctrl-3 = <0x00>;
					pinctrl-4 = <0x00>;
					pinctrl-5 = <0x00>;
					pinctrl-6 = <0x00>;
				};
			};
		};

		fragment@18 {

			__overlay__ {
				pinctrl-0 = <0x00>;
			};
		};

		fragment@21 {

			__overlay__ {

				aw8697_haptic@5A {
					pinctrl-0 = <0x00>;
				};
			};
		};

		fragment@24 {

			__overlay__ {
				pinctrl-0 = <0x00>;
				pinctrl-1 = <0x00>;
				pinctrl-2 = <0x00>;
				pinctrl-3 = <0x00>;
			};
		};

		fragment@26 {

			__overlay__ {
				pinctrl-0 = <0x00>;
				pinctrl-1 = <0x00>;
			};
		};

		fragment@27 {

			__overlay__ {
				pinctrl-0 = <0x00>;
				pinctrl-1 = <0x00>;
			};
		};

		fragment@29 {

			__overlay__ {

				mediatek,speaker-codec {
					sound-dai = <0x00 0x04>;
				};
			};
		};

		fragment@33 {

			__overlay__ {

				fsa4480@42 {
					pinctrl-0 = <0x00>;
				};
			};
		};

		fragment@37 {

			__overlay__ {
				pinctrl-0 = <0x00>;
			};
		};

		fragment@39 {

			__overlay__ {
				pinctrl-0 = <0x00>;
				pinctrl-1 = <0x00 0x04 0x08 0x0c 0x10>;
				pinctrl-2 = <0x00>;
			};
		};

		fragment@73 {

			__overlay__ {
				pinctrl-0 = <0x00>;
				pinctrl-1 = <0x00>;
			};
		};

		fragment@75 {

			__overlay__ {

				sc8547-charger@6F {
					pinctrl-0 = <0x00>;
					pinctrl-1 = <0x00>;
					pinctrl-2 = <0x00>;
					pinctrl-3 = <0x00>;
				};
			};
		};

		fragment@80 {

			__overlay__ {
				pinctrl-0 = <0x00>;
				pinctrl-1 = <0x00>;
				pinctrl-2 = <0x00>;
				pinctrl-3 = <0x00>;
				pinctrl-4 = <0x00>;
			};
		};

		fragment@84 {

			__overlay__ {
				pinctrl-0 = <0x00>;
				pinctrl-1 = <0x00>;
			};
		};

		fragment@86 {

			__overlay__ {

				optiga {
					pinctrl-0 = <0x00>;
				};
			};
		};

		fragment@88 {

			__overlay__ {
				pinctrl-0 = <0x00>;
				pinctrl-1 = <0x00>;
				pinctrl-2 = <0x00>;
				pinctrl-3 = <0x00>;
				pinctrl-4 = <0x00>;
				pinctrl-5 = <0x00>;
			};
		};

		fragment@89 {

			__overlay__ {
				pinctrl-0 = <0x00>;
				pinctrl-1 = <0x00>;
				pinctrl-2 = <0x00>;
				pinctrl-3 = <0x00>;
				pinctrl-4 = <0x00>;
				pinctrl-5 = <0x00>;
			};
		};

		fragment@92 {

			__overlay__ {
				pinctrl-0 = <0x00>;
				pinctrl-1 = <0x00>;
				pinctrl-2 = <0x00>;
				pinctrl-3 = <0x00>;
				pinctrl-4 = <0x00>;
				pinctrl-5 = <0x00>;
				pinctrl-6 = <0x00>;
				pinctrl-7 = <0x00>;
				pinctrl-8 = <0x00>;
				pinctrl-9 = <0x00>;
				pinctrl-10 = <0x00>;
				pinctrl-11 = <0x00>;
				pinctrl-12 = <0x00>;
				pinctrl-13 = <0x00>;
				pinctrl-14 = <0x00>;
				pinctrl-15 = <0x00>;
				pinctrl-16 = <0x00>;
				pinctrl-17 = <0x00>;
				pinctrl-18 = <0x00>;
				pinctrl-19 = <0x00>;
				pinctrl-20 = <0x00>;
				pinctrl-21 = <0x00>;
				pinctrl-22 = <0x00>;
				pinctrl-23 = <0x00>;
				pinctrl-24 = <0x00>;
				pinctrl-25 = <0x00>;
				pinctrl-26 = <0x00>;
				pinctrl-27 = <0x00>;
				pinctrl-28 = <0x00>;
				pinctrl-29 = <0x00>;
				pinctrl-30 = <0x00>;
				pinctrl-31 = <0x00>;
				pinctrl-32 = <0x00>;
				pinctrl-33 = <0x00>;
				pinctrl-34 = <0x00>;
				pinctrl-35 = <0x00>;
				pinctrl-36 = <0x00>;
				pinctrl-37 = <0x00>;
				pinctrl-38 = <0x00>;
				pinctrl-39 = <0x00>;
				pinctrl-40 = <0x00>;
				pinctrl-41 = <0x00>;
				pinctrl-42 = <0x00>;
				pinctrl-43 = <0x00>;
				pinctrl-44 = <0x00>;
				pinctrl-45 = <0x00>;
				pinctrl-46 = <0x00>;
				pinctrl-47 = <0x00>;
				pinctrl-48 = <0x00>;
				pinctrl-49 = <0x00>;
				pinctrl-50 = <0x00>;
			};
		};
	};
};
