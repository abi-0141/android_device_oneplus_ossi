/dts-v1/;

/ {

	fragment@0 {
		target = <0xffffffff>;

		__overlay__ {
			atag,videolfb-fb_base_l = "~`P";
			atag,videolfb-fb_base_h = <0x00>;
			atag,videolfb-islcmfound = <0x01>;
			atag,videolfb-islcm_inited = <0x00>;
			atag,videolfb-fps = <0x1770>;
			atag,videolfb-vramSize = <0x1be0000>;
			atag,videolfb-lcmname = "td4330_fhdp_dsi_cmd_auo_rt4831_drv";
		};
	};

	fragment@1 {
		target = <0xffffffff>;

		__overlay__ {
			pinctrl-names = "irtx_gpio_led_default\0irtx_gpio_led_set";
			pinctrl-0 = <0x01>;
			pinctrl-1 = <0x02>;
			status = "okay";
		};
	};

	fragment@2 {
		target = <0xffffffff>;

		__overlay__ {

			irtx_gpio_led_def@gpio139 {
				phandle = <0x01>;

				pins_cmd_dat {
					pinmux = <0x8b00>;
					slew-rate = <0x01>;
					bias-disable;
					output-low;
					input-schmitt-enable = <0x00>;
				};
			};

			irtx_gpio_led_set@gpio139 {
				phandle = <0x02>;

				pins_cmd_dat {
					pinmux = <0x8b02>;
					slew-rate = <0x01>;
					output-high;
				};
			};
		};
	};

	fragment@3 {
		target = <0xffffffff>;

		__overlay__ {
			mt6360,intr_gpio_num = <0x04>;
			mt6360,intr_gpio = <0xffffffff 0x04 0x00>;
		};
	};

	fragment@4 {
		target = <0xffffffff>;

		__overlay__ {
			pwr_off_seq = <0x4000002>;
		};
	};

	fragment@5 {
		target = <0xffffffff>;

		__overlay__ {
			mt6360pd,intr_gpio_num = <0x05>;
			mt6360pd,intr_gpio = <0xffffffff 0x05 0x00>;
		};
	};

	fragment@6 {
		target = <0xffffffff>;

		__overlay__ {
			status = "okay";

			Focaltech20181@38 {
				compatible = "focaltech,fts";
				reg = <0x38>;
				chip-name = "FT3518";
				interrupt-parent = <0xffffffff>;
				interrupts = <0x0e 0x2002>;
				vdd_2v8-supply = <0xffffffff>;
				vdd_2v8_volt = <0x2dc6c0>;
				irq-gpio = <0xffffffff 0x0e 0x2002>;
				reset-gpio = <0xffffffff 0x0f 0x01>;
				vid_len = <0x02>;
				tp_type = <0x08>;
				platform_support_project = <0x212a1>;
				platform_support_project_dir = <0x212a1>;
				platform_support_project_commandline = "default_commandline";
				touchpanel,max-num-support = <0x0a>;
				touchpanel,tx-rx-num = <0x10 0x22>;
				touchpanel,panel-coords = <0x10e0 0x2580>;
				touchpanel,display-coords = <0x438 0x960>;
				touchpanel,touchmajor-limit = <0x00 0xd8>;
				touchpanel,report-rate = <0x78 0xb4>;
				touchpanel,smooth-level = <0xff 0x02 0x0f 0x19 0x2d 0x3c>;
				touchpanel,smooth-level-charging = <0xff 0x0f 0x14 0x19 0x2d 0x3c>;
				touchpanel,sensitive-level = <0xff 0x14 0x10 0x0d 0x0a 0x05>;
				touchpanel,single-optimized-time = <0x08>;
				black_gesture_support;
				fw_edge_limit_support;
				pressure_report_support;
				charger_pump_support;
				game_switch_support;
				smart_gesture_support;
				fw_update_app_support;
				fingerprint_underscreen_support;
				headset_pump_support;
				health_monitor_v2_support;
				high_resolution_support;
				lcd_tp_refresh_support;
				touchpanel,button-type = <0x04>;
				touchpanel.button-TRx = <0x00 0x00>;
			};
		};
	};

	fragment@7 {
		target = <0xffffffff>;

		__overlay__ {

			eintdefault {
				phandle = <0x6b>;
			};

			int_active {
				phandle = <0x6c>;

				pins_cmd_dat {
					pinmux = <0xe00>;
					slew-rate = <0x00>;
					bias-pull-down = <0x00>;
				};
			};

			reset_active {
				phandle = <0x6d>;

				pins_cmd_dat {
					pinmux = <0xf00>;
					slew-rate = <0x01>;
					output-high;
				};
			};

			int_suspend {
				phandle = <0x6e>;

				pins_cmd_dat {
					pinmux = <0xe00>;
					slew-rate = <0x01>;
					output-low;
				};
			};

			reset_suspend {
				phandle = <0x6f>;

				pins_cmd_dat {
					pinmux = <0xf00>;
					slew-rate = <0x00>;
					output-low;
				};
			};
		};
	};

	fragment@8 {
		target = <0xffffffff>;

		__overlay__ {

			lcm_led_en1_gpio {
				phandle = <0x03>;

				pins_cmd_dat {
					pinmux = <0x6b00>;
					slew-rate = <0x01>;
					output-high;
				};
			};

			lcm_led_en0_gpio {
				phandle = <0x04>;

				pins_cmd_dat {
					pinmux = <0x6b00>;
					slew-rate = <0x01>;
					output-low;
				};
			};

			lcd_bias_enp1_gpio {
				phandle = <0x05>;

				pins_cmd_dat {
					pinmux = <0x6c00>;
					slew-rate = <0x01>;
					output-high;
				};
			};

			lcd_bias_enp0_gpio {
				phandle = <0x06>;

				pins_cmd_dat {
					pinmux = <0x6c00>;
					slew-rate = <0x01>;
					output-low;
				};
			};

			lcd_bias_enn1_gpio {
				phandle = <0x07>;

				pins_cmd_dat {
					pinmux = <0x6f00>;
					slew-rate = <0x01>;
					output-high;
				};
			};

			lcd_bias_enn0_gpio {
				phandle = <0x08>;

				pins_cmd_dat {
					pinmux = <0x6f00>;
					slew-rate = <0x01>;
					output-low;
				};
			};

			lcm_rst_out1_gpio {
				phandle = <0x09>;

				pins_cmd_dat {
					pinmux = <0x2800>;
					slew-rate = <0x01>;
					output-high;
				};
			};

			lcm_rst_out0_gpio {
				phandle = <0x0a>;

				pins_cmd_dat {
					pinmux = <0x2800>;
					slew-rate = <0x01>;
					output-low;
				};
			};

			lcm_dsi_te {
				phandle = <0x0b>;

				pins_cmd_dat {
					pinmux = <0x2701>;
				};
			};
		};
	};

	fragment@9 {
		target = <0xffffffff>;

		__overlay__ {
			pinctrl-names = "lcm_led_en1_gpio\0lcm_led_en0_gpio\0lcd_bias_enp1_gpio\0lcd_bias_enp0_gpio\0lcd_bias_enn1_gpio\0lcd_bias_enn0_gpio\0lcm_rst_out1_gpio\0lcm_rst_out0_gpio\0mode_te_te";
			pinctrl-0 = <0x03>;
			pinctrl-1 = <0x04>;
			pinctrl-2 = <0x05>;
			pinctrl-3 = <0x06>;
			pinctrl-4 = <0x07>;
			pinctrl-5 = <0x08>;
			pinctrl-6 = <0x09>;
			pinctrl-7 = <0x0a>;
			pinctrl-8 = <0x0b>;
			status = "disable";
		};
	};

	fragment@10 {
		target = <0xffffffff>;

		__overlay__ {
			pinctrl-names = "lcm_rst_out1_gpio\0lcm_rst_out0_gpio\0mode_te_te";
			pinctrl-0 = <0x09>;
			pinctrl-1 = <0x0a>;
			pinctrl-2 = <0x0b>;
			status = "okay";
			helper-value = <0x00 0x01 0x01 0x00 0x01 0x00 0x01 0x00 0x00 0x00 0x01 0x00 0x01 0x01 0x01 0x01 0x00 0x01 0x01 0x01 0x00 0x01 0x00 0x01 0x00 0x00 0x00 0x00 0x01 0x00 0x00 0x00 0x00 0x00 0x01 0x00 0x00 0x00 0x01 0x01>;
		};
	};

	fragment@11 {
		target = <0xffffffff>;

		__overlay__ {
			status = "okay";
			#address-cells = <0x01>;
			#size-cells = <0x00>;

			panel4@0 {
				compatible = "oplus21851_samsung_ams643ag01_1080p_dsi_cmd,lcm";
				reg = <0x02>;
				pm-enable-gpios = <0xffffffff 0x27 0x00>;
				reset-gpios = <0xffffffff 0x28 0x00>;
				bias-gpios = <0xffffffff 0x6e 0x00>;
				ldo3-supply = <0xffffffff>;
				pinctrl-names = "default";

				port {

					endpoint {
						remote-endpoint = <0x0c>;
						phandle = <0x0d>;
					};
				};
			};

			ports {

				port {

					endpoint {
						remote-endpoint = <0x0d>;
						phandle = <0x0c>;
					};
				};
			};
		};
	};

	fragment@12 {
		target = <0xffffffff>;

		__overlay__ {
			compatible = "mediatek,disp-leds";

			backlight {
				label = "lcd-backlight";
				max-brightness = <0xfff>;
				led-bits = <0x0c>;
				trans-bits = <0x0c>;
				default-state = "on";
			};
		};
	};

	fragment@13 {
		target = <0xffffffff>;

		__overlay__ {
			status = "okay";

			nfc_nxp@28 {
				compatible = "nxp,pn544";
				reg = <0x28>;
				nxp,pn544-irq = <0xffffffff 0x0b 0x00>;
				nxp,pn544-ven = <0xffffffff 0x0d 0x00>;
				nxp,pn544-fw-dwnld = <0xffffffff 0x07 0x00>;
				interrupt-parent = <0xffffffff>;
			};
		};
	};

	fragment@14 {
		target = <0xffffffff>;

		__overlay__ {

			led@0 {
				compatible = "mediatek,red";
				led_mode = <0x00>;
				data = <0x01>;
				pwm_config = <0x00 0x00 0x00 0x00 0x00>;
				phandle = <0x70>;
			};

			led@1 {
				compatible = "mediatek,green";
				led_mode = <0x00>;
				data = <0x01>;
				pwm_config = <0x00 0x00 0x00 0x00 0x00>;
				phandle = <0x71>;
			};

			led@2 {
				compatible = "mediatek,blue";
				led_mode = <0x00>;
				data = <0x01>;
				pwm_config = <0x00 0x00 0x00 0x00 0x00>;
				phandle = <0x72>;
			};

			led@3 {
				compatible = "mediatek,jogball-backlight";
				led_mode = <0x00>;
				data = <0x01>;
				pwm_config = <0x00 0x00 0x00 0x00 0x00>;
				phandle = <0x73>;
			};

			led@4 {
				compatible = "mediatek,keyboard-backlight";
				led_mode = <0x00>;
				data = <0x01>;
				pwm_config = <0x00 0x00 0x00 0x00 0x00>;
				phandle = <0x74>;
			};

			led@5 {
				compatible = "mediatek,button-backlight";
				led_mode = <0x00>;
				data = <0x01>;
				pwm_config = <0x00 0x00 0x00 0x00 0x00>;
				phandle = <0x75>;
			};

			led@6 {
				compatible = "mediatek,lcd-backlight";
				led_mode = <0x04>;
				data = <0x01>;
				led_config = <0x08 0x0b>;
				phandle = <0x76>;
			};

			vibrator@0 {
				compatible = "mediatek,vibrator";
				vib_timer = <0x1e>;
				vib_limit = <0x00>;
				vib_vol = <0x0b>;
				lk_vib_vol = <0x0b>;
				status = "okay";
				phandle = <0x77>;
			};

			sensor_fb {
				compatible = "oplus,sensor-feedback";
				phandle = <0x78>;
			};

			gsensor_1 {
				status = "okay";
				sensor_name = <0x0b>;
				device_name = "icm4n607";
				i2c_num = <0x02>;
				i2c_addr = <0x00>;
				direction = <0x02>;
				eint_num = <0x01>;
				gyro_cali_version = <0x02>;
				acc_cali_range = <0x12c 0x12c 0x12c>;
				phandle = <0x79>;
			};

			msensor_1 {
				status = "okay";
				sensor_name = <0x00>;
				i2c_num = <0x00>;
				i2c_addr = <0x0c>;
				direction = <0x00>;
				eint_num = <0x00>;
				soft-mag-parameter = <0x2889 0x00 0x40d 0x00 0x70 0x01 0x615 0x00 0x22cf 0x00 0xb4 0x01 0x335 0x00 0x386 0x01 0x2749 0x00>;
				phandle = <0x7a>;
			};

			msensor_2 {
				status = "okay";
				sensor_name = <0x02>;
				i2c_num = <0x00>;
				i2c_addr = <0x30>;
				direction = <0x01>;
				eint_num = <0x00>;
				soft-mag-parameter = <0x2705 0x00 0xef 0x00 0x184 0x00 0x27 0x01 0x2b0f 0x00 0x1e 0x00 0x25 0x00 0xca 0x00 0x2d8a 0x00>;
				phandle = <0x7b>;
			};

			sar_1 {
				status = "okay";
				sensor_name = <0x00>;
				i2c_num = <0x00>;
				i2c_addr = <0x28>;
				direction = <0x04>;
				eint_num = <0x0d>;
				channel_num = <0x03>;
				channel_0_min = <0xbb8>;
				channel_0_max = <0x1194>;
				channel_1_min = <0x107a>;
				channel_1_max = <0x18b8>;
				channel_2_min = <0xab3>;
				channel_2_max = <0x100d>;
				channel_3_min = <0x00>;
				channel_3_max = <0x11170>;
				reg_table_num = <0x05>;
				use_far_near = <0x01>;
				phandle = <0x7c>;
			};

			proximity_1 {
				status = "okay";
				sensor_name = <0x06>;
				i2c_num = <0x00>;
				i2c_addr = <0x48>;
				direction = <0x04>;
				eint_num = <0x02>;
				low_step = <0x12c>;
				high_step = <0x190>;
				low_limit = <0x190>;
				high_limit = <0x258>;
				dirty_low_step = <0x12c>;
				dirty_high_step = <0x190>;
				ps_dirty_limit = <0x708>;
				ps_ir_limit = <0x7d0>;
				ps_adjust_min = <0x00>;
				ps_adjust_max = <0x73a>;
				sampling_count = <0x05>;
				step_max = <0x190>;
				step_min = <0x64>;
				step_div = <0x7d0>;
				anti_shake_delta = <0x46>;
				dynamic_cali_max = <0x7d0>;
				raw2offset_radio = <0x3e8>;
				offset_max = <0xea60>;
				offset_range_min = <0x00>;
				offset_range_max = <0xffff>;
				force_cali_limit = <0x7d0>;
				cali_jitter_limit = <0x14>;
				cal_offset_margin = <0xbb8>;
				sensor-reg = <0x03 0x28>;
				phandle = <0x7d>;
			};

			light_1 {
				status = "okay";
				sensor_name = <0x06>;
				i2c_num = <0x00>;
				i2c_addr = <0x48>;
				direction = <0x04>;
				eint_num = <0x02>;
				als_buffer_length = <0x08>;
				als_ratio = <0x6e>;
				als_type = <0x02>;
				device_name = "stk32600";
				use_als_c2 = <0x01>;
				use_lb_algo = <0x01>;
				linear_comp_scope = <0x7c>;
				linear_comp_intercept = <0x36f5>;
				temp_lux = <0x0a>;
				coef = <0x85>;
				ir_coef_stage1 = <0x0b>;
				ir_coef_stage2 = <0x0c>;
				ir_coef_stage3 = <0x10>;
				ir_coef_val1 = <0x23>;
				ir_coef_val2 = <0x16>;
				ir_coef_val3 = <0x0d>;
				ir_coef_val4 = <0x0a>;
				phandle = <0x7e>;
			};

			proximity_2 {
				status = "okay";
				sensor_name = <0x05>;
				i2c_num = <0x00>;
				i2c_addr = <0x39>;
				direction = <0x04>;
				eint_num = <0x02>;
				low_step = <0x12c>;
				high_step = <0x190>;
				low_limit = <0x190>;
				high_limit = <0x258>;
				dirty_low_step = <0xb4>;
				dirty_high_step = <0xfa>;
				ps_dirty_limit = <0x3ff>;
				ps_ir_limit = <0x1f4>;
				ps_adjust_min = <0x00>;
				ps_adjust_max = <0x258>;
				sampling_count = <0x05>;
				step_max = <0x190>;
				step_min = <0x6e>;
				step_div = <0x5dc>;
				anti_shake_delta = <0x50>;
				dynamic_cali_max = <0x400>;
				raw2offset_radio = <0x5140>;
				offset_max = <0xfa>;
				offset_range_min = <0xff>;
				offset_range_max = <0xff>;
				force_cali_limit = <0x7d0>;
				cali_jitter_limit = <0x1e>;
				cal_offset_margin = <0x78>;
				sensor-reg = <0xb9 0x30 0xbc 0xa7>;
				phandle = <0x7f>;
			};

			light_2 {
				status = "okay";
				sensor_name = <0x05>;
				i2c_num = <0x00>;
				i2c_addr = <0x39>;
				direction = <0x04>;
				eint_num = <0x02>;
				als_ratio = <0x78>;
				als_buffer_length = <0x0a>;
				als_type = <0x02>;
				device_name = "tcs3701";
				use_lb_algo = <0x01>;
				lb_coef0 = <0x4b0>;
				lb_coef1 = <0x283c>;
				lb_coef2 = <0x2e18>;
				lb_coef3 = <0x2710>;
				ir_coef_stage0 = <0xe6>;
				ir_coef_stage1 = <0x230>;
				ir_coef_stage2 = <0x346>;
				ir_coef_stage3 = <0x444>;
				als_coef_a = <0x18d2b>;
				als_coef_b = <0x1d7fe>;
				als_coef_c = <0x1f9d2>;
				als_coef_d = <0xef7e>;
				als_coef_e = <0x177aa>;
				ir_coef_val1 = <0xc9b8>;
				ir_coef_val2 = <0x15806>;
				ir_coef_val3 = <0x7bc3>;
				use_exp_level = <0x01>;
				als_spectral_coefficient = <0x96>;
				als_coef_ratio = <0x3c>;
				offset_gain = <0x01>;
				phandle = <0x80>;
			};

			rear_cct_1 {
				status = "okay";
				sensor_name = <0x00>;
				i2c_num = <0x01>;
				i2c_addr = <0x48>;
				direction = <0x00>;
				eint_num = <0x0a>;
				available_sensor = <0x07>;
				gold_rear_cct_3k = <0x2b4b 0x36ec 0x6a4 0x1e8 0x40 0xa498>;
				gold_rear_cct_6k = <0x2128 0x330c 0xf58 0x174 0x40 0xa7d4>;
				device_name = "stk37600";
				cct_coef_Lir = <0x207e9a8 0x00 0x116c730 0x00 0xdaa4a8 0x00 0xcfe2c0 0x01 0x285050 0x01 0xbc5ea8 0x01 0x1cc1928 0x00 0x1ae7f08 0x00 0x44a6380 0x00 0x1c6588 0x01 0x1817f8 0x01 0x1d2108 0x01>;
				cct_coef_Hir = <0xb72d98 0x01 0xdb2e46 0x01 0x1339108 0x01 0x169bed6 0x00 0x176babe 0x00 0xfa6a4a 0x00 0xfaf6e 0x00 0x798ea2 0x00 0x330b68e 0x00 0x193ca 0x01 0x7c9b6 0x01 0x9e106 0x01>;
				phandle = <0x81>;
			};

			rear_cct_2 {
				status = "okay";
				sensor_name = <0x02>;
				i2c_num = <0x01>;
				i2c_addr = <0x39>;
				direction = <0x00>;
				eint_num = <0x0a>;
				available_sensor = <0x07>;
				gold_rear_cct_3k = <0x113a 0x87f 0x43e 0x1bea 0xa51 0x113a>;
				gold_rear_cct_6k = <0xb5c 0x927 0x62d 0x196a 0x94e 0xb5c>;
				device_name = "tcs3408";
				phandle = <0x82>;
			};

			pick_up {
				status = "okay";
				use-proximity = <0x01>;
				phandle = <0x83>;
			};

			lux_aod {
				status = "okay";
				use-proximity = <0x01>;
				phandle = <0x84>;
			};

			alsps_arch {
				status = "okay";
				new-arch-supported = <0x01>;
				phandle = <0x85>;
			};

			cali_arch {
				status = "okay";
				new-arch-supported = <0x01>;
				phandle = <0x86>;
			};

			oplus_boardid {
				compatible = "oplus,oplus_boardid";
				oplus_boardid,dtsino = "0x212A1";
				oplus_boardid,pcbmask = "0xffff";
				phandle = <0x87>;
			};

			oplus_project {
				compatible = "oplus,oplus_project";
				phandle = <0x88>;
			};

			oplus_devinfo {
				compatible = "oplus-devinfo";
				io-channels = <0xffffffff 0x08>;
				io-channel-names = "vph_pwr_voltage_sub";
				phandle = <0x89>;

				main-sub {
					compatible = "hw-match, main-sub";
					use_pmic_adc;
					is_mtk_use_adc;
					adc_ranges = <0x00 0x50 0x51 0xb4 0xb5 0x12c 0x12d 0x1a4 0x1a5 0x226 0x227 0x28a 0x28b 0x2f8 0x2f9 0x352 0x353 0x3b6 0x3b7 0x41a 0x41b 0x47e 0x47f 0x514>;
					aboard-patterns = <0x01>;
					match-projects = <0x212a1>;
				};
			};

			kpd_volume_down {
				compatible = "mediatek, VOLUME_DOWN-eint";
				interrupt-parent = <0xffffffff>;
				interrupts = <0x1d 0x02 0x1d 0x00>;
				debounce = <0x7d00>;
				status = "okay";
				phandle = <0x8a>;
			};

			nfc_chipset {
				compatible = "oplus-nfc-chipset";
				chipset-212A1 = "PN557";
				phandle = <0x8b>;
			};
		};
	};

	fragment@15 {
		target = <0xffffffff>;

		__overlay__ {
			keypad,volume-up = <0xffffffff 0x78 0x00>;
			keypad,volume-down = <0xffffffff 0x1d 0x00>;
			pinctrl-names = "volume_up_as_int\0volume_down_as_int";
			pinctrl-0 = <0x0e>;
			pinctrl-1 = <0x0f>;
			status = "okay";
		};
	};

	fragment@16 {
		target = <0xffffffff>;

		__overlay__ {

			volume_up@0 {
				phandle = <0x0e>;

				pins_cmd_dat {
					pinmux = <0x7800>;
					slew-rate = <0x00>;
					input-enable;
				};
			};

			volume_down@0 {
				phandle = <0x0f>;

				pins_cmd_dat {
					pinmux = <0x1d00>;
					slew-rate = <0x00>;
					input-enable;
				};
			};

			default@hw_sub_id {
				phandle = <0x8c>;
			};

			sleep@id0 {
				phandle = <0x8d>;

				pins_cmd_dat {
					pinmux = <0x1e00>;
					slew-rate = <0x00>;
					bias-pull-down;
					input-enable;
				};
			};

			active@id0 {
				phandle = <0x8e>;

				pins_cmd_dat {
					pinmux = <0x1e00>;
					slew-rate = <0x00>;
					bias-pull-up;
					input-enable;
				};
			};

			idle@id0 {
				phandle = <0x8f>;

				pins_cmd_dat {
					pinmux = <0x1e00>;
					slew-rate = <0x00>;
					bias-disable;
					input-enable;
				};
			};
		};
	};

	fragment@17 {
		target = <0xffffffff>;

		__overlay__ {

			gps_default {
				phandle = <0x10>;
			};

			gps_l1_lna@0 {
				phandle = <0x11>;

				pins_cmd_dat {
					pinmux = <0xbc00>;
					output-low;
				};
			};

			gps_l1_lna@1 {
				phandle = <0x12>;

				pins_cmd_dat {
					pinmux = <0xbc04>;
				};
			};

			gps_l1_lna@2 {
				phandle = <0x13>;

				pins_cmd_dat {
					pinmux = <0xbc00>;
					output-high;
				};
			};

			gps_l5_lna@0 {
				phandle = <0x14>;

				pins_cmd_dat {
					pinmux = <0xbd00>;
					output-low;
				};
			};

			gps_l5_lna@1 {
				phandle = <0x15>;

				pins_cmd_dat {
					pinmux = <0xbd04>;
				};
			};

			gps_l5_lna@2 {
				phandle = <0x16>;

				pins_cmd_dat {
					pinmux = <0xbd00>;
					output-high;
				};
			};
		};
	};

	fragment@18 {
		target = <0xffffffff>;

		__overlay__ {
			pinctrl-names = "default\0gps_l1_lna_disable\0gps_l1_lna_dsp_ctrl\0gps_l1_lna_enable\0gps_l5_lna_disable\0gps_l5_lna_dsp_ctrl\0gps_l5_lna_enable";
			pinctrl-0 = <0x10>;
			pinctrl-1 = <0x11>;
			pinctrl-2 = <0x12>;
			pinctrl-3 = <0x13>;
			pinctrl-4 = <0x14>;
			pinctrl-5 = <0x15>;
			pinctrl-6 = <0x16>;
			status = "okay";
		};
	};

	fragment@19 {
		target = <0xffffffff>;

		__overlay__ {
			accdet-mic-vol = <0x08>;
			headset-mode-setting = <0x500 0x500 0x01 0x1f0 0x1325 0x800 0x3d4 0x44 0x00 0x07 0x05 0x09 0x09 0x0d 0x0e>;
			accdet-plugout-debounce = <0x01>;
			accdet-mic-mode = <0x02>;
			headset-three-key-threshold = <0x00 0x52 0xaa 0x132>;
			headset-three-key-threshold-CDD = <0x00 0x79 0xc0 0x258>;
			headset-four-key-threshold = <0x00 0x3a 0x79 0xc0 0x190>;
			moisture_detect_enable = <0x01>;
			eint_use_ext_res = <0x00>;
			eint_detect_mode = <0x05>;
			moisture_detect_mode = <0x05>;
			moisture_comp_vth = <0x02>;
			moisture_comp_vref2 = <0x02>;
			moisture_use_ext_res = <0x00>;
			moisture-external-r = <0x1e8480>;
			moisture-internal-r = <0xb798>;
			moisture-water-r = <0x2710>;
			status = "okay";
		};
	};

	fragment@20 {
		target = <0xffffffff>;

		__overlay__ {
			pinctrl-names = "enable\0disable";
			pinctrl-0 = <0x17>;
			pinctrl-1 = <0x18>;
			status = "okay";
		};
	};

	fragment@21 {
		target = <0xffffffff>;

		__overlay__ {
			pinctrl-names = "sel_up\0sel_down";
			pinctrl-0 = <0x19>;
			pinctrl-1 = <0x1a>;
			status = "okay";
		};
	};

	fragment@22 {
		target = <0xffffffff>;

		__overlay__ {

			ps_enable {
				phandle = <0x17>;

				pins_cmd_dat {
					pinmux = <0x7900>;
					output-high;
				};
			};

			ps_disable {
				phandle = <0x18>;

				pins_cmd_dat {
					pinmux = <0x7900>;
					output-low;
				};
			};

			sel_up {
				phandle = <0x19>;

				pins_cmd_dat {
					pinmux = <0x600>;
					output-low;
				};
			};

			sel_down {
				phandle = <0x1a>;

				pins_cmd_dat {
					pinmux = <0x600>;
					output-high;
				};
			};
		};
	};

	fragment@23 {
		target = <0xffffffff>;

		__overlay__ {
			compatible = "mediatek, swtp-eint";
			debounce = <0x7d000>;
		};
	};

	fragment@24 {
		target = <0xffffffff>;

		__overlay__ {

			fan53870@35 {
				compatible = "fan53870";
				reg = <0x35>;
				ldo1_min_vol = "\0\f5";
				ldo1_max_vol = <0x16f300>;
				ldo1_step_vol = <0x1f40>;
				en-gpios = <0xffffffff 0x6d 0x01>;
			};
		};
	};

	fragment@25 {
		target = <0xffffffff>;

		__overlay__ {

			tfa98xx@34 {
				compatible = "nxp,tfa98xx";
				reg = <0x34>;
				reset-gpio = <0xffffffff 0x6b 0x00>;
				status = "okay";
				phandle = <0x90>;
			};

			gate_ic@11 {
				compatible = "mediatek,gate-ic-i2c";
				gate-power-gpios = <0xffffffff 0x6b 0x00>;
				reg = <0x11>;
				status = "disable";
				phandle = <0x91>;
			};
		};
	};

	fragment@26 {
		target = <0xffffffff>;

		__overlay__ {

			fsa_hs_det {
				phandle = <0x1b>;

				pins_cmd_dat {
					pinmux = <0xa900>;
					slew-rate = <0x01>;
					output-high;
				};
			};
		};
	};

	fragment@27 {
		target = <0xffffffff>;

		__overlay__ {

			fsa4480@42 {
				compatible = "qcom,fsa4480-i2c";
				reg = <0x42>;
				pinctrl-names = "default";
				pinctrl-0 = <0x1b>;
				fsa4480,hs-det-gpio = <0xffffffff 0xa9 0x00>;
				fsa4480,reset-gpio = <0xffffffff 0x6f 0x00>;
				phandle = <0x92>;
			};
		};
	};

	fragment@28 {
		target = <0xffffffff>;

		__overlay__ {
			oplus,fp_gpio_num = <0x01>;
			oplus,fp_gpio = <0x23>;
			oplus,fp_gpio_0 = <0xffffffff 0x23 0x00>;
			pinctrl-names = "default";
			pinctrl-0 = <0x1c>;

			goodix_optical {
				oplus,fp-id = <0x00>;
				vendor-chip = <0x0b>;
				eng-menu = "-1,-1";
				chip-name = "G_OPTICAL_G3S";
			};

			goodix_optical_bak {
				oplus,fp-id = <0x01>;
				vendor-chip = <0x0b>;
				eng-menu = "-1,-1";
				chip-name = "G_OPTICAL_G3S";
			};
		};
	};

	fragment@29 {
		target = <0xffffffff>;

		__overlay__ {

			gpio_id0_default {
				phandle = <0x1c>;

				pins_cmd_dat {
					pinmux = <0x2300>;
					slew-rate = <0x00>;
					bias-pull-up = <0x00>;
					input-enable;
				};
			};
		};
	};

	fragment@30 {
		target = <0xffffffff>;

		__overlay__ {
			goodix,gpio_irq = <0xffffffff 0x16 0x00>;
			goodix,gpio_reset = <0xffffffff 0x15 0x00>;
			goodix,gpio_cs = <0xffffffff 0x63 0x00>;
			pinctrl-names = "default\0gf_spi_drive_6mA\0gf_cs_func";
			pinctrl-0 = <0x1d 0x1e>;
			pinctrl-1 = <0x1f 0x20 0x21>;
			pinctrl-2 = <0x22>;
			status = "okay";
		};
	};

	fragment@31 {
		target = <0xffffffff>;

		__overlay__ {
			cd-gpios = <0xffffffff 0x03 0x00>;
			cd_level = [01];
			status = "okay";
			vmmc-supply = <0xffffffff>;
		};
	};

	fragment@32 {
		target = <0xffffffff>;

		__overlay__ {
			sdcard_det_en = <0x01>;
			sdcard_hlact = <0x00>;
		};
	};

	fragment@33 {
		target = <0xffffffff>;

		__overlay__ {
			#address-cells = <0x01>;
			#size-cells = <0x00>;
			status = "okay";

			fingerprint@0 {
				compatible = "oplus,oplus_fp";
				reg = <0x00>;
				spi-max-frequency = <0x2faf080>;
				spi-id = <0x05>;
				spi-irq = <0x16>;
				spi-reg = <0xa822f8>;
				pw_en_gpio = <0xffffffff 0x8b 0x00>;
				power-num = <0x01>;
				status = "okay";
				phandle = <0x93>;

				power_source_1 {
					power-mode = <0x02>;
					power-name = "pw_en_gpio";
					poweron-level = <0x01>;
					delay-time = <0x00>;
				};
			};
		};
	};

	fragment@34 {
		target = <0xffffffff>;

		__overlay__ {

			gpio_goodix_reset_default {
				phandle = <0x1e>;

				pins_cmd_dat {
					pinmux = <0x1500>;
					slew-rate = <0x01>;
					output-low;
				};
			};

			gpio_goodix_irq_default {
				phandle = <0x1d>;

				pins_cmd_dat {
					pinmux = <0x1600>;
					slew-rate = <0x00>;
					bias-pull-down;
				};
			};

			gpio_goodix_clk_6mA {
				phandle = <0x1f>;

				pins_cmd_dat {
					pinmux = <0x6201>;
					drive-strength = <0x02>;
				};
			};

			gpio_goodix_mosi_6mA {
				phandle = <0x20>;

				pins_cmd_dat {
					pinmux = <0x6501>;
					drive-strength = <0x02>;
				};
			};

			gpio_goodix_miso_6mA {
				phandle = <0x21>;

				pins_cmd_dat {
					pinmux = <0x6401>;
					drive-strength = <0x03>;
				};
			};

			gpio_goodix_cs_func {
				phandle = <0x22>;

				pins_cmd_dat {
					pinmux = <0x6301>;
					drive-strength = <0x02>;
				};
			};
		};
	};

	fragment@35 {
		target = <0xffffffff>;

		__overlay__ {

			adc_channel@ {
				compatible = "mediatek,adc_channel";
				mediatek,temperature0 = <0x00>;
				mediatek,temperature1 = <0x01>;
				mediatek,adc_fdd_rf_params_dynamic_custom_ch = <0x02>;
				status = "okay";
			};
		};
	};

	fragment@36 {
		target = <0xffffffff>;

		__overlay__ {
			io-channels = <0xffffffff 0x02>;
		};
	};

	fragment@37 {
		target = <0xffffffff>;

		__overlay__ {
			mediatek,clkbuf-quantity = <0x07>;
			mediatek,clkbuf-config = <0x02 0x01 0x01 0x02 0x00 0x00 0x01>;
			mediatek,clkbuf-output-impedance = <0x03 0x04 0x03 0x04 0x00 0x00 0x03>;
			mediatek,clkbuf-controls-for-desense = <0x00 0x04 0x00 0x04 0x00 0x00 0x00>;
			status = "okay";
		};
	};

	fragment@38 {
		target = <0xffffffff>;

		__overlay__ {
			#address-cells = <0x01>;
			#size-cells = <0x00>;
			clock-frequency = <0x61a80>;
			mediatek,use-open-drain;
		};
	};

	fragment@39 {
		target = <0xffffffff>;

		__overlay__ {
			#address-cells = <0x01>;
			#size-cells = <0x00>;
			clock-frequency = <0x61a80>;
			mediatek,use-open-drain;
		};
	};

	fragment@40 {
		target = <0xffffffff>;

		__overlay__ {
			#address-cells = <0x01>;
			#size-cells = <0x00>;
			clock-frequency = <0x61a80>;
			mediatek,use-open-drain;

			camera_main@1a {
				compatible = "mediatek,camera_main";
				reg = <0x1a>;
				status = "okay";
				phandle = <0x94>;
			};

			camera_main_af@72 {
				compatible = "mediatek,camera_main_af";
				reg = <0x72>;
				status = "okay";
				phandle = <0x95>;
			};
		};
	};

	fragment@41 {
		target = <0xffffffff>;

		__overlay__ {
			#address-cells = <0x01>;
			#size-cells = <0x00>;
			clock-frequency = <0x61a80>;
			mediatek,use-open-drain;

			nfc@08 {
				compatible = "mediatek,nfc";
				reg = <0x08>;
				status = "okay";
				phandle = <0x96>;
			};
		};
	};

	fragment@42 {
		target = <0xffffffff>;

		__overlay__ {
			#address-cells = <0x01>;
			#size-cells = <0x00>;
			clock-frequency = <0x61a80>;
			mediatek,use-open-drain;

			camera_main_two@1a {
				compatible = "mediatek,camera_main_two";
				reg = <0x1a>;
				status = "okay";
				phandle = <0x97>;
			};

			camera_sub@10 {
				compatible = "mediatek,camera_sub";
				reg = <0x10>;
				status = "okay";
				phandle = <0x98>;
			};

			camera_sub_two@37 {
				compatible = "mediatek,camera_sub_two";
				reg = <0x37>;
				status = "okay";
				phandle = <0x99>;
			};
		};
	};

	fragment@43 {
		target = <0xffffffff>;

		__overlay__ {
			#address-cells = <0x01>;
			#size-cells = <0x00>;
			clock-frequency = <0x33e140>;
			mediatek,use-push-pull;

			subpmic@34 {
				compatible = "mediatek,subpmic";
				reg = <0x34>;
				status = "okay";
				phandle = <0x9a>;
			};

			usb_type_c@4e {
				compatible = "mediatek,usb_type_c";
				reg = <0x4e>;
				status = "okay";
				phandle = <0x9b>;
			};

			subpmic_pmic@1a {
				compatible = "mediatek,subpmic_pmic";
				reg = <0x1a>;
				status = "okay";
				phandle = <0x9c>;
			};

			subpmic_ldo@64 {
				compatible = "mediatek,subpmic_ldo";
				reg = <0x64>;
				status = "okay";
				phandle = <0x9d>;
			};
		};
	};

	fragment@44 {
		target = <0xffffffff>;

		__overlay__ {
			#address-cells = <0x01>;
			#size-cells = <0x00>;
			clock-frequency = <0x61a80>;
			mediatek,use-open-drain;

			i2c_lcd_bias@11 {
				compatible = "mediatek,i2c_lcd_bias";
				reg = <0x11>;
				status = "okay";
				phandle = <0x9e>;
			};
		};
	};

	fragment@45 {
		target = <0xffffffff>;

		__overlay__ {
			#address-cells = <0x01>;
			#size-cells = <0x00>;
			clock-frequency = <0x186a0>;
			mediatek,use-open-drain;
		};
	};

	fragment@46 {
		target = <0xffffffff>;

		__overlay__ {
			#address-cells = <0x01>;
			#size-cells = <0x00>;
			clock-frequency = <0x61a80>;
			mediatek,use-open-drain;
		};
	};

	fragment@47 {
		target = <0xffffffff>;

		__overlay__ {
			#address-cells = <0x01>;
			#size-cells = <0x00>;
			clock-frequency = <0x61a80>;
			mediatek,use-open-drain;
		};
	};

	fragment@48 {
		target = <0xffffffff>;

		__overlay__ {
			#address-cells = <0x01>;
			#size-cells = <0x00>;
			clock-frequency = <0x61a80>;
			mediatek,use-open-drain;
		};
	};

	fragment@49 {
		target = <0xffffffff>;

		__overlay__ {
			#address-cells = <0x01>;
			#size-cells = <0x00>;
			clock-frequency = <0x61a80>;
			mediatek,use-open-drain;
		};
	};

	fragment@50 {
		target = <0xffffffff>;

		__overlay__ {
			GPIO_FDD_BAND_SUPPORT_DETECT_1ST_PIN = <0xffffffff 0x47 0x00>;
			GPIO_FDD_BAND_SUPPORT_DETECT_2ND_PIN = <0xffffffff 0x48 0x00>;
			GPIO_FDD_BAND_SUPPORT_DETECT_3RD_PIN = <0xffffffff 0x49 0x00>;
			GPIO_FDD_BAND_SUPPORT_DETECT_4TH_PIN = <0xffffffff 0x4a 0x00>;
			GPIO_RF_PWREN_RST_PIN = <0xffffffff 0x4b 0x00>;
			GPIO_SIM2_SIO = <0xffffffff 0xaa 0x00>;
			GPIO_SIM2_SCLK = <0xffffffff 0xab 0x00>;
			GPIO_SIM2_SRST = <0xffffffff 0xac 0x00>;
			GPIO_SIM1_SRST = <0xffffffff 0xad 0x00>;
			GPIO_SIM1_SCLK = <0xffffffff 0xae 0x00>;
			GPIO_SIM1_SIO = <0xffffffff 0xaf 0x00>;
			GPIO_SIM1_HOT_PLUG = <0xffffffff 0xb0 0x00>;
			GPIO_SIM2_HOT_PLUG = <0xffffffff 0xb1 0x00>;
		};
	};

	fragment@51 {
		target = <0xffffffff>;

		__overlay__ {
			gpio_init_default = <0x00 0x00 0x00 0x00 0x01 0x01 0x01 0x01 0x00 0x00 0x00 0x01 0x00 0x01 0x02 0x00 0x00 0x00 0x01 0x01 0x01 0x03 0x00 0x00 0x00 0x01 0x01 0x01 0x04 0x00 0x00 0x00 0x01 0x01 0x01 0x05 0x00 0x00 0x00 0x01 0x01 0x01 0x06 0x00 0x00 0x00 0x00 0x00 0x00 0x07 0x00 0x01 0x00 0x01 0x00 0x00 0x08 0x00 0x00 0x00 0x01 0x01 0x00 0x09 0x00 0x00 0x00 0x00 0x00 0x00 0x0a 0x00 0x00 0x00 0x01 0x01 0x00 0x0b 0x00 0x00 0x00 0x00 0x00 0x01 0x0c 0x02 0x00 0x00 0x01 0x01 0x00 0x0d 0x00 0x01 0x00 0x01 0x00 0x00 0x0e 0x00 0x00 0x00 0x01 0x01 0x01 0x0f 0x00 0x01 0x00 0x01 0x00 0x01 0x10 0x07 0x00 0x00 0x01 0x01 0x00 0x11 0x07 0x00 0x00 0x01 0x01 0x00 0x12 0x07 0x00 0x00 0x01 0x01 0x00 0x13 0x00 0x00 0x00 0x01 0x01 0x00 0x14 0x07 0x00 0x00 0x00 0x00 0x00 0x15 0x00 0x01 0x00 0x00 0x00 0x00 0x16 0x00 0x00 0x00 0x01 0x00 0x00 0x17 0x07 0x00 0x00 0x01 0x01 0x00 0x18 0x00 0x01 0x00 0x01 0x00 0x00 0x19 0x00 0x01 0x00 0x01 0x00 0x00 0x1a 0x01 0x00 0x00 0x01 0x01 0x00 0x1b 0x01 0x00 0x00 0x00 0x00 0x00 0x1c 0x01 0x00 0x00 0x01 0x01 0x00 0x1d 0x01 0x00 0x00 0x01 0x01 0x00 0x1e 0x00 0x00 0x00 0x00 0x00 0x00 0x1f 0x00 0x00 0x00 0x00 0x00 0x00 0x20 0x01 0x00 0x00 0x01 0x01 0x00 0x21 0x00 0x01 0x00 0x01 0x00 0x00 0x22 0x00 0x00 0x00 0x00 0x00 0x00 0x23 0x00 0x01 0x01 0x01 0x01 0x01 0x24 0x01 0x00 0x00 0x01 0x01 0x01 0x25 0x01 0x00 0x00 0x01 0x01 0x01 0x26 0x01 0x00 0x00 0x01 0x01 0x01 0x27 0x01 0x00 0x00 0x01 0x00 0x01 0x28 0x00 0x01 0x00 0x00 0x00 0x01 0x29 0x01 0x00 0x00 0x00 0x00 0x01 0x2a 0x01 0x00 0x00 0x00 0x00 0x01 0x2b 0x01 0x00 0x00 0x01 0x00 0x01 0x2c 0x01 0x00 0x00 0x01 0x00 0x01 0x2d 0x01 0x00 0x00 0x01 0x01 0x01 0x2e 0x01 0x00 0x00 0x00 0x00 0x00 0x2f 0x01 0x00 0x00 0x00 0x00 0x00 0x30 0x01 0x00 0x00 0x00 0x00 0x00 0x31 0x01 0x00 0x00 0x00 0x00 0x00 0x32 0x01 0x00 0x00 0x01 0x00 0x00 0x33 0x01 0x00 0x00 0x01 0x00 0x00 0x34 0x01 0x00 0x00 0x01 0x00 0x00 0x35 0x01 0x00 0x00 0x01 0x00 0x00 0x36 0x01 0x00 0x00 0x01 0x00 0x01 0x37 0x01 0x00 0x00 0x01 0x00 0x00 0x38 0x01 0x00 0x00 0x01 0x00 0x00 0x39 0x01 0x00 0x00 0x01 0x00 0x00 0x3a 0x01 0x00 0x00 0x01 0x00 0x00 0x3b 0x01 0x00 0x00 0x01 0x00 0x00 0x3c 0x01 0x00 0x00 0x00 0x00 0x01 0x3d 0x01 0x00 0x00 0x00 0x00 0x01 0x3e 0x01 0x00 0x00 0x00 0x00 0x01 0x3f 0x01 0x00 0x00 0x00 0x00 0x01 0x40 0x01 0x00 0x00 0x01 0x01 0x01 0x41 0x01 0x00 0x00 0x01 0x01 0x01 0x42 0x01 0x00 0x00 0x01 0x00 0x01 0x43 0x01 0x00 0x00 0x01 0x00 0x01 0x44 0x01 0x00 0x00 0x00 0x00 0x00 0x45 0x01 0x00 0x00 0x01 0x00 0x00 0x46 0x01 0x00 0x00 0x01 0x00 0x01 0x47 0x00 0x00 0x00 0x01 0x00 0x01 0x48 0x00 0x00 0x00 0x01 0x00 0x01 0x49 0x00 0x00 0x00 0x01 0x00 0x01 0x4a 0x00 0x00 0x00 0x01 0x00 0x01 0x4b 0x00 0x01 0x01 0x01 0x00 0x01 0x4c 0x01 0x00 0x00 0x00 0x00 0x01 0x4d 0x01 0x00 0x00 0x00 0x00 0x01 0x4e 0x01 0x00 0x00 0x00 0x00 0x01 0x4f 0x01 0x00 0x00 0x00 0x00 0x01 0x50 0x01 0x00 0x00 0x00 0x00 0x01 0x51 0x01 0x00 0x00 0x00 0x00 0x01 0x52 0x01 0x00 0x00 0x00 0x00 0x00 0x53 0x01 0x00 0x00 0x01 0x00 0x00 0x54 0x01 0x00 0x00 0x00 0x00 0x00 0x55 0x01 0x00 0x00 0x01 0x00 0x00 0x56 0x01 0x00 0x00 0x01 0x00 0x01 0x57 0x01 0x00 0x00 0x00 0x00 0x01 0x58 0x01 0x00 0x00 0x00 0x00 0x01 0x59 0x01 0x00 0x00 0x00 0x00 0x01 0x5a 0x01 0x00 0x00 0x00 0x00 0x01 0x5b 0x01 0x00 0x00 0x00 0x00 0x01 0x5c 0x01 0x00 0x00 0x00 0x00 0x01 0x5d 0x01 0x00 0x00 0x00 0x00 0x01 0x5e 0x01 0x00 0x00 0x00 0x00 0x01 0x5f 0x01 0x00 0x00 0x00 0x00 0x01 0x60 0x01 0x00 0x00 0x00 0x00 0x01 0x61 0x01 0x00 0x00 0x00 0x00 0x01 0x62 0x01 0x01 0x00 0x00 0x00 0x00 0x63 0x00 0x01 0x00 0x00 0x00 0x00 0x64 0x01 0x00 0x00 0x01 0x00 0x00 0x65 0x01 0x01 0x00 0x00 0x00 0x00 0x66 0x01 0x00 0x00 0x01 0x01 0x00 0x67 0x01 0x00 0x00 0x01 0x01 0x00 0x68 0x01 0x00 0x00 0x01 0x01 0x00 0x69 0x01 0x00 0x00 0x01 0x01 0x00 0x6a 0x01 0x00 0x00 0x01 0x01 0x00 0x6b 0x00 0x01 0x01 0x01 0x00 0x01 0x6c 0x00 0x01 0x00 0x01 0x00 0x01 0x6d 0x00 0x01 0x00 0x01 0x00 0x00 0x6e 0x00 0x01 0x00 0x01 0x00 0x00 0x6f 0x00 0x01 0x00 0x01 0x00 0x00 0x70 0x01 0x00 0x00 0x01 0x01 0x00 0x71 0x00 0x00 0x00 0x01 0x01 0x00 0x72 0x00 0x00 0x00 0x01 0x01 0x00 0x73 0x02 0x00 0x00 0x01 0x00 0x00 0x74 0x01 0x00 0x00 0x01 0x01 0x01 0x75 0x00 0x00 0x00 0x01 0x00 0x00 0x76 0x00 0x00 0x00 0x01 0x00 0x00 0x77 0x00 0x00 0x00 0x01 0x00 0x00 0x78 0x01 0x00 0x00 0x01 0x01 0x00 0x79 0x00 0x00 0x00 0x01 0x01 0x00 0x7a 0x07 0x00 0x00 0x01 0x01 0x01 0x7b 0x07 0x00 0x00 0x01 0x01 0x00 0x7c 0x07 0x00 0x00 0x01 0x01 0x00 0x7d 0x07 0x00 0x00 0x01 0x01 0x00 0x7e 0x02 0x00 0x00 0x01 0x00 0x00 0x7f 0x02 0x00 0x00 0x01 0x00 0x00 0x80 0x02 0x00 0x00 0x01 0x01 0x01 0x81 0x02 0x00 0x00 0x01 0x00 0x01 0x82 0x02 0x00 0x00 0x01 0x01 0x01 0x83 0x02 0x00 0x00 0x01 0x01 0x01 0x84 0x01 0x00 0x00 0x01 0x01 0x01 0x85 0x01 0x00 0x00 0x01 0x01 0x01 0x86 0x01 0x00 0x00 0x01 0x01 0x01 0x87 0x01 0x00 0x00 0x01 0x01 0x01 0x88 0x01 0x00 0x00 0x01 0x01 0x01 0x89 0x01 0x00 0x00 0x01 0x01 0x01 0x8a 0x04 0x00 0x00 0x01 0x01 0x00 0x8b 0x00 0x01 0x00 0x00 0x00 0x00 0x8c 0x00 0x01 0x00 0x01 0x00 0x01 0x8d 0x00 0x01 0x00 0x01 0x00 0x01 0x8e 0x00 0x01 0x00 0x01 0x00 0x00 0x8f 0x01 0x00 0x00 0x01 0x01 0x01 0x90 0x01 0x00 0x00 0x01 0x01 0x01 0x91 0x01 0x00 0x00 0x01 0x01 0x01 0x92 0x01 0x00 0x00 0x01 0x01 0x01 0x93 0x01 0x00 0x00 0x01 0x01 0x01 0x94 0x01 0x00 0x00 0x01 0x01 0x01 0x95 0x01 0x00 0x00 0x01 0x01 0x00 0x96 0x01 0x00 0x00 0x01 0x01 0x00 0x97 0x01 0x00 0x00 0x01 0x01 0x00 0x98 0x01 0x00 0x00 0x01 0x01 0x00 0x99 0x00 0x00 0x00 0x01 0x01 0x00 0x9a 0x00 0x01 0x00 0x01 0x00 0x00 0x9b 0x00 0x01 0x00 0x01 0x00 0x00 0x9c 0x00 0x00 0x00 0x01 0x01 0x00 0x9d 0x00 0x01 0x00 0x01 0x00 0x00 0x9e 0x00 0x00 0x00 0x01 0x01 0x00 0x9f 0x00 0x01 0x00 0x01 0x00 0x00 0xa0 0x00 0x00 0x00 0x01 0x01 0x00 0xa1 0x00 0x01 0x00 0x01 0x00 0x00 0xa2 0x00 0x00 0x00 0x01 0x01 0x00 0xa3 0x00 0x00 0x00 0x01 0x01 0x00 0xa4 0x01 0x00 0x00 0x01 0x01 0x00 0xa5 0x01 0x00 0x00 0x00 0x00 0x00 0xa6 0x01 0x00 0x00 0x01 0x01 0x00 0xa7 0x01 0x00 0x00 0x01 0x01 0x00 0xa8 0x01 0x00 0x00 0x01 0x01 0x00 0xa9 0x00 0x00 0x00 0x01 0x01 0x00 0xaa 0x01 0x00 0x00 0x01 0x01 0x01 0xab 0x01 0x00 0x00 0x00 0x00 0x01 0xac 0x01 0x00 0x00 0x00 0x00 0x01 0xad 0x01 0x00 0x00 0x00 0x00 0x01 0xae 0x01 0x00 0x00 0x00 0x00 0x01 0xaf 0x01 0x00 0x00 0x01 0x01 0x01 0xb0 0x01 0x00 0x00 0x01 0x01 0x01 0xb1 0x01 0x00 0x00 0x01 0x01 0x01 0xb2 0x01 0x00 0x00 0x01 0x00 0x00 0xb3 0x01 0x00 0x00 0x01 0x00 0x00 0xb4 0x00 0x00 0x00 0x00 0x00 0x01 0xb5 0x00 0x00 0x00 0x00 0x00 0x01 0xb6 0x01 0x00 0x00 0x01 0x01 0x00 0xb7 0x01 0x00 0x00 0x01 0x01 0x00 0xb8 0x01 0x00 0x00 0x01 0x01 0x00 0xb9 0x01 0x00 0x00 0x01 0x01 0x00 0xba 0x03 0x00 0x00 0x01 0x01 0x01 0xbb 0x03 0x00 0x00 0x01 0x01 0x01 0xbc 0x00 0x01 0x00 0x01 0x01 0x00 0xbd 0x00 0x01 0x00 0x01 0x01 0x00 0xbe 0x01 0x00 0x00 0x01 0x01 0x00 0xbf 0x05 0x00 0x00 0x00 0x00 0x00 0xc0 0x05 0x00 0x00 0x00 0x00 0x00 0xc1 0x00 0x00 0x00 0x01 0x01 0x00 0xc2 0x00 0x00 0x00 0x01 0x01 0x00 0xc3 0x00 0x00 0x00 0x01 0x01 0x00 0xc4 0x00 0x00 0x00 0x01 0x00 0x00 0xc5 0x00 0x00 0x00 0x01 0x00 0x00 0xc6 0x00 0x00 0x00 0x01 0x00 0x00 0xc7 0x00 0x00 0x00 0x01 0x00 0x00 0xc8 0x00 0x00 0x00 0x01 0x00 0x00 0xc9 0x00 0x00 0x00 0x01 0x00 0x00 0xca 0x00 0x00 0x00 0x01 0x00 0x00 0xcb 0x00 0x00 0x00 0x01 0x00 0x00 0xcc 0x00 0x00 0x00 0x01 0x00 0x00 0xcd 0x00 0x00 0x00 0x01 0x00 0x00 0xce 0x00 0x00 0x00 0x01 0x00 0x00 0xcf 0x00 0x00 0x00 0x01 0x00 0x00 0xd0 0x00 0x00 0x00 0x01 0x00 0x00>;
		};
	};

	fragment@52 {
		target = <0xffffffff>;

		__overlay__ {
			interrupt-parent = <0xffffffff>;
			interrupts = <0x00 0x08>;
			status = "okay";
		};
	};

	fragment@53 {
		target = <0xffffffff>;

		__overlay__ {
			interrupt-parent = <0xffffffff>;
			interrupts = <0x03 0x08>;
			status = "okay";
		};
	};

	fragment@54 {
		target = <0xffffffff>;

		__overlay__ {
			interrupt-parent = <0xffffffff>;
			interrupts = <0x04 0x02>;
			status = "okay";
		};
	};

	fragment@55 {
		target = <0xffffffff>;

		__overlay__ {
			interrupt-parent = <0xffffffff>;
			interrupts = <0x08 0x04>;
			status = "okay";
		};
	};

	fragment@56 {
		target = <0xffffffff>;

		__overlay__ {
			interrupt-parent = <0xffffffff>;
			interrupts = <0x0b 0x01>;
			status = "okay";
		};
	};

	fragment@57 {
		target = <0xffffffff>;

		__overlay__ {
			interrupt-parent = <0xffffffff>;
			interrupts = <0x0e 0x08>;
			status = "okay";
		};
	};

	fragment@58 {
		target = <0xffffffff>;

		__overlay__ {
			interrupt-parent = <0xffffffff>;
			interrupts = <0x13 0x04>;
			deb-gpios = <0xffffffff 0x13 0x00>;
			debounce = <0x7d000>;
			status = "okay";
		};
	};

	fragment@59 {
		target = <0xffffffff>;

		__overlay__ {
			interrupt-parent = <0xffffffff>;
			interrupts = <0x25 0x01>;
			status = "okay";
		};
	};

	fragment@60 {
		target = <0xffffffff>;

		__overlay__ {
			compatible = "mediatek,md1_sim1_hot_plug_eint-eint";
			interrupts = <0x00 0x08>;
			debounce = <0x00 0x2710>;
			dedicated = <0x00 0x00>;
			src_pin = <0x00 0x01>;
			sockettype = <0x00 0x00>;
			status = "okay";
		};
	};

	fragment@61 {
		target = <0xffffffff>;

		__overlay__ {
			compatible = "mediatek,md1_sim2_hot_plug_eint-eint";
			interrupts = <0x01 0x08>;
			debounce = <0x01 0x2710>;
			dedicated = <0x01 0x00>;
			src_pin = <0x01 0x02>;
			sockettype = <0x01 0x00>;
			status = "okay";
		};
	};

	fragment@62 {
		target = <0xffffffff>;

		__overlay__ {
			regulator-name = "vcamio";
			regulator-default-on = <0x01>;
			status = "okay";
		};
	};

	fragment@63 {
		target = <0xffffffff>;

		__overlay__ {
			regulator-name = "vtp";
			regulator-default-on = <0x01>;
			status = "okay";
		};
	};

	fragment@64 {
		target = <0xffffffff>;

		__overlay__ {
			vcamio-supply = <0xffffffff>;
			status = "okay";
		};
	};

	fragment@65 {
		target = <0xffffffff>;

		__overlay__ {
			vtouch-supply = <0xffffffff>;
			status = "okay";
		};
	};

	fragment@66 {
		target = <0xffffffff>;

		__overlay__ {
			mediatek,kpd-key-debounce = <0x400>;
			mediatek,kpd-sw-pwrkey = <0x74>;
			mediatek,kpd-hw-pwrkey = <0x08>;
			mediatek,kpd-sw-rstkey = <0x73>;
			mediatek,kpd-hw-rstkey = <0x11>;
			mediatek,kpd-use-extend-type = <0x00>;
			mediatek,kpd-hw-map-num = <0x48>;
			mediatek,kpd-hw-init-map = <0x00 0x72 0x00 0x00 0x00 0x00 0x00 0x00 0x00 0x00 0x00 0x00 0x00 0x00 0x00 0x00 0x00 0x00 0x00 0x00 0x00 0x00 0x00 0x00 0x00 0x00 0x00 0x00 0x00 0x00 0x00 0x00 0x00 0x00 0x00 0x00 0x00 0x00 0x00 0x00 0x00 0x00 0x00 0x00 0x00 0x00 0x00 0x00 0x00 0x00 0x00 0x00 0x00 0x00 0x00 0x00 0x00 0x00 0x00 0x00 0x00 0x00 0x00 0x00 0x00 0x00 0x00 0x00 0x00 0x00 0x00 0x00>;
			mediatek,kpd-pwrkey-eint-gpio = <0x00>;
			mediatek,kpd-pwkey-gpio-din = <0x00>;
			mediatek,kpd-hw-dl-key0 = <0x11>;
			mediatek,kpd-hw-dl-key2 = <0x08>;
			mediatek,kpd-hw-recovery-key = <0x11>;
			status = "okay";
		};
	};

	fragment@67 {
		target = <0xffffffff>;

		__overlay__ {
			status = "okay";
			scl-gpio-id = <0x93>;
			sda-gpio-id = <0x94>;

			aw8697_haptic@5A {
				status = "disabled";
				compatible = "awinic,aw8697_haptic";
				reg = <0x5a>;
				phandle = <0x9f>;
			};
		};
	};

	fragment@68 {
		target = <0xffffffff>;

		__overlay__ {
			mt6360,intr_gpio_num = <0x04>;
			mt6360,intr_gpio = <0xffffffff 0x04 0x00>;
			disable_lpsd = <0x01>;

			chg {
				support_hvdcp;
			};
		};
	};

	fragment@69 {
		target = <0xffffffff>;

		__overlay__ {
			mt6360pd,intr_gpio_num = <0x05>;
			mt6360pd,intr_gpio = <0xffffffff 0x05 0x00>;
			mt-tcpc,role_def = <0x01>;
			mt-tcpc,vconn_supply = <0x01>;

			pd-data {
				pd,source-pdo-size = <0x01>;
				pd,source-pdo-data = <0x19096>;
				pd,sink-pdo-size = <0x02>;
				pd,sink-pdo-data = <0x190c8 0x1912c>;
				pd,id-vdo-size = <0x03>;
				pd,id-vdo-data = <0xd10029cf 0x00 0x63600000>;
				bat,nr = <0x01>;

				bat-info0 {
					bat,vid = <0x29cf>;
					bat,pid = <0x6360>;
					bat,mfrs = "bat1";
					bat,design_cap = <0x11>;
				};
			};

			dpm_caps {
				attemp_discover_svid;
			};
		};
	};

	fragment@70 {
		target = <0xffffffff>;

		__overlay__ {
			charger_by_buckboost;
			support_tuv_authentication;
			max_charger_voltage = <0x989680>;
		};
	};

	fragment@71 {
		target = <0xffffffff>;

		__overlay__ {
			io-channels = <0xffffffff 0x04 0xffffffff 0x05 0xffffffff 0x06>;
			io-channel-names = "auxadc4-usb_temp_v_l\0auxadc5-usb_temp_v_r\0auxadc3-chargeric_temp";
			pinctrl-names = "default\0charger_gpio_as_output_low\0charger_gpio_as_output_high\0ship_sleep\0ship_active\0dischg_enable\0dischg_disable\0chgvin_enable\0chgvin_disable\0pmic_chgfunc_enable\0pmic_chgfunc_disable";
			pinctrl-0 = <0x23>;
			pinctrl-1 = <0x24>;
			pinctrl-2 = <0x25>;
			pinctrl-3 = <0x26>;
			pinctrl-4 = <0x27>;
			pinctrl-5 = <0x28>;
			pinctrl-6 = <0x29>;
			pinctrl-7 = <0x2a>;
			pinctrl-8 = <0x2b>;
			pinctrl-9 = <0x2c>;
			pinctrl-10 = <0x2d>;
			qcom,input_current_charger_ma = <0x7d0>;
			qcom,pd_input_current_charger_ma = <0x7d0>;
			qcom,qc_input_current_charger_ma = <0x7d0>;
			qcom,input_current_usb_ma = <0x1f4>;
			qcom,input_current_cdp_ma = <0x5dc>;
			qcom,input_current_camera_ma = <0x4b0>;
			qcom,input_current_calling_ma = <0x5dc>;
			qcom,led_warm_bat_decidegc = <0x15e>;
			qcom,led_high_bat_decidegc = <0x172>;
			qcom,input_current_led_ma = <0x4b0>;
			qcom,input_current_led_ma_high = <0x5dc>;
			qcom,input_current_led_ma_warm = <0x5dc>;
			qcom,input_current_led_ma_normal = <0x7d0>;
			qcom,vooc_temp_bat_normal_decidegc = <0x15e>;
			qcom,vooc_temp_bat_warm_decidegc = <0x172>;
			qcom,vooc_temp_bat_hot_decidegc = <0x1fe>;
			qcom,input_current_vooc_led_ma_high = <0x4b0>;
			qcom,input_current_vooc_led_ma_warm = <0x708>;
			qcom,input_current_vooc_led_ma_normal = <0xe10>;
			qcom,input_current_vooc_ma_normal = <0xe10>;
			qcom,input_current_vooc_ma_warm = <0xc80>;
			qcom,input_current_vooc_ma_high = <0x898>;
			qcom,charger_current_vooc_ma_normal = <0x708>;
			qcom,iterm_disabled = <0x00>;
			qcom,iterm_ma = <0xd2>;
			qcom,recharge-mv = <0x64>;
			qcom,batt_capacity_mah = <0x1194>;
			qcom,removed_bat_decidegc = <0xbe>;
			qcom,cold_bat_decidegc = <0x64>;
			qcom,temp_cold_vfloat_mv = <0x1156>;
			qcom,temp_cold_fastchg_current_ma = <0x226>;
			qcom,little_cold_bat_decidegc = <0x00>;
			qcom,temp_little_cold_vfloat_mv = <0x1156>;
			qcom,temp_little_cold_fastchg_current_ma_high = <0x44c>;
			qcom,temp_little_cold_fastchg_current_ma_low = <0x44c>;
			qcom,temp_little_cold_fastchg_current_ma = <0x44c>;
			qcom,pd_temp_little_cold_fastchg_current_ma_high = <0x7d0>;
			qcom,pd_temp_little_cold_fastchg_current_ma_low = <0x5aa>;
			qcom,qc_temp_little_cold_fastchg_current_ma_high = <0x7d0>;
			qcom,qc_temp_little_cold_fastchg_current_ma_low = <0x5aa>;
			qcom,cool_bat_decidegc = <0x32>;
			qcom,temp_cool_vfloat_mv = <0x1156>;
			qcom,temp_cool_fastchg_current_ma_high = <0x44c>;
			qcom,temp_cool_fastchg_current_ma_low = <0x44c>;
			qcom,pd_temp_cool_fastchg_current_ma_high = <0x7d0>;
			qcom,pd_temp_cool_fastchg_current_ma_low = <0x7d0>;
			qcom,qc_temp_cool_fastchg_current_ma_high = <0x7d0>;
			qcom,qc_temp_cool_fastchg_current_ma_low = <0x7d0>;
			qcom,little_cool_bat_decidegc = <0x78>;
			qcom,temp_little_cool_vfloat_mv = <0x1156>;
			qcom,temp_little_cool_fastchg_current_ma = <0x44c>;
			qcom,pd_temp_little_cool_fastchg_current_ma = <0x7d0>;
			qcom,qc_temp_little_cool_fastchg_current_ma = <0x7d0>;
			qcom,normal_bat_decidegc = <0xa0>;
			qcom,temp_normal_vfloat_mv = <0x1156>;
			qcom,temp_normal_fastchg_current_ma = <0x44c>;
			qcom,pd_temp_normal_fastchg_current_ma = <0x7d0>;
			qcom,qc_temp_normal_fastchg_current_ma = <0x7d0>;
			qcom,warm_bat_decidegc = <0x1c2>;
			qcom,temp_warm_vfloat_mv = <0x1022>;
			qcom,temp_warm_fastchg_current_ma = <0x44c>;
			qcom,pd_temp_warm_fastchg_current_ma = <0x4b0>;
			qcom,qc_temp_warm_fastchg_current_ma = <0x4b0>;
			qcom,temp_warm_fastchg_current_ma_led_on = <0x1f4>;
			qcom,hot_bat_decidegc = <0x212>;
			qcom,non_standard_vfloat_mv = <0xf8c>;
			qcom,non_standard_fastchg_current_ma = <0x200>;
			qcom,short_c_bat_cv_mv = <0x10ea>;
			qcom,short_c_bat_vfloat_mv = <0xed8>;
			qcom,short_c_bat_fastchg_current_ma = <0x200>;
			qcom,cold_vfloat_sw_limit = <0x1121>;
			qcom,little_cold_vfloat_sw_limit = <0x1121>;
			qcom,cool_vfloat_sw_limit = <0x1121>;
			qcom,little_cool_vfloat_sw_limit = <0x1121>;
			qcom,normal_vfloat_sw_limit = <0x1121>;
			qcom,warm_vfloat_sw_limit = <0xff0>;
			qcom,non_standard_vfloat_sw_limit = <0xf5a>;
			qcom,short_c_bat_vfloat_sw_limit = <0xea6>;
			qcom,max_chg_time_sec = <0xfd20>;
			qcom,charger_hv_thr = <0x2710>;
			qcom,charger_recv_thr = <0x2648>;
			qcom,charger_lv_thr = <0xd48>;
			qcom,vbatt_full_thr = <0x1156>;
			qcom,vbatt_hv_thr = <0x11f8>;
			qcom,vfloat_step_mv = <0x08>;
			qcom,cold_vfloat_over_sw_limit = <0x115d>;
			qcom,little_cold_vfloat_over_sw_limit = <0x115d>;
			qcom,cool_vfloat_over_sw_limit = <0x115d>;
			qcom,little_cool_vfloat_over_sw_limit = <0x115d>;
			qcom,normal_vfloat_over_sw_limit = <0x115d>;
			qcom,warm_vfloat_over_sw_limit = <0x102c>;
			qcom,non_standard_vfloat_over_sw_limit = <0xf96>;
			qcom,vbatt_power_off = <0xce4>;
			qcom,vbatt_soc_1 = <0xcee>;
			qcom,vooc_project = <0x03>;
			qcom,vbatt_num = <0x02>;
			qcom,new_ui_warning_support;
			qcom,chargerid_support;
			qcom,ffc_support;
			qcom,dual_ffc;
			recharge_after_full;
			qcom,smart_charging_screenoff;
			qcom,vooc_show_ui_soc_decimal;
			qcom,ui_soc_decimal_speedmin = <0x14>;
			qcom,check_batt_full_by_sw;
			qcom,chg_ctrl_by_lcd;
			qcom,chg_ctrl_by_camera;
			qcom,chg_ctrl_by_calling;
			qcom,support_abnormal_adapter;
			qcom,external_gauge;
			qcom,chg_ctrl_by_vooc;
			qcom,hv_flashled_support;
			qcom,support_ntc_01c_precision;
			qcom,sw_vfloat_over_protect_enable;
			qcom,normal_vterm_hw_inc = <0x12>;
			qcom,non_normal_vterm_hw_inc = <0x12>;
			qcom,usbtemp_batttemp_gap = <0x0c>;
			qcom,ff1_normal_fastchg_ma = <0x226>;
			qcom,ff1_warm_fastchg_ma = <0x226>;
			qcom,ffc2_normal_fastchg_ma = <0x15e>;
			qcom,ffc2_temp_warm_decidegc = <0x15e>;
			qcom,ffc2_warm_fastchg_ma = <0x15e>;
			qcom,ffc2_temp_high_decidegc = <0x190>;
			qcom,ffc2_temp_low_decidegc = <0x78>;
			qcom,ff1_exit_step_ma = <0x96>;
			qcom,ff1_warm_exit_step_ma = <0x96>;
			qcom,ffc2_exit_step_ma = <0x96>;
			qcom,ffc2_warm_exit_step_ma = <0x96>;
			qcom,ffc_normal_vfloat_sw_limit = <0x115d>;
			qcom,ffc_temp_normal_vfloat_mv = <0x1194>;
			qcom,ffc_normal_vfloat_over_sw_limit = <0x1194>;
			qcom,ffc_warm_vfloat_sw_limit = <0x115d>;
			qcom,ffc2_normal_vfloat_sw_limit = <0x1158>;
			qcom,ffc2_temp_normal_vfloat_mv = <0x1194>;
			qcom,ffc2_normal_vfloat_over_sw_limit = <0x1194>;
			qcom,ffc2_warm_vfloat_sw_limit = <0x1156>;
			qcom,default_iterm_ma = <0xd2>;
			qcom,default_temp_normal_fastchg_current_ma = <0x44c>;
			qcom,default_normal_vfloat_sw_limit = <0x1121>;
			qcom,default_temp_normal_vfloat_mv = <0x1156>;
			qcom,default_normal_vfloat_over_sw_limit = <0x115d>;
			qcom,default_temp_little_cool_fastchg_current_ma = <0x44c>;
			qcom,default_little_cool_vfloat_sw_limit = <0x1121>;
			qcom,default_temp_little_cool_vfloat_mv = <0x1156>;
			qcom,default_little_cool_vfloat_over_sw_limit = <0x115d>;
			qcom,vbatt_pdqc_to_5v_thr = <0x1004>;
			qcom,vbatt_pdqc_to_9v_thr = <0xfa0>;
			qcom,chargerid_switch-gpio = <0xffffffff 0x19 0x00>;
			qcom,ship-gpio = <0xffffffff 0x6c 0x00>;
			qcom,dischg-gpio = <0xffffffff 0x8d 0x00>;
			qcom,chgvin = <0xffffffff 0x6f 0x00>;
			qcom,pmic_chgfunc = <0xffffffff 0x8e 0x00>;
		};
	};

	fragment@72 {
		target = <0xffffffff>;

		__overlay__ {

			eint0default {
				phandle = <0x23>;
			};

			charger_gpio_as_output_low {
				phandle = <0x24>;

				pins_cmd_dat {
					pinmux = <0x1900>;
					slew-rate = <0x01>;
					output-low;
				};
			};

			charger_gpio_as_output_high {
				phandle = <0x25>;

				pins_cmd_dat {
					pinmux = <0x1900>;
					slew-rate = <0x01>;
					output-high;
				};
			};

			ship_sleep {
				phandle = <0x26>;

				pins_cmd_dat {
					pinmux = <0x6c00>;
					slew-rate = <0x01>;
					output-low;
				};
			};

			ship_active {
				phandle = <0x27>;

				pins_cmd_dat {
					pinmux = <0x6c00>;
					slew-rate = <0x01>;
					output-high;
				};
			};

			dischg_enable {
				phandle = <0x28>;

				pins_cmd_dat {
					pinmux = <0x8d00>;
					slew-rate = <0x01>;
					output-high;
				};
			};

			dischg_disable {
				phandle = <0x29>;

				pins_cmd_dat {
					pinmux = <0x8d00>;
					slew-rate = <0x01>;
					output-low;
				};
			};

			chgvin_enable {
				phandle = <0x2a>;

				pins_cmd_dat {
					pinmux = <0x6f00>;
					slew-rate = <0x01>;
					output-low;
				};
			};

			chgvin_disable {
				phandle = <0x2b>;

				pins_cmd_dat {
					pinmux = <0x6f00>;
					slew-rate = <0x01>;
					output-high;
				};
			};

			pmic_chgfunc_enable {
				phandle = <0x2c>;

				pins_cmd_dat {
					pinmux = <0x8e00>;
					slew-rate = <0x01>;
					output-low;
				};
			};

			pmic_chgfunc_disable {
				phandle = <0x2d>;

				pins_cmd_dat {
					pinmux = <0x8e00>;
					slew-rate = <0x01>;
					output-high;
				};
			};
		};
	};

	fragment@73 {
		target = <0xffffffff>;

		__overlay__ {
			FUELGAGUE_APPLY = <0x00>;
			DISABLE_MTKBATTERY = <0x01>;
		};
	};

	fragment@74 {
		target = <0xffffffff>;

		__overlay__ {

			vooc_ap_data {
				compatible = "mediatek, VOOC_AP_DATA-eint";
				interrupts = <0x62 0x02 0x62 0x00>;
				phandle = <0xa0>;
			};

			vooc_ap_data_new_function {
				compatible = "mediatek, VOOC_EINT_NEW_FUNCTION";
				phandle = <0xa1>;
			};
		};
	};

	fragment@75 {
		target = <0xffffffff>;

		__overlay__ {
			status = "okay";
			clock-frequency = <0x186a0>;
			scl-gpio-id = <0x86>;
			sda-gpio-id = <0x87>;

			bq27541-battery@55 {
				status = "okay";
				compatible = "oplus,bq27541-battery";
				reg = <0x55>;
				qcom,modify-soc-smooth;
				qcom,modify-soc-calibration;
				qcom,batt_bq28z610;
				qcom,sha1_key_index = <0x01>;
			};

			rk826_fastcg@0a {
				status = "okay";
				compatible = "oplus,rk826-fastcg";
				reg = <0x0a>;
				qcom,support_vooc_by_normal_charger_path;
				qcom,vooc-version = <0x05>;
				qcom,vooc_fw_update_newmethod;
				qcom,vooc-fw-type = <0x03>;
				qcom,vooc_reply_mcu_bits = <0x07>;
				qcom,parse_fw_from_dt;
				vooc,firmware_data = <0x3455 0xec370000 0x64000000 0x64000000 0xf413b89a 0x4e288571 0x00 0x00 0x00 0x00 0x00 0x00 0x00 0x00 0x00 0x00 0x00 0x00 0x00 0x00 0x00 0x00 0x00 0x00 0x00 0x00 0x00 0x00 0x00 0x00 0x00 0x00 0x80020 0xd010021 0xa9090021 0x79090021 0x00 0x00 0x00 0x00 0x00 0x00 0x00 0x2b0a0021 0x00 0x00 0x290a0021 0x2d0a0021 0x2f010021 0x11090021 0x2f010021 0x310a0021 0x2f010021 0x2f010021 0x2f010021 0x2f010021 0x490b0021 0x2f010021 0x2f010021 0x2f010021 0x3488546 0xf0dcfb 0x480047 0x9d200021 0x80020 0x401efdd8 0x70470000 0x8480949 0x1600820 0xc0000120 0x80f31088 0xbf00bf 0x5480047 0xfee7fee7 0xfee7fee7 0xfee7fee7 0x250 0x800080 0xf1000021 0x30b50b46 0x1460020 0x20220124 0x9e00d46 0xd5409d42 0x5d31d46 0x9540491b 0x25469540 0x40191546 0x521e002d 0xf1dc30bd 0x70b50024 0x25460028 0x1da0124 0x40420029 0x1da0125 0x4942fff7 0xddffac42 0xd04042 0x2c00d0 0x494270bd 0xf8b50246 0x4a40d40f 0x42004b00 0x52085b08 0x9a4202d2 0x2460846 0x11464a00 0x23d0c30d 0x4a00ddb2 0x120ead1a 0x202d35da 0x49020126 0x490af605 0x8a19002c 0xd05242 0x20214f1b 0x1146b940 0x2a411018 0xc20d9a42 0x21d0002c 0x17d0012d 0x8dcda05 0x801ad20f 0x8019d207 0xdbb200f0 0xc4faf8bd 0xda05801a 0x1234000 0x1b06c018 0x80185a42 0x8018ca0f 0x10434900 0x7e04908 0xc2071143 0xda05801a 0x80194008 0x801800f0 0xa4faf8bd 0x61000122 0x511a001b 0xf7e70122 0xd2075140 0xaae70122 0xd2075040 0xa6e70246 0x70b54a40 0xd30fdb07 0x40002dd0 0x4a002ad0 0x10e140e 0x21202 0x919400a 0x520a8418 0xe5010446 0x5443000a 0x120a2e04 0x5043a419 0x4219200c 0xc543aa18 0x120c0125 0xad03521c 0x52191204 0x7f392404 0xd0521c 0x104301d4 0x4000491e 0xc2b20c06 0xc0092018 0x401c4008 0x802a02d0 0x3e00020 0x70bd4008 0x40000029 0xda0020 0x184370bd 0x70b50246 0x4a40d50f 0x40004a00 0xed074008 0x52080028 0x14d0002a 0x12d0c40d 0xd30d4102 0x120c005 0x5202490a 0x520ae41a 0x9181218 0x7d349142 0x1d3641c 0xe04900 0x2c01da 0x2070bd 0x239142 0x1d3891a 0x3434008 0x49000028 0xf7d10029 0xad09142 0x2d10121 0xc90705e0 0x914201d2 0x12101e0 0x121c943 0xe005c018 0x401900f0 0x1cfa70bd 0xf0b50746 0x8465840 0x87b0c00f 0x4904800 0xe465900 0x40084908 0xbc1a8841 0x5d23846 0x31461e46 0x17460b46 0x2465800 0x40081043 0x4cd0300d 0x3904005 0x5900400d 0x490d0590 0x401a0290 0x402872da 0x18030121 0xb0905 0x8430190 0x4980092 0x2805d0 0x1995242 0x208841 0x920190 0x2984021 0xa1a0199 0x9800f0 0xbdf90546 0xc466b46 0x7cb00f0 0xc7f9c019 0x7141039a 0xe0d0023 0xd7175640 0x1a467a40 0x164344d0 0x49a002a 0x2dd0029a 0x12a039a 0x15dc1205 0xc01a9141 0x1263605 0x1c7141 0xd20f059e 0xd2070093 0x1920296 0x2a462346 0xf005fa 0x7b0f0bd 0x38463146 0xfae71605 0x224a0f46 0xb218c01a 0xb7410121 0x905001c 0x4f410018 0x7f411146 0x18187941 0xe20f1043 0x6d196441 0x13e0e207 0x6d081543 0x6408c207 0x1443039a 0x1261205 0xc01a9141 0x3605001c 0x7141ce07 0x40083043 0x4908c018 0x51412a46 0x234600f0 0xc7f9cde7 0xffe70498 0x1224000 0xc117121a 0x238b41 0x4983146 0xc417381a 0xa141eee7 0x30b40124 0xe4076340 0x30bc55e7 0x30b40124 0xe4076140 0x30bc4fe7 0xe0ff 0xf0b51fb4 0x88b00b99 0x9980024 0x48400999 0xc00f4900 0x49080991 0xc0070b99 0x904900 0x49080b91 0x9990898 0xa6460843 0x1cd00b99 0xa980843 0x18d00998 0x1244000 0x420d4800 0x410d0998 0x24050003 0xb2043 0x9900b98 0x3000b 0x20430b90 0x50181c49 0x40180022 0x1901446 0x104605e0 0x200146 0xdb0f0bd 0x32801da 0x34600e0 0x3239c46 0xc11a0aae 0xae05f00 0x8aded5b 0x4f00f75b 0x7d430027 0xaa187c41 0x491c5b1e 0x6145f2dd 0x410004ab 0x5a522104 0x120c0a43 0x240c401c 0x828dfdb 0x1980290 0x997046 0x1910090 0x59b049a 0x7990698 0xf053f9 0xd0e70000 0xdfcffff 0xf0b50c46 0x5c4085b0 0xe40fe407 0x3944c00 0x266408 0x59009446 0x49080246 0x2962243 0x21d06246 0xa431ed0 0x6200570d 0x4a000e03 0x2303550d 0x1240246 0x2c492405 0x781b1b0b 0x360b4018 0x23432643 0x61460090 0x1c46501a 0xb44103d3 0x98401c 0x9002e0 0x92180098 0x5b410028 0x3da0020 0x14605b0 0xf0bd0020 0x1210905 0x7468646 0x11e06446 0x1d46141b 0xb54106d3 0x6546521b 0xb3417446 0x7430c43 0xa646cd07 0x40084908 0x28439218 0x5b410546 0xd43ead1 0x10461843 0x13d06046 0x19465040 0x71400843 0x6d06046 0x101ab341 0x6d20122 0x2306e0 0x220123 0xdb0702e0 0x122d243 0x53100098 0x74460105 0x381c6141 0x29c039d 0x196941 0xf0cef8 0xbfe70000 0xfd030000 0xc217c10f 0x504010b5 0x4018ca07 0x96230021 0xf087f8 0x10bd10b5 0x229623 0x114600f0 0x80f810bd 0xc20f4100 0x40020123 0x400adb05 0xd207090e 0xc0187f29 0x1da0020 0x70479629 0x3dc9623 0x591ac840 0x1e09639 0x8840002a 0xf4d04042 0x7047c20f 0xd2074000 0x40080bd0 0xc10d0723 0xdb01c918 0x40020905 0x400a1143 0xc2084007 0x11437047 0x200146 0x7047cb0f 0xdb074900 0x10b54908 0x2460a43 0x7d00a0d 0x7240903 0xe401090b 0x121b002a 0x1dc0020 0x10bdc900 0x440f0c43 0xc100e018 0xd2058018 0xf02ff8 0x10bd0000 0x122d207 0x2800db 0x101a0029 0xdb511a 0x81427047 0x10b5202a 0x4db0146 0x203a9140 0x2010bd 0x91402023 0x9c1a0346 0xe3401943 0x904010bd 0x10b5202a 0x6dbcb17 0x846203a 0x1041c117 0xb4306e0 0xb461341 0xd0402024 0xa21a9140 0x8431946 0x10bd0029 0x4da401c 0x490001d1 0x40084000 0x704770b4 0x24050c 0x5d11024 0x402d1 0x2921d0 0x1124050e 0x1d10002 0x834050f 0x1d10001 0x241d850f 0x1d18000 0xa41c0028 0x1db4000 0x641c0029 0x8d02025 0x2e1b0d46 0xf540a140 0xd00121 0x29430843 0x1061b1b 0xadb1d 0x2d50020 0x70bc7047 0xdb051818 0x80180029 0xf8da401c 0x4900f5d1 0x70bc4008 0x40007047 0x10b5002b 0x8da0024 0x401c6141 0x92185b41 0x1a4301d1 0x40084000 0x10bdf0b5 0x1fb482b0 0x5460c00 0x3d00846 0xf0a2f9 0x2e000f0 0x9ff92030 0x2460090 0x21462846 0xfff77cff 0x49b059a 0x4460f46 0x18431143 0x84314d0 0x18461043 0x1bd00098 0x40210a1a 0x18460599 0xf040f8 0x5460e46 0x9a0599 0x498fff7 0x63ff0843 0x5d00120 0x4e02046 0x394607b0 0xf0bd0020 0xc1170543 0xe432c43 0x37430099 0xe986305 0x401a7905 0xe40a0022 0xc43fd0a 0xa3002d5 0x200146 0xe9e70105 0x10196941 0xc9c0d9d 0x196941 0xfff7a2ff 0xdfe70000 0x64c0125 0x64e05e0 0xe36807cc 0x2b430c3c 0x98471034 0xb442f7d3 0xfff716fc 0xd8370021 0xe8370021 0x10b5202a 0x4db0846 0x203ad040 0x2110bd 0xb46d340 0xd0402024 0xa21a9140 0x8431946 0x10bd10b5 0x4462001 0x9fff7 0x1fc10bd 0xbf0146 0x401e0029 0xfbd17047 0x10b502f0 0x4ff90446 0x80202040 0x2818d0 0x802002f0 0x41f91048 0x780028 0x7d102f0 0x8bfc0020 0xd490870 0x1200b49 0x8700c48 0x780228 0x2d100f0 0x3ff90ce0 0xf004fd 0x9e04020 0x20400028 0x5d04020 0x2f024f9 0x1200449 0x87010bd 0x71010020 0x38010020 0x5f010020 0x11010020 0xbffee7 0x70b50446 0xd461646 0x2b463246 0x21465520 0x2f0d4f9 0x70bd70b5 0x4460d46 0x16462b46 0x32462146 0x552002f0 0x67fa70bd 0x70470000 0x70b50021 0x230f22 0xc478002c 0x25d0194c 0xe4680725 0x2d022c40 0x2c1b210a 0x424631a 0x1446cc40 0x22464478 0x9c402146 0x84781440 0x21430901 0x104c0325 0x2d026419 0x578ad00 0x61510478 0xe506ed0e 0x124ac40 0x5786d11 0xad00094e 0xad192c60 0xae00478 0xe506ed0e 0x124ac40 0x44d8035 0x6787611 0xb600ac51 0x70bd0000 0xed00e0 0xe100e0 0x70477047 0x70470000 0x10b50020 0x2f0c2fa 0x37480088 0x2805d0 0x35480088 0x401e3449 0x88015e0 0x7d20c000 0x31490880 0x31480088 0x2804d0 0x2f480088 0x401e2e49 0x8802e48 0x880028 0x4d02c48 0x88401e 0x2a490880 0x2a480068 0x2804d0 0x28480068 0x401e2749 0x8602748 0x680028 0x4d02548 0x68401e 0x23490860 0x23480068 0x2804d0 0x21480068 0x401e2049 0x8602048 0x780028 0x4d01e48 0x78401e 0x1c490870 0x1c480068 0x2804d0 0x1a480068 0x401e1949 0x8601948 0x680028 0x4d01748 0x68401e 0x15490860 0x15480078 0x401c1449 0x8700846 0x78c828 0xedd0020 0x8701148 0x780028 0x5d00020 0x1f064fa 0x1200e49 0x8700120 0xb490870 0x10bd0000 0x3a010020 0x3c010020 0x3e010020 0x40010020 0x44010020 0x48010020 0x4c010020 0x50010020 0x54010020 0x38010020 0x24010020 0x10010020 0x4480069 0x2804d0 0x1200249 0x48617620 0xc8607047 0x140 0x2021020c 0x1d01021 0x1046020a 0x1d01046 0x8390209 0x1d01046 0x91f8208 0x1d01046 0x891e4208 0x1d0881e 0x7047081a 0x704730b4 0x7446641e 0x2578641c 0xab4204d3 0x635d5b00 0xe31830bc 0x18471d46 0xf8e702e0 0x8c8121f 0x8c1002a 0xfad17047 0x70470020 0x1e001c1 0x121f002a 0xfbd17047 0x10b5fe48 0x780828 0xbda01f0 0x13fafc49 0xfa4a1278 0x8854f948 0x78401c 0xf7490870 0x10bdf648 0x780828 0x29d10920 0xf3490870 0x2f072fa 0xf2480078 0x12821d1 0xf0484078 0x281dd1 0xee488078 0x12819d1 0xec48c078 0xc000eb49 0x9798900 0x843e949 0x49794900 0x843e749 0x89790843 0xe6490870 0x20e649 0x870e648 0x780028 0xd6d1e549 0x8708fe0 0xdf480078 0x12820d1 0xdd484078 0x281cd1 0xdb488078 0x2818d1 0xd948c078 0xc000d849 0x9798900 0x843d649 0x49794900 0x843d449 0x89790843 0xd3490870 0x20d349 0x870d349 0x8700220 0xd2490870 0x6ae0cd48 0x40780128 0x21d1cb48 0x80780028 0x1dd1c948 0xc0780128 0x19d1c748 0x79c000 0xc5494979 0x89000843 0xc3498979 0x49000843 0xc149c979 0x843c149 0x8700020 0xc0490870 0xc0480078 0x2801d1 0xbf490870 0x84e7ba48 0x40780128 0x20d1b848 0x80780028 0x1cd1b648 0xc0780028 0x18d1b448 0x79c000 0xb2494979 0x89000843 0xb0498979 0x49000843 0xae49c979 0x843ae49 0x8700020 0xad490870 0xad490870 0x220ad49 0x8705fe7 0xa748c078 0xc000a649 0x9798900 0x843a449 0x49794900 0x843a249 0x89790843 0xa1490870 0x220a349 0x870a048 0x780028 0x5d19e48 0x78401c 0x9c490870 0x2e00120 0x9d490870 0x9d480078 0x2814d1 0x9c49c870 0x8714871 0x8871c871 0x8724872 0x99480078 0x22809d1 0x90480078 0x7000e 0x96490870 0x1209349 0x487141e2 0x92480078 0x1280ad1 0x91480078 0x88490978 0x8438f49 0x8700120 0x8b494871 0x32e28d48 0x780528 0x16d18848 0x807a8749 0xc8700846 0xc07a0871 0x846007b 0x48710846 0x407b8871 0x846807b 0xc8710846 0xc07b0872 0x846007c 0x487217e2 0x7f480078 0x42809d1 0x74480078 0x7000c 0x7c490880 0x1207749 0x487109e2 0x78480078 0x3280bd1 0x6d480078 0x27649 0x9880843 0x74490880 0x1206f49 0x4871f9e1 0x70480078 0x2280bd1 0x65480078 0x16e49 0x9880843 0x6c490880 0x1206749 0x4871e9e1 0x68480078 0x12815d1 0x67480088 0x5c490978 0x8436549 0x88000f0 0xa3fb0120 0x5e494871 0x62480088 0x60490988 0x884290d1 0x1206049 0x870cfe1 0x5f480078 0x284cd0 0x5d480078 0x401ec100 0x81a5c49 0x968085c 0x5249c870 0x58480078 0x401ec100 0x81a5749 0x9684018 0x40784d49 0x8715348 0x78401e 0xc100081a 0x51490968 0x40188078 0x47494871 0x4d480078 0x401ec100 0x81a4c49 0x9684018 0xc0784249 0x88714848 0x78401e 0xc100081a 0x46490968 0x40180079 0x3c49c871 0x42480078 0x401ec100 0x81a4149 0x9684018 0x40793749 0x8723d48 0x78401e 0xc100081a 0x3b490968 0x40188079 0x31494872 0x7ee12a48 0x780928 0xcd10020 0x2e490870 0x2f490870 0x32490870 0x1f04af8 0x1203249 0x87051e6 0x202849 0x8702949 0x8702c49 0x8701e48 0x780300 0xfff719fe 0x10ee0984 0xa0d6ef20 0x20202020 0x20f7ebea 0xe9202748 0x780028 0x13d02648 0x780028 0x6d10120 0x1849c870 0x8710872 0x487202e0 0x1201549 0x88711f48 0x78c043 0x1d490870 0x3fe11d48 0x780028 0x38d00120 0xe49c870 0x8714871 0x8871c871 0x8724872 0x16480078 0x401e1549 0x8702ce1 0x21010020 0x19010020 0x23010020 0x15010020 0x60010020 0x5f010020 0x12010020 0x22010020 0x84010020 0x25010020 0x26010020 0x28010020 0x2c010020 0x2e010020 0x30010020 0x29010020 0x10020 0x18010020 0x37010020 0x5e010020 0x58010020 0xb0480068 0xb0498842 0x1da0024 0x7e0ad49 0x968ad4a 0x881a0a21 0xfff79af8 0x4466006 0xc00faa49 0xc870a006 0xc00f0871 0xe006c00f 0x48712007 0xc00f8871 0x6007c00f 0xc871a007 0xc00f0872 0xe007c00f 0x4872dce0 0x3214903 0x5200003 0x2f0b6fa 0x9d490870 0x8460078 0x22803d1 0x1209949 0x8710ae0 0x98480078 0x12803d1 0x95490871 0x487102e0 0x1209349 0x4871c0e0 0x1209349 0x8709348 0x784006 0xc00f8e49 0xc8709048 0x788006 0xc00f0871 0x8d480078 0xc006c00f 0x48718b48 0x780007 0xc00f8871 0x88480078 0x4007c00f 0xc8718648 0x788007 0xc00f0872 0x83480078 0xc007c00f 0x48720020 0x81490870 0x7f480078 0x64214843 0xff302d30 0x7e490880 0xa207e49 0x8708ae0 0x7d480078 0x2807d0 0x207c49 0x8707a48 0x78401e 0x78490870 0x78480078 0x6f49c870 0x1204871 0x77e03ee0 0x3ce022e0 0x9e000e0 0x37e00320 0x72490870 0x1206849 0x8718871 0x69e07048 0x780028 0x3d06f48 0x780028 0xd160e0 0x6b480078 0x401e6a49 0x8700620 0x6a490870 0xf086ff 0x69490870 0xf0c0f9 0x51e06848 0x78401c 0x67490870 0x65480078 0x801c6649 0x8706648 0x785449 0xc8706548 0x780871 0x64480078 0x48716448 0x788871 0x39e001e0 0xe000bf 0x61480078 0x282fd0 0x4c480078 0x282bd0 0x5e480078 0x32803d1 0x1205d49 0x8700be5 0x5a480078 0x401c5949 0x8704049 0x968404a 0x881a0a21 0xfef7c0ff 0x4466006 0xc00f3d49 0xc870a006 0xc00f0871 0xe006c00f 0x48712007 0xc00f8871 0x6007c00f 0xc871a007 0xc00f0872 0xe007c00f 0x487202e0 0x1f0daff 0xe4e400bf 0x3049484a 0x1278885c 0x1f062ff 0x45480078 0x401c4449 0x8700846 0x780928 0x4cdd0420 0xf0aefa 0x52000f0 0xabfa01f0 0x3bff0020 0x3c490870 0x3c490870 0x3c490870 0x2a480078 0x2805d0 0x28480078 0x401e2749 0x87033e0 0x28480078 0x2805d0 0x26480078 0x401e2549 0x87029e0 0x26480078 0x280ad0 0x24480078 0x401e2349 0x8702348 0x78401e 0x21490870 0x1ae02b48 0x780228 0x2d00428 0x13d10ae0 0xd480078 0x12805d1 0x12480078 0x12801d1 0xf086fe 0x7e00120 0x11490870 0xf0d6fe 0x20490870 0xbf00bf 0xbf85e4 0xc010020 0x4c0d0000 0x84010020 0x70010020 0x14010020 0x59010020 0x58010020 0x62010020 0x64010020 0x60010020 0x17010020 0x25010020 0x27010020 0x34010020 0x28010020 0x36010020 0x4010020 0x29010020 0x2a010020 0x6010020 0x7010020 0x8010020 0x9010020 0x67010020 0x16010020 0x13010020 0x22010020 0x21010020 0x24010020 0x23010020 0x35010020 0x10b55d48 0x780828 0xbda00f0 0x4bfe5b49 0x594a1278 0x88545848 0x78401c 0x56490870 0x10bd5548 0x780828 0x61d10920 0x52490870 0x1f0aafe 0x51480078 0x1281bd1 0x4f484078 0x2817d1 0x4d488078 0x12813d1 0x4b48c078 0xc0004a49 0x9798900 0x8434849 0x49794900 0x8434649 0x89790843 0x45490870 0x204549 0x8703ce0 0x41484078 0x1281bd1 0x3f488078 0x2817d1 0x3d48c078 0x12813d1 0x3b480079 0xc0003a49 0x49798900 0x8433849 0x89794900 0x8433649 0xc9790843 0x35490870 0x203549 0x870b5e7 0x3148c078 0xc0003049 0x9798900 0x8432e49 0x49794900 0x8432c49 0x89790843 0x2b490870 0x2b480078 0x2805d1 0x29480078 0x401c2849 0x87002e0 0x1202749 0x8702748 0x780028 0x22d10120 0x25498870 0x20c870 0x8714871 0x8871c871 0x8724872 0x1c480078 0x42802d0 0x6280cd1 0x7e01e48 0x781c49 0xc8700120 0xc8714872 0x7e00120 0x1849c870 0x3e00120 0x18490870 0x72e700bf 0x1449134a 0x1278885c 0x1f028fe 0x10480078 0x401c0f49 0x8700846 0x780928 0xbdd0420 0xf074f9 0x1f004fe 0x200949 0x8700349 0x8700b49 0x87000bf 0x54e70000 0x21010020 0x19010020 0x23010020 0x15010020 0x12010020 0x22010020 0x84010020 0x17010020 0x13010020 0x24010020 0x28480078 0x40022849 0x9784900 0x8432749 0x8802448 0x784006 0xc00f2549 0x48712148 0x788006 0xc00fc872 0x1e480078 0xc006c00f 0x8721c48 0x780007 0xc00f0874 0x19480078 0x4007c00f 0x88731748 0x788007 0xc00f4873 0x14480078 0xc007c00f 0xc8711348 0x784006 0xc00fc870 0x10480078 0x8006c00f 0x8730e48 0x78c006 0xc00f0871 0xb480078 0x7c00f 0x88720948 0x784007 0xc00f4872 0x6480078 0x8007c00f 0xc8730448 0x78c007 0xc00f8871 0x70470000 0x35010020 0x36010020 0x2e010020 0x84010020 0x3480088 0x3490840 0x1490880 0x70470000 0x2c010020 0xfefe0000 0x70b50446 0x1200003 0x844206d1 0x1f086f8 0x204601f0 0xa3f90546 0x22e00120 0x40038442 0x6d101f0 0x7bf82046 0x1f098f9 0x54617e0 0x7200003 0x84420cd1 0x1f070f8 0x204601f0 0x8df90546 0x4b21c900 0x284602f0 0x31f80546 0x6e02046 0x1f062f8 0x204601f0 0x7ff90546 0x284670bd 0x70477047 0x38b50446 0x6a460221 0x2046fff7 0xa1f96946 0x48780002 0x9780843 0x5b2062c 0x2d10248 0x281805b2 0x284638bd 0x55f5ffff 0x7cb511a0 0x680190 0x1aa0221 0x3e20fff7 0x94f900f0 0x94f86a46 0x4214020 0xfff782f9 0x68464078 0x1026846 0x780143 0xc466846 0xc0780002 0x69468978 0x8430546 0xac4201da 0x28467cbd 0x2046fce7 0x71000000 0x10b50120 0x3fff7 0x8bff0446 0x1249fff7 0x2ff810d3 0x1204003 0xfff782ff 0x4460e49 0xfff726f8 0x7d30020 0xfff77aff 0x4460a49 0xfff71ef8 0x5d20948 0x78401c 0x7490870 0x2e00020 0x5490870 0x4480078 0x92801dd 0x12010bd 0x20fce7 0x5343 0x5d010020 0x10b50446 0x2c02d0 0x2000f0 0x3bff0122 0x11468020 0x1f084fa 0x2c02d0 0x12000f0 0x31ff10bd 0x10b50446 0x2c02d0 0x2000f0 0x29ff0122 0x11464020 0x1f072fa 0x2c02d0 0x12000f0 0x1fff10bd 0x10b50024 0xbf03e0 0xf005f8 0x601cc4b2 0x192cf9db 0x10bd10b5 0xf017f8 0xf015f8 0xf013f8 0xf011f8 0x10bd10b5 0x240a24 0x3e000f0 0xaf8601e 0xc4b2002c 0xf9dc10bd 0x10b50320 0xfff7b8f8 0x10bd10b5 0x2220fff7 0xb3f810bd 0x70b50446 0x254603e0 0xfff7f5ff 0x681ec5b2 0x2df9dc 0x70bd7047 0x8ab00020 0x9900890 0x260027 0x7900690 0x5900490 0x3900290 0x190e120 0x4001fe49 0x880c320 0x8000fd49 0x880fd48 0xfd490860 0xfd490860 0xa20fd49 0x8707ae3 0x1f07cff 0xfb480068 0x283ad1 0x582001f0 0x2dfd0546 0xf8480078 0x282dd1 0x1f2d05d1 0xf0dcfb 0x120f449 0x87018e0 0x2d03d1 0x712001f0 0xbbfc12e0 0xc2d02db 0x3f200090 0xde0022d 0x7db0b2d 0x5dc681c 0x81004018 0xc0b20090 0x3e0012d 0x1d10f20 0x90e748 0x780028 0x8d1e648 0x278e648 0x780099 0x1f070fc 0xe1490870 0x7d200001 0xdd490860 0x36e3d948 0x680028 0x70d10c20 0xfff7d4fe 0x746dd48 0x874205dd 0xfff773ff 0xc20fff7 0xcbfe0746 0x3c4600bf 0xd3480078 0x2872d1 0xd6488442 0xada0798 0x401cc0b2 0x7900798 0x22805dd 0x772001f0 0x71fc01e0 0x200790 0xcd488742 0x2dd7520 0x1f068fc 0xcc488442 0xadd0398 0x401cc0b2 0x3900398 0x22805dd 0x742001f0 0x5bfc01e0 0x200390 0xc5480078 0x12853d1 0xc4480068 0xc4498842 0x2dd0520 0x69025e0 0xc0480068 0xc049491f 0x884202dd 0x4200690 0x1ce0bc48 0x68bc49 0x14398842 0x2dd0320 0x69013e0 0xb7480068 0xb7491e39 0x884202dd 0x2200690 0xae0b348 0x68b349 0x28398842 0x2dd0120 0x69001e0 0x200690 0xaf488442 0x3dd0020 0x590d2e0 0x17e1ac48 0x64388442 0x2dd0120 0x590cae0 0xa848c838 0x844202dd 0x2200590 0xc3e0a648 0x844203dd 0x3200590 0xbde0f9e0 0xa2486438 0x844202dd 0x4200590 0xb5e00520 0x590b2e0 0x99480078 0x22853d1 0x98480068 0x98498842 0x2dd0520 0x69025e0 0x94480068 0x9449491f 0x884202dd 0x4200690 0x1ce09048 0x689049 0x14398842 0x2dd0320 0x69013e0 0x8b480068 0x8b491e39 0x884202dd 0x2200690 0xae08748 0x688749 0x28398842 0x2dd0120 0x69001e0 0x200690 0x83489630 0x844202dd 0x200590 0x79e08048 0x64308442 0x2dd0120 0x59072e0 0xe1208000 0x844202dd 0x2200590 0x6be07a48 0x64308442 0x2dd0320 0x59064e0 0x4b20c000 0x844202dd 0x4200590 0x5de00520 0x5905ae0 0x6d480078 0x32852d1 0x6c480068 0x6f498842 0x2dd0520 0x69025e0 0x68480068 0x6b493c39 0x884202dd 0x4200690 0x1ce06448 0x686749 0x64398842 0x2dd0320 0x69013e0 0x5f480068 0x7d214901 0x884202dd 0x2200690 0xae05b48 0x685e49 0xa0398842 0x2dd0120 0x69001e0 0x200690 0x57488442 0x2dd0020 0x59022e0 0x19204001 0x844202dd 0x1200590 0x1be04b20 0xc0008442 0x2dd0220 0x59014e0 0xff20c330 0x844202dd 0x3200590 0xde0ff20 0x2d308442 0x2dd0420 0x59006e0 0x5200590 0x3e00020 0x6900520 0x5900599 0x6984018 0x5280add 0x298401c 0xc0b20290 0x2980528 0x5dd5a20 0x1f03efb 0x1e00020 0x2903d48 0x888442 0x11dd3b48 0x883b49 0x88420cdd 0x3a480078 0x2805d0 0x38480078 0x401e3749 0x87002e0 0x552001f0 0x25fb2d48 0x682d49 0x24398842 0xfdd3248 0x84420cdd 0x1e480078 0x401e1d49 0x8700846 0x780028 0x6d15520 0x1f010fb 0x2e00a20 0x17490870 0x7d20c000 0x13490860 0xa8e12748 0x680028 0x7ed1fff7 0x5dfd0646 0x24488642 0x3dc7d20 0x18642 0xedafff7 0xe2fdfff7 0x51fd0646 0x1e488642 0x3dc7d20 0x18642 0x2da7620 0x1f0eafa 0xf4833e0 0x3c010020 0x3e010020 0x204e0000 0x44010020 0x50010020 0x65010020 0x48010020 0x37010020 0x58010020 0x33010020 0x5a010020 0x10270000 0x30f8ffff 0x4c1d0000 0xb010020 0xc010020 0x8a110000 0xb6030000 0x8a020000 0x22100000 0x62010020 0xfc080000 0x64010020 0xe40c0000 0x40010020 0x88130000 0x660ac48 0x780028 0x7ed1ab48 0x880028 0x7d1aa48 0x783f28 0x1edd3f20 0xa7490870 0x1ae0a548 0x88ff21 0x2d318842 0x7daa348 0x783f28 0x10dd3f20 0xa0490870 0xce09e48 0x88ff21 0xe1318842 0x6da9c48 0x783228 0x2dd3220 0x99490870 0x99480078 0x2800e0 0xa0e019d1 0x97480068 0x97498842 0x7dd9348 0x783f28 0x10dd3f20 0x90490870 0xce09148 0x689149 0xfa398842 0x6dd8c48 0x783f28 0x2dd3f20 0x89490870 0x8a480068 0x8a499639 0x884207dd 0x85480078 0x3f281edd 0x3f208349 0x8701ae0 0x83480068 0x2121c901 0x884207dd 0x7e480078 0x3f2810dd 0x3f207c49 0x8700ce0 0x7c480068 0x7c49e639 0x884206dd 0x77480078 0x3f2802dd 0x3f207549 0x8707848 0x780028 0x9d17748 0x2787748 0x1787048 0x7801f0 0x7fa7249 0x87000e0 0x44e07348 0x780228 0x8d16c48 0x686c49 0x14398842 0x2dd5a20 0x1f022fa 0x6d480078 0x1281ad1 0x65480068 0x6b498842 0x2dd5a20 0x1f016fa 0x61480068 0x67490a39 0x88420add 0x898401c 0xc0b20890 0x8980528 0x5dd5a20 0x1f006fa 0x1e00020 0x8905848 0x685849 0x32318842 0x2dd5a20 0x1f0faf9 0x53480068 0x53492831 0x88420add 0x998401c 0xc0b20990 0x9980528 0x5dd5a20 0x1f0eaf9 0x1e00020 0x990ff20 0xf5305149 0x86083e0 0x50480068 0x282ad1 0x620fff7 0x21fc0446 0x3f480078 0x281dd1 0x2c0edd 0x46480078 0x2803d1 0xff20f530 0x844206dc 0x42480078 0x1280dd1 0x44488442 0xadd0498 0x401cc0b2 0x4900498 0x22805dd 0x5c2001f0 0xbbf901e0 0x200490 0xff20f530 0x3a490860 0x54e03b48 0x680028 0x1ed12a48 0x780028 0xed1fff7 0x2bfc0028 0x5d00020 0xf0bcf8 0x1202449 0x8701920 0x40013149 0x8603de0 0x1980028 0x4d15d20 0x1f0f6f9 0x1200190 0x2c482b49 0x86031e0 0x2b480078 0x282dd1 0x2a480088 0x2806d1 0x16480078 0x2802d1 0x5a2001f0 0x81f92648 0x780028 0x2d05920 0x1f07af9 0x23480078 0x2802d0 0x732001f0 0x73f92148 0x780028 0x2d07220 0x1f06cf9 0x1e480078 0x2803d1 0x1d480078 0x12802dd 0x542001f0 0x61f91420 0x13490870 0x2f20fff7 0x5bfc83e4 0x37010020 0x3e010020 0x5a010020 0x5b010020 0xc010020 0x62110000 0x58010020 0x33010020 0x32010020 0x66010020 0xa010020 0x2c100000 0x40010020 0x50010020 0x26020000 0x54010020 0x10270000 0x4c010020 0x3c010020 0x18010020 0x13010020 0x12010020 0x10010020 0x61010020 0x30e001f0 0xcffb1848 0x680028 0xad15820 0x1f080f9 0x2801d1 0x1f02cf9 0x13481249 0x8601fe0 0x12480078 0x281bd1 0x11480078 0x2802d0 0x732001f0 0xdf90f48 0x780028 0x2d07220 0x1f006f9 0xc480078 0x2803d1 0xb480078 0x12802dd 0x542001f0 0xfbf81420 0x3490870 0xcde70000 0x48010020 0x70170000 0x4c010020 0x13010020 0x12010020 0x10010020 0x61010020 0x2803d0 0x549064a 0x516003e0 0x1210904 0x34a5160 0x3490870 0x70470000 0x1000100 0x550 0x67010020 0x70470000 0x149487c 0x70470000 0x40000350 0x10b52020 0xf036fe 0x4462046 0x10bd0000 0x3480078 0x2801d1 0x1207047 0x20fce7 0x67010020 0x10b50320 0x400300f0 0x69fd0149 0x86010bd 0x68010020 0x10b50122 0x210820 0xf0c0fd 0xfff7a3fb 0x82000f0 0x13fe0446 0x2c06d0 0x1200549 0x8706420 0x4490880 0x2e00020 0x1490870 0x10bd0000 0x6c010020 0x6e010020 0x10b50020 0xf0a4ff 0xc4b26406 0x640e2046 0x10bd10b5 0x210846 0xf00efe 0x10bd0000 0x8b50121 0x68460170 0x214170 0x2218170 0x121c170 0xfef77cfc 0x1204007 0xf8494860 0xf848f949 0x886000f0 0x7bfa01f0 0xd7f901f0 0xbfbfff7 0xb7fff548 0x780128 0x5d103e0 0x1f008fb 0xf07cfa 0xfae701f0 0x3fb00f0 0x68fafff7 0xceff0020 0xfff718fb 0x12000f0 0x45fa5320 0x1f036f9 0x5462d07 0x2d0f002d 0x1d10a24 0x16e0012d 0x1d13c24 0x12e0022d 0x1d18224 0xee0032d 0x1d1aa24 0xae0042d 0x2d1ff24 0x53405e0 0x52d02d1 0xff24f534 0xe00a24 0x322c0bdb 0x782c09da 0xd848d949 0x8600420 0xd8490870 0x220d849 0x87048e0 0x782c0bdb 0xa02c09da 0xd548d249 0x8600620 0xd1490870 0x120d349 0x8703ae0 0xa02c0bdb 0xfa2c09da 0xd048cb49 0x8600620 0xca490870 0x120cc49 0x8702ce0 0xfa2c0ddb 0xff20af30 0x844209da 0xc948c349 0x8600620 0xc2490870 0x220c449 0x8701ce0 0xff20af30 0x84420fdb 0xc3488442 0xcdac348 0xba490860 0x220ba49 0x8700120 0xc0490870 0x320ba49 0x87008e0 0xbe48b449 0x8600420 0xb3490870 0x220b349 0x870b149 0x878c10f 0x9184910 0xb84a1170 0x10460078 0x8210840 0xc010b649 0x8701046 0x780421 0x8408010 0xb3490870 0x10460078 0x2210840 0x4010b149 0x8701046 0x78c007 0xc00faf49 0x87000f0 0xdfff00f0 0xf4ff00f0 0x43ff00f0 0x11ff0020 0xfff75efa 0xbffff7 0xb4fa01f0 0x4ffa00f0 0xfeff0028 0xf7d011e0 0x1f048fa 0xa3480078 0x2801d0 0xf0aaff 0xa1480078 0x12800d1 0x5e0a048 0x780028 0xd100e0 0xece700bf 0x522000f0 0xebff0546 0x1209b49 0x870002d 0x1d100f0 0x93ff01f0 0x29fa15e0 0x1f026fa 0x92480078 0x2801d0 0xf088ff 0x90480078 0x12804d1 0x91480078 0x12800d1 0x5e08d48 0x780028 0xd100e0 0xe8e700bf 0x1208c49 0x870fff7 0xa7f98b48 0x7800f0 0xbfff0546 0x22d01d0 0xf06aff 0x1f000fa 0x1f0fef9 0x84480078 0x2803d0 0xfff7acf9 0x82490860 0xfff722fa 0x7f480078 0x2803d0 0x2c20fff7 0x8bf9c6b2 0x552e25dd 0xfa2c05db 0x14207b49 0x8707b49 0x8708ae0 0xa02c05db 0xf207749 0x8707749 0x87082e0 0x782c05db 0xf207349 0x8707349 0x8707ae0 0x322c05db 0xa206f49 0x8706f49 0x87072e0 0xa206c49 0x8706c49 0x8706ce0 0x4b2e25dd 0xfa2c05db 0x1e206749 0x8706749 0x87062e0 0xa02c05db 0x19206349 0x8706349 0x8705ae0 0x782c05db 0x14205f49 0x8705f49 0x87052e0 0x322c05db 0xa205b49 0x8705b49 0x8704ae0 0xa205849 0x8705849 0x87044e0 0x322e25dd 0xfa2c05db 0x28205349 0x8705349 0x8703ae0 0xa02c05db 0x28204f49 0x8704f49 0x87032e0 0x782c05db 0x1c204b49 0x8704b49 0x8702ae0 0x322c05db 0xf204749 0x8704749 0x87022e0 0xa204449 0x8704449 0x8701ce0 0xa02c05db 0x3f204049 0x8704049 0x87014e0 0x782c05db 0x32203c49 0x8703c49 0x8700ce0 0x322c05db 0x18203849 0x8703849 0x87004e0 0x14203549 0x8703549 0x8702448 0x780128 0x4d10c20 0x30490870 0x30490870 0xfff77af9 0xfff7e8fd 0x582000f0 0xfffe0120 0x2c490870 0x23480078 0x2801d1 0xfff76cfd 0xce001f0 0x3bf91d48 0x780028 0x3d11e48 0x780128 0x2dd5420 0xf088fe 0xfff7c2fd 0x128eed0 0xfff78ef9 0x250 0x7004700 0x550 0x6c010020 0x14370021 0x10020 0x4010020 0x66010020 0x30370021 0xb010020 0x5a370021 0x84370021 0x12020000 0xae370021 0xa010020 0xf8360021 0x5010020 0x6010020 0x7010020 0x8010020 0x9010020 0x10010020 0x30010020 0x5f010020 0x61010020 0x2a010020 0x31010020 0x26010020 0xc010020 0x59010020 0x5a010020 0x17010020 0x70b50246 0x290ad1 0x154d164e 0xb560ff25 0x2d041543 0x144e3543 0x124e3560 0x13e00129 0x11d1d506 0xed0e6026 0x16407600 0x35432a46 0xb4d6d1c 0xb4eb560 0xff252d04 0x15430a4e 0x3543084e 0x3560074d 0xac6801e0 0x54dac68 0xe505ed0f 0x2df9d0 0x24d6b68 0xd8b270bd 0x1000f00 0x340 0x800080 0x2809d0 0xa490978 0x2905d1 0xbf62b6 0xbf0749 0x8700ae0 0x2808d1 0x4490978 0x2904d0 0xbf72b6 0xbf0149 0x8707047 0x72010020 0x704710b5 0xfff71afd 0xf0a0fd 0xf075fd 0xf07afd 0xf048fd 0xfff729f8 0x10bd0000 0xfeb50520 0x300f0 0x91fa0546 0x64216943 0x8463549 0xfdf7bafd 0x34494018 0x87b20320 0x400300f0 0x83fa0546 0x64216943 0x8462e49 0xfdf7acfd 0x2d494018 0x86b20120 0x3fef7 0xd3ff0090 0xfef72ef8 0xb20190 0x20fef7 0xcbff0090 0xfef726f8 0xb20290 0x38043043 0x23490860 0x2980004 0x1990843 0x20494860 0x8468468 0x200c1f49 0x884207d1 0x1e480078 0x280ad1 0x120fff7 0xb5fc06e0 0x1a480078 0x12802d1 0x20fff7 0xadfcfff7 0x69f81748 0x880028 0x4dd1548 0x88401e 0x13490880 0x12480088 0x2815d1 0xd488468 0xa0b20028 0x3d00d48 0x780028 0x7d10d48 0x20430849 0x88606420 0x9490880 0x4e00020 0xfff78afc 0xf080fd 0xfebd0000 0x22020000 0x70170000 0xc0000250 0xa5a50000 0x67010020 0x6e010020 0xffff0000 0xf1b582b0 0x2980190 0x5210903 0x1988842 0x2bd10120 0x80058549 0x8600121 0x1320fff7 0xdff0746 0x1211220 0xfff708ff 0x6463802 0x30430746 0x3846fdf7 0xacff4721 0x9060090 0xfdf7ccfd 0x7a490860 0x1211120 0xfff7f6fe 0x4460121 0x1020fff7 0xf1fe0546 0x21022943 0xc4620b2 0x73490880 0xdee00321 0x49030198 0x88422bd1 0x1204005 0x6c490860 0x1211720 0xfff7dcfe 0x7460121 0x1620fff7 0xd7fe0646 0x38023043 0x7463846 0xfdf77bff 0x47210906 0x90fdf7 0x9bfd6249 0x8600121 0x1520fff7 0xc5fe0446 0x1211420 0xfff7c0fe 0x5462102 0x29430c46 0x20b25b49 0x880ade0 0x7210903 0x1988842 0x4ed10121 0x1b20fff7 0xaffe0746 0x1211a20 0xfff7aafe 0x6463802 0x30430746 0x3846fdf7 0x4eff4721 0x9060090 0xfdf76efd 0x4b490860 0x1211920 0xfff798fe 0x4460121 0x1820fff7 0x93fe0546 0x20022843 0x44620b2 0x44490880 0x1211f20 0xfff788fe 0x7460121 0x1e20fff7 0x83fe0646 0x38023043 0x7463846 0xfdf727ff 0x47210906 0x90fdf7 0x47fd3a49 0x8600121 0x1d20fff7 0x71fe0446 0x1211c20 0xfff76cfe 0x5462002 0x28430446 0x20b23349 0x88059e0 0x121c903 0x1988842 0x27d10121 0x2320fff7 0x5bfe0746 0x1212220 0xfff756fe 0x6463802 0x30430746 0x3846fdf7 0xfafe4721 0x9060090 0xfdf71afd 0x21490860 0x1212120 0xfff744fe 0x4460121 0x2020fff7 0x3ffe0546 0x21022943 0xc4620b2 0x1a490880 0x2ce00121 0xf20fff7 0x33fe0746 0x1210e20 0xfff72efe 0x6463802 0x30430746 0x3846fdf7 0xd2fe4721 0x9060090 0xfdf7f2fc 0xd490860 0x1210d20 0xfff71cfe 0x4460121 0xc20fff7 0x17fe0546 0x21022943 0xc4620b2 0x6490880 0x7d20c000 0x844201dd 0xb200880 0xfebd0000 0x650 0x74010020 0x7c010020 0x78010020 0x7e010020 0xf1b58cb0 0x5200990 0xc9c6a48 0x6a490860 0xf200007 0x20430860 0x68488089 0xc005c00f 0x1214840 0x5906548 0x80894004 0xc00f0490 0xbe06248 0x8089c005 0xc00f0121 0x48400590 0x5e488089 0x4004c00f 0x4900598 0x28f0d0 0x4980028 0xedd02046 0xf0e8f8 0xb900027 0x200a90 0x19e05648 0x53490860 0xbf5248 0x680221 0x8400028 0xf9d14f48 0x806801b2 0xa984000 0x6aa1152 0xa984000 0x6a9085e 0xc7190a98 0x401cc0b2 0xa900999 0xa988842 0xe1db0521 0x3846fdf7 0xcffb0746 0x3fb20720 0x38442 0x1dd14348 0x87421add 0x42490020 0x85efdf7 0x3bfe3ab2 0x2900b99 0x501afdf7 0x35fe0090 0x3d480168 0x98fdf7 0x22fc0190 0x299fdf7 0xc5fb0390 0xfdf753fe 0x5460e46 0x18e03749 0x20085e 0xfdf720fe 0x2900b99 0x781afdf7 0x1bfe0090 0x32480168 0x98fdf7 0x8fc0190 0x299fdf7 0xabfb0390 0xfdf739fe 0x5460e46 0x5200003 0x844207d0 0x3204003 0x844203d0 0x7200003 0x844214d1 0x22264b 0x28463146 0xfdf71afd 0x22244b 0x1910090 0xfdf77cfd 0x22204b 0x3910290 0xfdf75cfc 0x5460e46 0x20e00120 0xc0038442 0xed10022 0x1b4b2846 0x3146fdf7 0x1fd0022 0x174b0391 0x290fdf7 0x63fd0546 0xe460de0 0x22154b 0x28463146 0xfdf7f2fc 0x22104b 0x3910290 0xfdf754fd 0x5460e46 0x28463146 0xfdf705fe 0xdb0f0bd 0x1000100 0x650 0x550 0x2000200 0x77370000 0x7e010020 0x78010020 0x7c010020 0x74010020 0x70a740 0xe040 0x5940 0xc0a240 0x10b50146 0xb460c48 0xc4c2060 0x80012060 0x40102060 0xf200007 0x18432060 0x220848 0x206000bf 0x5480068 0x2242040 0x28f9d1 0x2488268 0x10b210bd 0x1000100 0x650 0x2000200 0x1460522 0x12039142 0x7d00322 0x52039142 0x3d00722 0x12039142 0x3d10c4a 0xc4b1a60 0x2e00c4a 0xa4b1a60 0xb4a094b 0x1a6000bf 0x74a1268 0x2231a40 0x2af9d1 0x44a9268 0x10b20322 0x5206024b 0x1a607047 0x40004 0x650 0x20002 0x2000200 0x1490873 0x70470000 0x40000350 0x4490978 0x9020143 0x24a1278 0x11430846 0x70470000 0x40000350 0x70b50b46 0x1446002b 0x5d0114d 0x2d790543 0xf4e3571 0x1be00504 0x5430e4e 0x35600c4d 0x2d798543 0xa4e3571 0x210ee0 0x1258d40 0x540002d 0x8d04a00 0x25469540 0x3269640 0x36043543 0x34e7560 0x491c0729 0xeedb70bd 0x350 0x40000250 0x10b5144b 0x1b7d8343 0x124c2375 0x2904d0 0x23461b7e 0x3432376 0x4e00e4b 0x1b7e8343 0xc4c2376 0x2a05d0 0xa4b1b7f 0x343094c 0x237704e0 0x74b1b7f 0x8343064c 0x2377ff23 0x44c2034 0x2372034b 0x1b7c0343 0x14c2374 0x10bd0000 0x20000350 0x1460448 0x7c0840 0x2801d0 0x1207047 0x20fce7 0x40000350 0x2905d0 0x54a1278 0x243044b 0x1a7004e0 0x24a1278 0x8243014b 0x1a707047 0x350 0xf8b50646 0xc461948 0x19490863 0x124863 0xa20fdf7 0x16fe0120 0x61549 0x8630012 0x48630a20 0xfdf70dfe 0x7273f06 0x2e11d1 0x3252d02 0x2c03d1 0xe480f49 0x48600be0 0x12c03d1 0xd480c49 0x486005e0 0xb480a49 0x486001e0 0xff250135 0x120c005 0x6490860 0x38462843 0x6494860 0xf8bd0000 0x10001 0x150 0x8000800 0x240 0x1000100 0x250 0xf8b50446 0xd461646 0x1f460120 0x3b463246 0x29460090 0x204600f0 0x1f8f8bd 0xffb581b0 0xd461646 0x1f463c46 0x1ce0202c 0x13dd2023 0x32462946 0x19800f0 0x17f80028 0x2d00120 0x5b0f0bd 0x2036203c 0xa980028 0xad02846 0x2030c5b2 0x6e02346 0x32462946 0x19800f0 0x3f8ede7 0xe1e70000 0xffb50d46 0x984006 0x60e202b 0x2dd0120 0x4b0f0bd 0x28023043 0x284f3860 0x2848294f 0x38600220 0x386100bf 0x2648006a 0x228fbd1 0x1203043 0x214f3860 0x2148224f 0x38600120 0x386100bf 0x1f48006a 0x128fbd1 0x1e481d4f 0x38603846 0x436100bf 0x1a48006a 0x9842fbd1 0x19481438 0x174f3860 0x2415e0 0x1748a710 0xbf00c159 0x1170521c 0xff200002 0x840000a 0x1070521c 0xff200004 0x840000c 0x1070521c 0x80e1070 0x521c241d 0x9c42e7db 0xbf0948 0xc0692027 0x38402028 0xf9d10020 0xc043054f 0xf8610748 0x38600020 0xaae70000 0x10240 0x900ff00 0x240 0x25007f00 0x20240 0xff07 0xf8b50446 0xd461646 0x1f460120 0x3b463246 0x29460090 0x204600f0 0x1f8f8bd 0xffb581b0 0xd461646 0x1f463c46 0x1ce01e2c 0x13dd1e23 0x32462946 0x19800f0 0x17f80028 0x2d00120 0x5b0f0bd 0x1e361e3c 0xa980028 0xad02846 0x1e30c5b2 0x6e02346 0x32462946 0x19800f0 0x3f8ede7 0xe1e70000 0xffb581b0 0xd460198 0x4006000e 0x900026 0x1c461e2b 0x1dc002b 0x2d10120 0x5b0f0bd 0x2802009f 0x38430146 0x1078521c 0x40143 0x12b03d0 0x1078521c 0x60143 0x24480160 0x22c27dd 0xa41e14e0 0x241f0021 0x1178521c 0x1078521c 0x20143 0x1078521c 0x40143 0x1078521c 0x60143 0x1948001d 0xb700c151 0x761c042c 0xe8dc1078 0x57783f02 0x38439778 0x3f043843 0xd7783f06 0x38430146 0x1048001d 0xb700c151 0xf48104f 0x3860981c 0x386100bf 0xd48006a 0x9f1cb842 0xfad10a48 0x8300a4f 0x386000bf 0x848c069 0x20273840 0x2028f9d1 0x20c043 0x44ff861 0x4483860 0x20a5e7 0x10240 0x900ff00 0x240 0xff01 0x4201024b 0xd1180122 0x8a617047 0x450 0x1464801 0x14bc218 0x90687047 0x450 0x10b50146 0x1204b01 0x24c1a19 0x13691840 0x10bd0000 0x450 0x30b50346 0x5c01054d 0x60190160 0x2a02d0 0x4240461 0x1e00024 0x46130bd 0x450 0x4201034b 0xd1180a69 0x1231a43 0xa617047 0x450 0x76200149 0xc8607047 0x140 0xa4a5060 0x22094b 0x1a600029 0x5d01a46 0x12680223 0x1a43054b 0x1a60044a 0x12680123 0x1a43024b 0x1a607622 0xda607047 0x140 0x10b50748 0x7498860 0x221146 0x8020fff7 0xabfd0022 0x11460120 0xfff7a6fd 0x10bd0000 0x1000100 0x40000250 0x10b50022 0x1218020 0xfff79afd 0x10bd10b5 0x446002c 0x4d00121 0x8020fff7 0xf5fd03e0 0x218020 0xfff7f0fd 0x10bd10b5 0x2220021 0x4020fff7 0x85fd10bd 0x3480449 0x88600020 0x3494871 0x70470000 0x10001000 0x40000250 0x350 0x200249 0x48700120 0x48717047 0x350 0x2803d0 0x121034a 0x517002e0 0x21014a 0x51707047 0x350 0x10b50122 0x212020 0xfff75cfd 0x10bd10b5 0x212020 0xfff7bafd 0x220121 0x2020fff7 0x51fd10bd 0x10b50446 0x2c04d0 0x1212020 0xfff7acfd 0x3e00021 0x2020fff7 0xa7fd10bd 0x30b50346 0x10480478 0x10480078 0x984201dd 0xe480370 0xe480170 0xe480270 0x914200da 0xa460a48 0x789042 0x2dd0748 0x27003e0 0x6480078 0x44d2870 0x3480078 0x844201d0 0x52030bd 0x20fce7 0x59010020 0x5a010020 0x32010020 0x33010020 0x10b50446 0xf0a4fa 0x20fef7 0x11fffff7 0x89ff2046 0xf054f8 0xf002f8 0x10bd0000 0x1480249 0x8607047 0xb9fd0000 0x40000150 0x10b50748 0x780228 0x9d00548 0x780128 0x3d10220 0x2490870 0x1e0fff7 0xe9ff10bd 0x61010020 0x10b50024 0xfff748ff 0xbf0de0 0x20fff7 0x4aff0120 0xfef7cafa 0x120fff7 0x44ff0320 0xfef7c4fa 0x601cc4b2 0x1e2cefdb 0x10bd08b5 0x3216846 0x1700021 0x41700321 0x81700121 0xc170fdf7 0xb9fb0122 0x7d21c901 0x20fff7 0xd7fe08bd 0x10b50020 0xfff7e2fe 0x10bd10b5 0x20fff7 0xc1fe0446 0x204610bd 0xfeb50546 0x2700f0 0x43fa0195 0x203e49 0x870fff7 0x50fffef7 0x89fa0020 0xfff756ff 0xfef764fa 0x120fff7 0x51ff0024 0x1fe03748 0x780028 0x3d0582d 0x1d1fff7 0x13ff00f0 0x27fa00bf 0x30480078 0x28fbd0 0xf020fa 0x620011b 0x1980841 0xc007c00f 0x900098 0xfff734ff 0x202849 0x870601c 0xc4b2072c 0xdddb00f0 0xdfa0024 0x28e02448 0x780028 0x3d0582d 0x1d1fff7 0xedfe00f0 0x1fa00bf 0x1d480078 0x28fbd0 0xf0faf9 0x2c03d1 0xfff702ff 0xfef742fa 0x201749 0x870fef7 0x7bfe0646 0x62c07d0 0x2c05d0 0x520011b 0x30468840 0x3843c7b2 0x601cc4b2 0x72cd4db 0xf0def9 0xbf0c48 0x780028 0xfbd000f0 0xd7f9fff7 0xe8fefef7 0x21fa0020 0xfff7eefe 0x200549 0x870fef7 0xf9f9fef7 0xf7f900f0 0xc7f93846 0xfebd0000 0x11010020 0x10010020 0xfeb50546 0x2700f0 0xbbf90195 0x203c49 0x870fff7 0xc8fefef7 0x1fa0020 0xfff7cefe 0xfef7dcf9 0x120fff7 0xc9fe0024 0x1fe03548 0x780028 0x3d0582d 0x1d1fff7 0x8bfe00f0 0x9ff900bf 0x2e480078 0x28fbd0 0xf098f9 0x620011b 0x1980841 0xc007c00f 0x900098 0xfff7acfe 0x202649 0x870601c 0xc4b2072c 0xdddb00f0 0x85f90024 0x24e02248 0x780028 0x3d0582d 0x1d1fff7 0x65fe00f0 0x79f900bf 0x1b480078 0x28fbd0 0xf072f9 0x2c03d1 0xfff77afe 0xfef7baf9 0x201549 0x870fef7 0xf3fd0646 0x620011b 0x30468840 0x3843c7b2 0x601cc4b2 0x72cd8db 0xf05af9 0xbf0c48 0x780028 0xfbd000f0 0x53f9fff7 0x64fefef7 0x9df90020 0xfff76afe 0x200549 0x870fef7 0x75f9fef7 0x73f900f0 0x43f93846 0xfebd0000 0x11010020 0x10010020 0x203049 0x8703049 0x8703049 0x8703049 0x8703049 0x8703049 0x8703049 0x8703049 0x8703049 0x8700120 0x2f490870 0x204870 0x88702e49 0x8702e49 0x8702e49 0x8702e49 0x8700320 0x2d490870 0x202d49 0x8702d49 0x8702d49 0x8702d49 0x880401e 0x2c490880 0x202c49 0x8702c49 0x8703f20 0x2b490870 0x2b490870 0x202b49 0x8702b49 0x8702b49 0x8703f20 0x2a490870 0x2a490870 0x1202a49 0x8702a49 0x8700020 0x29490870 0x29490870 0x2202949 0x8700320 0x28490870 0x202849 0x8702849 0x8702849 0x8702849 0x8702849 0x8707047 0x10010020 0x17010020 0x18010020 0x12010020 0x13010020 0x14010020 0x15010020 0x16010020 0x21010020 0x84010020 0x22010020 0x24010020 0x25010020 0x26010020 0x27010020 0x28010020 0x29010020 0x2a010020 0x2c010020 0x2e010020 0x30010020 0x31010020 0x32010020 0x33010020 0x34010020 0x37010020 0x58010020 0x59010020 0x5a010020 0x5b010020 0x5c010020 0x5d010020 0x5e010020 0x5f010020 0x60010020 0x61010020 0x66010020 0xa010020 0x67010020 0xb010020 0xf8b50546 0x240026 0x272846 0xfff78efa 0x4461c48 0x68241a 0x1b480068 0xe1210901 0x884201da 0x194e7700 0x17480068 0x18498842 0x2da164e 0x77001be0 0x13480068 0x14496431 0x884202da 0x114e7700 0x12e00f48 0x687d21 0x49018842 0x2da0d4e 0x770009e0 0xa480068 0xc498842 0x2da094e 0x770001e0 0x74e7700 0xb44201da 0x20f8bd 0xbc4201dd 0x220fae7 0x120f8e7 0x68010020 0xc010020 0x22020000 0x740e0000 0x4100000 0xfeb50646 0xc460121 0x4420fef7 0x4dff0290 0x2980428 0x13d11548 0x68fcf7 0xe5ff1349 0x1900968 0x819fcf7 0xdfff3146 0x90fcf7 0xcefd0746 0x199fcf7 0x7fe0546 0x14e00b48 0x68fcf7 0xd1ff0949 0x1900968 0x9190846 0xc838fcf7 0xc9ff3146 0x90fcf7 0xb8fd0746 0x199fcf7 0xf1fd0546 0x2846febd 0x80010020 0x10b50121 0x20fff7 0xa3fc10bd 0x10b5fff7 0x99fc10bd 0x01 0x1010001 0x101 0x1000000 0x10001 0x10100 0x10100 0x100 0x1000001 0x101 0x1000000 0x10001 0x10100 0x10100 0x10001 0x01 0x101 0x1000000 0x1010100 0x10100 0x1000001 0x01 0x10001 0x1000101 0x01 0x10000 0x10001 0x100 0x101 0x1010001 0x1000100 0x10000 0x10001 0x10100 0x1010000 0x10001 0x01 0x10000 0x1000000 0x1010101 0x10100 0x1000001 0x01 0x1000001 0x1000101 0x00 0x10001 0x1010100 0x1010000 0x00 0x00 0x00 0x00 0x00 0x00 0x00 0xe8370021 0x10020 0x84000000 0xaa0b0021 0x00 0x00 0x00 0x00 0x00 0x00 0x00 0x00 0x00 0x00 0x00 0x00 0x00 0x00 0x00 0x00 0x00 0x00 0x00 0x00 0x00 0x00 0x00 0x00 0x00 0x00 0x00 0x00 0x00 0x00 0x00 0x00 0x00 0x00 0x00 0x00 0x00 0x00 0x00 0x00 0x00 0x00 0x00 0x00 0x00 0x00 0x00 0x00 0x00 0x00 0x00 0x20102 0xa0103fe 0xd3345534>;
				qcom,vooc-low-temp = <0x00>;
				qcom,vooc-high-temp = <0x1f4>;
				qcom,vooc-low-soc = <0x01>;
				qcom,vooc-high-soc = <0x5a>;
				qcom,vooc-little-cool-temp = <0xa0>;
				qcom,vooc-cool-temp = <0x78>;
				qcom,vooc-normal-high-temp = <0x1ae>;
				qcom,vooc-warm-allow-vol = <0x1022>;
				qcom,vooc-warm-allow-soc = <0x32>;
				qcom,vooc-little-cool-to-normal-temp = <0xb4>;
				qcom,vooc-normal-to-little-cool-current = <0x05>;
				qcom,vooc_cool_bat_volt = <0xd7a>;
				qcom,vooc_little_cool_bat_volt = <0xd48>;
				qcom,vooc_normal_bat_volt = <0xd16>;
				qcom,vooc_warm_bat_volt = <0xce4>;
				qcom,vooc_cool_bat_suspend_volt = <0xd7a>;
				qcom,vooc_little_cool_bat_suspend_volt = <0xd48>;
				qcom,vooc_normal_bat_suspend_volt = <0xd16>;
				qcom,vooc_warm_bat_suspend_volt = <0xce4>;
				qcom,vooc_multistep_adjust_current_support;
				qcom,vooc_multistep_initial_batt_temp = <0x3e8>;
				qcom,vooc_strategy_normal_current = <0x0c>;
				qcom,vooc_batt_over_high_temp = <0x1fe>;
				qcom,vooc_batt_over_low_temp = <0x2d>;
				qcom,vooc_over_high_or_low_current = <0x00>;
				qcom,vooc_strategy1_batt_high_temp0 = <0x190>;
				qcom,vooc_strategy1_batt_high_temp1 = <0x1a4>;
				qcom,vooc_strategy1_batt_high_temp2 = <0x1ae>;
				qcom,vooc_strategy1_batt_low_temp2 = <0x1a4>;
				qcom,vooc_strategy1_batt_low_temp1 = <0x19a>;
				qcom,vooc_strategy1_batt_low_temp0 = <0x186>;
				qcom,vooc_strategy1_high_current0 = <0x09>;
				qcom,vooc_strategy1_high_current1 = <0x07>;
				qcom,vooc_strategy1_high_current2 = <0x05>;
				qcom,vooc_strategy1_low_current2 = <0x07>;
				qcom,vooc_strategy1_low_current1 = <0x09>;
				qcom,vooc_strategy1_low_current0 = <0x0c>;
				qcom,vooc_strategy2_batt_up_temp1 = <0x177>;
				qcom,vooc_strategy2_batt_up_down_temp2 = <0x17c>;
				qcom,vooc_strategy2_batt_up_temp3 = <0x186>;
				qcom,vooc_strategy2_batt_up_down_temp4 = <0x190>;
				qcom,vooc_strategy2_batt_up_temp5 = <0x19a>;
				qcom,vooc_strategy2_batt_up_temp6 = <0x19f>;
				qcom,vooc_strategy2_high0_current = <0x09>;
				qcom,vooc_strategy2_high1_current = <0x07>;
				qcom,vooc_strategy2_high2_current = <0x05>;
				qcom,vooc_strategy2_high3_current = <0x03>;
				qcom,abnormal_adapter_current = <0x00 0x00 0x09 0x09 0x07 0x07 0x05 0x05 0x03 0x03>;
				qcom,vooc_current_lvl = <0x3e8 0x5dc 0x7d0 0x9c4 0xbb8 0xdac 0xfa0 0x1194 0x1388 0x157c 0x1770 0x1964 0x1b58 0x1d4c 0x1f40 0x2134 0x2328 0x251c 0x2710 0x2904 0x2af8 0x2cec 0x2ee0 0x30d4>;
				pinctrl-names = "switch1_act_switch2_act\0switch1_sleep_switch2_sleep\0switch1_act_switch3_act\0switch1_sleep_switch3_sleep\0switch1_act_switch2_sleep\0switch1_sleep_switch2_act\0clock_active\0clock_sleep\0data_active\0data_sleep\0reset_active\0reset_sleep\0vooc_asic_id_active\0vooc_asic_id_sleep";
				pinctrl-0 = <0x2e>;
				pinctrl-1 = <0x2f>;
				pinctrl-2 = <0x2e>;
				pinctrl-3 = <0x2f>;
				pinctrl-4 = <0x2e>;
				pinctrl-5 = <0x2f>;
				pinctrl-6 = <0x30>;
				pinctrl-7 = <0x31>;
				pinctrl-8 = <0x32>;
				pinctrl-9 = <0x33>;
				pinctrl-10 = <0x34>;
				pinctrl-11 = <0x35>;
				pinctrl-12 = <0x36>;
				pinctrl-13 = <0x37>;
				qcom,charging_switch1-gpio = <0xffffffff 0x18 0x00>;
				qcom,charging_reset-gpio = <0xffffffff 0x21 0x00>;
				qcom,charging_clock-gpio = <0xffffffff 0xb4 0x00>;
				qcom,charging_data-gpio = <0xffffffff 0xb5 0x00>;
				qcom,vooc_asic_id-gpio = <0xffffffff 0x22 0x00>;
				qcom,vooc-max-input-volt-support = <0x2710>;
				qcom,vooc-max-input-current-support = <0x1964>;

				vooc_charge_strategy_30w {

					strategy_1 {
						capacity_range = <0x00 0x4b>;
						temp_range = <0x78 0xa0>;
						input_current = <0xfa0 0x1162 0x00 0xbb8 0x1176 0x00 0x7d0 0x1180 0x00>;
					};

					strategy_2 {
						capacity_range = <0x00 0x4b>;
						temp_range = <0xa0 0x19a>;
						input_current = <0x1770 0x1068 0x384 0x1388 0x1068 0x00 0x1194 0x1162 0x00 0xfa0 0x1162 0x00 0xbb8 0x1176 0x00 0x7d0 0x1180 0x00>;
					};

					strategy_3 {
						capacity_range = <0x00 0x4b>;
						temp_range = <0x19a 0x1a4>;
						input_current = <0xfa0 0x1176 0x00 0x7d0 0x1180 0x00>;
					};

					strategy_4 {
						capacity_range = <0x00 0x4b>;
						temp_range = <0x1a4 0x1a9>;
						input_current = <0xfa0 0x1180 0x00>;
					};

					strategy_5 {
						capacity_range = <0x00 0x4b>;
						temp_range = <0x1a9 0x1b3>;
						input_current = <0xbb8 0x1180 0x00>;
					};
				};

				vooc_charge_strategy_65w {

					strategy_1 {
						capacity_range = <0x00 0x32>;
						temp_range = <0x78 0xa0>;
						input_current = <0x1770 0x1068 0x00 0xfa0 0x1166 0x00 0x7d0 0x118e 0x00 0x5dc 0x1194 0x00>;
					};

					strategy_2 {
						capacity_range = <0x00 0x32>;
						temp_range = <0xa0 0x172>;
						input_current = <0x1964 0x1068 0x00 0x1770 0x109a 0x12c 0x157c 0x10cc 0x190 0x1194 0x1166 0x30c 0xdac 0x1166 0x00 0x7d0 0x118e 0x00 0x5dc 0x1194 0x00>;
					};

					strategy_3 {
						capacity_range = <0x00 0x5a>;
						temp_range = <0x172 0x1ae>;
						input_current = <0x1964 0x1068 0x00 0x1770 0x109a 0x12c 0x157c 0x10cc 0x190 0x1194 0x1166 0x30c 0xdac 0x1166 0x00 0x7d0 0x118e 0x00 0x640 0x1194 0x00>;
					};
				};
			};

			tfa98xx-vib {
				status = "disabled";
				compatible = "tfa98xx,vib";
			};
		};
	};

	fragment@76 {
		target = <0xffffffff>;

		__overlay__ {

			charging_switch1_active {
				phandle = <0x2e>;

				pins_cmd_dat {
					pinmux = <0x1800>;
					slew-rate = <0x01>;
					output-high;
				};
			};

			charging_switch1_sleep {
				phandle = <0x2f>;

				pins_cmd_dat {
					pinmux = <0x1800>;
					slew-rate = <0x01>;
					output-low;
				};
			};

			charging_clock_active {
				phandle = <0x30>;

				pins_cmd_dat {
					pinmux = <0xb400>;
					slew-rate = <0x00>;
					bias-pull-up;
				};
			};

			charging_clock_sleep {
				phandle = <0x31>;

				pins_cmd_dat {
					pinmux = <0xb400>;
					slew-rate = <0x00>;
					bias-pull-down;
				};
			};

			charging_data_active {
				phandle = <0x32>;

				pins_cmd_dat {
					pinmux = <0xb500>;
					slew-rate = <0x00>;
					bias-pull-down;
				};
			};

			charging_data_sleep {
				phandle = <0x33>;

				pins_cmd_dat {
					pinmux = <0xb500>;
					slew-rate = <0x00>;
					bias-pull-down;
				};
			};

			charging_reset_active {
				phandle = <0x34>;

				pins_cmd_dat {
					pinmux = <0x2100>;
					slew-rate = <0x01>;
					bias-disable;
				};
			};

			charging_reset_sleep {
				phandle = <0x35>;

				pins_cmd_dat {
					pinmux = <0x2100>;
					slew-rate = <0x01>;
					bias-disable;
				};
			};

			vooc_asic_id_active {
				phandle = <0x36>;

				pins_cmd_dat {
					pinmux = <0x2200>;
					input-enable;
					slew-rate = <0x00>;
					bias-pull-up = <0x66>;
				};
			};

			vooc_asic_id_sleep {
				phandle = <0x37>;

				pins_cmd_dat {
					pinmux = <0x2200>;
					input-enable;
					slew-rate = <0x00>;
					bias-pull-down = <0x66>;
				};
			};
		};
	};

	fragment@77 {
		target = <0xffffffff>;

		__overlay__ {
			status = "okay";
			clock-frequency = <0x186a0>;
			scl-gpio-id = <0xbf>;
			sda-gpio-id = <0xc0>;

			charge_pump-divider@68 {
				status = "okay";
				compatible = "oplus,charge_pump-divider";
				reg = <0x68>;
				oplus,charge_pump-hwid-gpio = <0xffffffff 0x1e 0x00>;
				pinctrl-names = "charge_pump_hwid_active\0charge_pump_hwid_sleep\0charge_pump_hwid_default";
				pinctrl-0 = <0x38>;
				pinctrl-1 = <0x39>;
				pinctrl-2 = <0x3a>;
			};

			mp2650-charger@5c {
				status = "okay";
				compatible = "oplus,mp2650-charger";
				reg = <0x5c>;
				qcom,mps_otg_en-gpio = <0xffffffff 0x8c 0x00>;
				pinctrl-names = "mps_otg_en_active\0mps_otg_en_sleep\0mps_otg_en_default";
				pinctrl-0 = <0x3b>;
				pinctrl-1 = <0x3c>;
				pinctrl-2 = <0x3d>;
			};
		};
	};

	fragment@78 {
		target = <0xffffffff>;

		__overlay__ {

			charge_pump_hwid_active {
				phandle = <0x38>;

				pins_cmd_dat {
					pinmux = <0x1e00>;
					input-enable;
					slew-rate = <0x00>;
					bias-pull-up = <0x66>;
				};
			};

			charge_pump_hwid_sleep {
				phandle = <0x39>;

				pins_cmd_dat {
					pinmux = <0x1e00>;
					input-enable;
					slew-rate = <0x00>;
					bias-pull-down = <0x66>;
				};
			};

			charge_pump_hwid_default {
				phandle = <0x3a>;

				pins_cmd_dat {
					pinmux = <0x1e00>;
					input-enable;
					slew-rate = <0x00>;
					bias-disable;
				};
			};

			mps_otg_en_active {
				phandle = <0x3b>;

				pins_cmd_dat {
					pinmux = <0x8c00>;
					slew-rate = <0x01>;
					bias-pull-up;
				};
			};

			mps_otg_en_sleep {
				phandle = <0x3c>;

				pins_cmd_dat {
					pinmux = <0x8c00>;
					slew-rate = <0x01>;
					bias-pull-down;
				};
			};

			mps_otg_en_default {
				phandle = <0x3d>;

				pins_cmd_dat {
					pinmux = <0x8c00>;
					slew-rate = <0x01>;
					bias-pull-down;
				};
			};
		};
	};

	fragment@79 {
		target = <0xffffffff>;

		__overlay__ {
			pinctrl-names = "uart0_rx_gpio\0uart0_tx_gpio";
			pinctrl-0 = <0x3e>;
			pinctrl-1 = <0x3f>;
			status = "okay";
		};
	};

	fragment@80 {
		target = <0xffffffff>;

		__overlay__ {
			status = "disabled";
		};
	};

	fragment@81 {
		target = <0xffffffff>;

		__overlay__ {

			uart0_rx_gpio {
				phandle = <0x3e>;

				pins_cmd_dat {
					pinmux = <0xb300>;
					input-enable;
					slew-rate = <0x00>;
					bias-disable;
				};
			};

			uart0_tx_gpio {
				phandle = <0x3f>;

				pins_cmd_dat {
					pinmux = <0xb200>;
					input-enable;
					slew-rate = <0x00>;
					bias-disable;
				};
			};
		};
	};

	fragment@82 {
		target = <0xffffffff>;

		__overlay__ {
			status = "disabled";
		};
	};

	fragment@83 {
		target = <0xffffffff>;

		__overlay__ {
			status = "disabled";
		};
	};

	fragment@84 {
		target = <0xffffffff>;

		__overlay__ {
			status = "disabled";
		};
	};

	fragment@85 {
		target = <0xffffffff>;

		__overlay__ {

			usbphy_tuning {
				compatible = "mediatek,phy_tuning";
				u2_vrt_ref = <0x03>;
				u2_term_ref = <0x07>;
				u2_enhance = <0x03>;
				host_u2_vrt_ref = <0x06>;
				host_u2_term_ref = <0x06>;
				host_u2_enhance = <0x03>;
				phandle = <0xa2>;
			};
		};
	};

	fragment@86 {
		target = <0xffffffff>;

		__overlay__ {
			boost_period = <0x00>;
		};
	};

	fragment@87 {
		target = <0xffffffff>;

		__overlay__ {
			pinctrl-names = "i2c-state\0output-low-state";
			pinctrl-0 = <0x40>;
			pinctrl-1 = <0x41>;
		};
	};

	fragment@88 {
		target = <0xffffffff>;

		__overlay__ {

			i2c7_sda_i2c_state {
				phandle = <0x40>;

				pins_cmd_dat {
					pinmux = <0x8701>;
					slew-rate = <0x00>;
					bias-pull-up;
				};
			};

			i2c7_sda_output_low_state {
				phandle = <0x41>;

				pins_cmd_dat {
					pinmux = <0x8700>;
					slew-rate = <0x01>;
					output-low;
				};
			};
		};
	};

	fragment@89 {
		target = <0xffffffff>;

		__overlay__ {
			status = "disabled";
		};
	};

	fragment@90 {
		target = <0xffffffff>;

		__overlay__ {
			clock-frequency = <0x61a80>;
			pinctrl-names = "default\0ts_int_active\0ts_reset_active\0ts_int_suspend\0ts_reset_suspend\0ts_i2c_mode";
			pinctrl-0 = <0x42>;
			pinctrl-1 = <0x43>;
			pinctrl-2 = <0x44>;
			pinctrl-3 = <0x45>;
			pinctrl-4 = <0x46>;
			pinctrl-5 = <0x47>;

			gt9886@5d {
				compatible = "goodix,gt9886";
				reg = <0x5d>;
				status = "ok";
				interrupt-parent = <0xffffffff>;
				interrupts = <0x0e 0x02 0x0e 0x00>;
				vtouch-supply = <0xffffffff>;
				goodix,irq-gpio = <0xffffffff 0x0e 0x00>;
				goodix,reset-gpio = <0xffffffff 0x0f 0x00>;
				goodix,irq-flags = <0x02>;
				goodix,panel-max-id = <0x0a>;
				goodix,panel-max-x = <0x438>;
				goodix,panel-max-y = <0x8e8>;
				goodix,panel-max-w = <0x100>;
				goodix,panel-max-p = <0x100>;
				goodix,input-max-x = <0x438>;
				goodix,input-max-y = <0x8e8>;
				goodix,panel-key-map = <0x9e 0xac 0xd9>;
				goodix,power-on-delay-us = <0x2710>;
				goodix,power-off-delay-us = <0x1388>;
				goodix,firmware-version = "6877v01";
				goodix,config-version = "6877v01";
				goodix,pen-enable;
				goodix,key-of-pen = <0x14b 0x14c>;
				tpd-filter-enable = <0x00>;
				tpd-filter-pixel-density = <0xa1>;
				tpd-filter-custom-prameters = <0x00 0x00 0x00 0x00 0x00 0x00 0x00 0x00 0x00 0x00 0x00 0x00>;
				tpd-filter-custom-speed = <0x00 0x00 0x00>;
			};
		};
	};

	fragment@91 {
		target = <0xffffffff>;

		__overlay__ {
			status = "okay";
			#address-cells = <0x01>;
			#size-cells = <0x00>;
			pinctrl-names = "default\0gt9896s_int_active\0gt9896s_reset_active\0gt9896s_int_suspend\0gt9896s_reset_suspend\0gt9896s_spi_mode";
			pinctrl-0 = <0x48>;
			pinctrl-1 = <0x49>;
			pinctrl-2 = <0x4a>;
			pinctrl-3 = <0x4b>;
			pinctrl-4 = <0x4c>;
			pinctrl-5 = <0x4d>;

			gt9896s@0 {
				compatible = "goodix,gt9896s";
				reg = <0x00>;
				spi-max-frequency = <0xf4240>;
				goodix,avdd-name = "vtouch";
				vtouch-supply = <0xffffffff>;
				goodix,irq-gpio = <0xffffffff 0x0e 0x00>;
				goodix,reset-gpio = <0xffffffff 0x0f 0x00>;
				goodix,irq-flags = <0x02>;
				goodix,panel-max-id = <0x0a>;
				goodix,panel-max-x = <0x438>;
				goodix,panel-max-y = <0x8fc>;
				goodix,panel-max-w = <0x100>;
				goodix,panel-max-p = <0x100>;
				goodix,input-max-x = <0x438>;
				goodix,input-max-y = <0x8fc>;
				goodix,panel-key-map = <0x9e 0xac 0xd9>;
				goodix,power-on-delay-us = <0x2710>;
				goodix,power-off-delay-us = <0x1388>;
				goodix,firmware-version = "6877v01";
				goodix,config-version = "6877v01";
				goodix,pen-enable;
				tpd-filter-enable = <0x00>;
				tpd-filter-pixel-density = <0xa1>;
				tpd-filter-custom-prameters = <0x00 0x00 0x00 0x00 0x00 0x00 0x00 0x00 0x00 0x00 0x00 0x00>;
				tpd-filter-custom-speed = <0x00 0x00 0x00>;
			};
		};
	};

	fragment@92 {
		target = <0xffffffff>;

		__overlay__ {

			eintdefault {
				phandle = <0x42>;
			};

			pins_default {
				phandle = <0x48>;
			};

			int_active {
				phandle = <0x43>;

				pins_cmd_dat {
					pinmux = <0xe00>;
					input-enable;
				};
			};

			reset_active {
				phandle = <0x44>;

				pins_cmd_dat {
					pinmux = <0xf00>;
					output-high;
				};
			};

			int_suspend {
				phandle = <0x45>;

				pins_cmd_dat {
					pinmux = <0xe00>;
					output-low;
				};
			};

			reset_suspend {
				phandle = <0x46>;

				pins_cmd_dat {
					pinmux = <0xf00>;
					output-low;
				};
			};

			i2cmode_default {
				phandle = <0x47>;

				pins_cmd_dat {
					pinmux = <0x4001 0x4101>;
				};
			};

			int_high {
				phandle = <0xa3>;

				pins_cmd_dat {
					pinmux = <0xe00>;
					output-high;
				};
			};

			int1_active {
				phandle = <0x49>;

				pins_cmd_dat {
					pinmux = <0xe00>;
					input-enable;
				};
			};

			reset1_active {
				phandle = <0x4a>;

				pins_cmd_dat {
					pinmux = <0xf00>;
					output-high;
				};
			};

			int1_suspend {
				phandle = <0x4b>;

				pins_cmd_dat {
					pinmux = <0xe00>;
					output-low;
				};
			};

			reset1_suspend {
				phandle = <0x4c>;

				pins_cmd_dat {
					pinmux = <0xf00>;
					output-low;
				};
			};

			spimode_default {
				phandle = <0x4d>;

				pins_cmd_dat {
					pinmux = <0xc02 0xd02 0x4002 0x4102>;
					drive-strength = <0x02>;
				};
			};
		};
	};

	fragment@93 {
		target = <0xffffffff>;

		__overlay__ {

			cam0@0 {
				phandle = <0x4f>;

				pins_cmd_dat {
					pinmux = <0x9d00>;
					slew-rate = <0x01>;
					output-low;
				};
			};

			cam0@1 {
				phandle = <0x50>;

				pins_cmd_dat {
					pinmux = <0x9d00>;
					slew-rate = <0x01>;
					output-high;
				};
			};

			cam1@0 {
				phandle = <0x51>;

				pins_cmd_dat {
					pinmux = <0x9b00>;
					slew-rate = <0x01>;
					output-low;
				};
			};

			cam1@1 {
				phandle = <0x52>;

				pins_cmd_dat {
					pinmux = <0x9b00>;
					slew-rate = <0x01>;
					output-high;
				};
			};

			cam2@0 {
				phandle = <0x53>;

				pins_cmd_dat {
					pinmux = <0x9f00>;
					slew-rate = <0x01>;
					output-low;
				};
			};

			cam2@1 {
				phandle = <0x54>;

				pins_cmd_dat {
					pinmux = <0x9f00>;
					slew-rate = <0x01>;
					output-high;
				};
			};

			cam3@0 {
				phandle = <0x55>;

				pins_cmd_dat {
					pinmux = <0xa100>;
					slew-rate = <0x01>;
					output-low;
				};
			};

			cam3@1 {
				phandle = <0x56>;

				pins_cmd_dat {
					pinmux = <0xa100>;
					slew-rate = <0x01>;
					output-high;
				};
			};

			camera_pins_cam0_mclk_off {
				phandle = <0x57>;

				pins_cmd_dat {
					pinmux = <0x9600>;
					drive-strength = <0x01>;
				};
			};

			camera_pins_cam0_mclk_2ma {
				phandle = <0x58>;

				pins_cmd_dat {
					pinmux = <0x9601>;
					drive-strength = <0x00>;
				};
			};

			camera_pins_cam0_mclk_4ma {
				phandle = <0x59>;

				pins_cmd_dat {
					pinmux = <0x9601>;
					drive-strength = <0x01>;
				};
			};

			camera_pins_cam0_mclk_6ma {
				phandle = <0x5a>;

				pins_cmd_dat {
					pinmux = <0x9601>;
					drive-strength = <0x02>;
				};
			};

			camera_pins_cam0_mclk_8ma {
				phandle = <0x5b>;

				pins_cmd_dat {
					pinmux = <0x9601>;
					drive-strength = <0x03>;
				};
			};

			camera_pins_cam1_mclk_off {
				phandle = <0x5c>;

				pins_cmd_dat {
					pinmux = <0x9900>;
					drive-strength = <0x01>;
				};
			};

			camera_pins_cam1_mclk_2ma {
				phandle = <0x5d>;

				pins_cmd_dat {
					pinmux = <0x9901>;
					drive-strength = <0x00>;
				};
			};

			camera_pins_cam1_mclk_4ma {
				phandle = <0x5e>;

				pins_cmd_dat {
					pinmux = <0x9901>;
					drive-strength = <0x01>;
				};
			};

			camera_pins_cam1_mclk_6ma {
				phandle = <0x5f>;

				pins_cmd_dat {
					pinmux = <0x9901>;
					drive-strength = <0x02>;
				};
			};

			camera_pins_cam1_mclk_8ma {
				phandle = <0x60>;

				pins_cmd_dat {
					pinmux = <0x9901>;
					drive-strength = <0x03>;
				};
			};

			camera_pins_cam2_mclk_off {
				phandle = <0x61>;

				pins_cmd_dat {
					pinmux = <0x9500>;
					drive-strength = <0x01>;
				};
			};

			camera_pins_cam2_mclk_2ma {
				phandle = <0x62>;

				pins_cmd_dat {
					pinmux = <0x9501>;
					drive-strength = <0x00>;
				};
			};

			camera_pins_cam2_mclk_4ma {
				phandle = <0x63>;

				pins_cmd_dat {
					pinmux = <0x9501>;
					drive-strength = <0x01>;
				};
			};

			camera_pins_cam2_mclk_6ma {
				phandle = <0x64>;

				pins_cmd_dat {
					pinmux = <0x9501>;
					drive-strength = <0x02>;
				};
			};

			camera_pins_cam2_mclk_8ma {
				phandle = <0x65>;

				pins_cmd_dat {
					pinmux = <0x9501>;
					drive-strength = <0x03>;
				};
			};

			camera_pins_cam3_mclk_off {
				phandle = <0x66>;

				pins_cmd_dat {
					pinmux = <0x9700>;
					drive-strength = <0x01>;
				};
			};

			camera_pins_cam3_mclk_2ma {
				phandle = <0x67>;

				pins_cmd_dat {
					pinmux = <0x9701>;
					drive-strength = <0x00>;
				};
			};

			camera_pins_cam3_mclk_4ma {
				phandle = <0x68>;

				pins_cmd_dat {
					pinmux = <0x9701>;
					drive-strength = <0x01>;
				};
			};

			camera_pins_cam3_mclk_6ma {
				phandle = <0x69>;

				pins_cmd_dat {
					pinmux = <0x9701>;
					drive-strength = <0x02>;
				};
			};

			camera_pins_cam3_mclk_8ma {
				phandle = <0x6a>;

				pins_cmd_dat {
					pinmux = <0x9701>;
					drive-strength = <0x03>;
				};
			};

			camdefault {
				phandle = <0x4e>;
			};
		};
	};

	fragment@94 {
		target = <0xffffffff>;

		__overlay__ {
			pinctrl-names = "default\0cam0_rst0\0cam0_rst1\0cam1_rst0\0cam1_rst1\0cam2_rst0\0cam2_rst1\0cam3_rst0\0cam3_rst1\0cam0_mclk_off\0cam0_mclk_2mA\0cam0_mclk_4mA\0cam0_mclk_6mA\0cam0_mclk_8mA\0cam1_mclk_off\0cam1_mclk_2mA\0cam1_mclk_4mA\0cam1_mclk_6mA\0cam1_mclk_8mA\0cam2_mclk_off\0cam2_mclk_2mA\0cam2_mclk_4mA\0cam2_mclk_6mA\0cam2_mclk_8mA\0cam3_mclk_off\0cam3_mclk_2mA\0cam3_mclk_4mA\0cam3_mclk_6mA\0cam3_mclk_8mA";
			pinctrl-0 = <0x4e>;
			pinctrl-1 = <0x4f>;
			pinctrl-2 = <0x50>;
			pinctrl-3 = <0x51>;
			pinctrl-4 = <0x52>;
			pinctrl-5 = <0x53>;
			pinctrl-6 = <0x54>;
			pinctrl-7 = <0x55>;
			pinctrl-8 = <0x56>;
			pinctrl-9 = <0x57>;
			pinctrl-10 = <0x58>;
			pinctrl-11 = <0x59>;
			pinctrl-12 = <0x5a>;
			pinctrl-13 = <0x5b>;
			pinctrl-14 = <0x5c>;
			pinctrl-15 = <0x5d>;
			pinctrl-16 = <0x5e>;
			pinctrl-17 = <0x5f>;
			pinctrl-18 = <0x60>;
			pinctrl-19 = <0x61>;
			pinctrl-20 = <0x62>;
			pinctrl-21 = <0x63>;
			pinctrl-22 = <0x64>;
			pinctrl-23 = <0x65>;
			pinctrl-24 = <0x66>;
			pinctrl-25 = <0x67>;
			pinctrl-26 = <0x68>;
			pinctrl-27 = <0x69>;
			pinctrl-28 = <0x6a>;
			cam0_vcamio-supply = <0xffffffff>;
			cam1_vcamio-supply = <0xffffffff>;
			cam2_vcamio-supply = <0xffffffff>;
			cam3_vcamio-supply = <0xffffffff>;
			cam0_enable_sensor = "ov64b_mipi_raw212a1";
			cam1_enable_sensor = "imx615_mipi_raw212a1";
			cam2_enable_sensor = "imx355_mipi_raw212a1";
			cam3_enable_sensor = "gc02m1_mipi_raw212a1";
			status = "okay";
		};
	};

	fragment@95 {
		target = <0xffffffff>;

		__overlay__ {

			camera_eeprom0@50 {
				compatible = "mediatek,camera_eeprom";
				reg = <0x50>;
				status = "okay";
				phandle = <0xa4>;
			};
		};
	};

	fragment@96 {
		target = <0xffffffff>;

		__overlay__ {

			camera_eeprom2@51 {
				compatible = "mediatek,camera_eeprom";
				reg = <0x51>;
				status = "okay";
				phandle = <0xa5>;
			};

			camera_eeprom3@52 {
				compatible = "mediatek,camera_eeprom";
				reg = <0x52>;
				status = "okay";
				phandle = <0xa6>;
			};

			camera_eeprom1@54 {
				compatible = "mediatek,camera_eeprom";
				reg = <0x54>;
				status = "okay";
				phandle = <0xa7>;
			};
		};
	};

	fragment@97 {
		target = <0xffffffff>;

		__overlay__ {

			fan53870@35 {
				compatible = "fan53870";
				reg = <0x35>;
				ldo1_min_vol = "\0\f5";
				ldo1_max_vol = <0x16f300>;
				ldo1_step_vol = <0x1f40>;
				en-gpios = <0xffffffff 0x6d 0x01>;
			};

			wl2868c@2f {
				compatible = "wl2868c-i2c";
				vs2-supply = <0xffffffff>;
				reg = <0x2f>;
				id_reg = <0x00>;
				id_val = <0x82>;
				vin1_vol = "\0\f5";
				vin2_vol = <0x16f300>;
				en-gpios = <0xffffffff 0x6d 0x01>;
			};
		};
	};

	__symbols__ {
		irtx_gpio_led_default = "/fragment@2/__overlay__/irtx_gpio_led_def@gpio139";
		irtx_gpio_led_set = "/fragment@2/__overlay__/irtx_gpio_led_set@gpio139";
		ctp_pins_default_t = "/fragment@7/__overlay__/eintdefault";
		ctp_ts_int_active_t = "/fragment@7/__overlay__/int_active";
		ctp_ts_reset_active_t = "/fragment@7/__overlay__/reset_active";
		ctp_ts_int_suspend_t = "/fragment@7/__overlay__/int_suspend";
		ctp_ts_reset_suspend_t = "/fragment@7/__overlay__/reset_suspend";
		mtkfb_pins_lcm_led_en1 = "/fragment@8/__overlay__/lcm_led_en1_gpio";
		mtkfb_pins_lcm_led_en0 = "/fragment@8/__overlay__/lcm_led_en0_gpio";
		mtkfb_pins_lcd_bias_enp1 = "/fragment@8/__overlay__/lcd_bias_enp1_gpio";
		mtkfb_pins_lcd_bias_enp0 = "/fragment@8/__overlay__/lcd_bias_enp0_gpio";
		mtkfb_pins_lcd_bias_enn1 = "/fragment@8/__overlay__/lcd_bias_enn1_gpio";
		mtkfb_pins_lcd_bias_enn0 = "/fragment@8/__overlay__/lcd_bias_enn0_gpio";
		mtkfb_pins_lcm_rst_out1_gpio = "/fragment@8/__overlay__/lcm_rst_out1_gpio";
		mtkfb_pins_lcm_rst_out0_gpio = "/fragment@8/__overlay__/lcm_rst_out0_gpio";
		mtkfb_pins_lcm_dsi_te = "/fragment@8/__overlay__/lcm_dsi_te";
		panel_in4 = "/fragment@11/__overlay__/panel4@0/port/endpoint";
		dsi_out = "/fragment@11/__overlay__/ports/port/endpoint";
		led0 = "/fragment@14/__overlay__/led@0";
		led1 = "/fragment@14/__overlay__/led@1";
		led2 = "/fragment@14/__overlay__/led@2";
		led3 = "/fragment@14/__overlay__/led@3";
		led4 = "/fragment@14/__overlay__/led@4";
		led5 = "/fragment@14/__overlay__/led@5";
		led6 = "/fragment@14/__overlay__/led@6";
		vibrator0 = "/fragment@14/__overlay__/vibrator@0";
		sensor_fb = "/fragment@14/__overlay__/sensor_fb";
		gsensor_1 = "/fragment@14/__overlay__/gsensor_1";
		msensor_1 = "/fragment@14/__overlay__/msensor_1";
		msensor_2 = "/fragment@14/__overlay__/msensor_2";
		sar_1 = "/fragment@14/__overlay__/sar_1";
		proximity_1 = "/fragment@14/__overlay__/proximity_1";
		light_1 = "/fragment@14/__overlay__/light_1";
		proximity_2 = "/fragment@14/__overlay__/proximity_2";
		light_2 = "/fragment@14/__overlay__/light_2";
		rear_cct_1 = "/fragment@14/__overlay__/rear_cct_1";
		rear_cct_2 = "/fragment@14/__overlay__/rear_cct_2";
		pick_up = "/fragment@14/__overlay__/pick_up";
		lux_aod = "/fragment@14/__overlay__/lux_aod";
		alsps_arch = "/fragment@14/__overlay__/alsps_arch";
		cali_arch = "/fragment@14/__overlay__/cali_arch";
		oplus_boardid = "/fragment@14/__overlay__/oplus_boardid";
		oplus_project = "/fragment@14/__overlay__/oplus_project";
		oplus_devinfo = "/fragment@14/__overlay__/oplus_devinfo";
		kpd_volume_down = "/fragment@14/__overlay__/kpd_volume_down";
		nfc_chipset = "/fragment@14/__overlay__/nfc_chipset";
		volume_up_gpio_eint = "/fragment@16/__overlay__/volume_up@0";
		volume_down_gpio_eint = "/fragment@16/__overlay__/volume_down@0";
		hw_pins_default = "/fragment@16/__overlay__/default@hw_sub_id";
		aboard_pin_gpio0_sleep = "/fragment@16/__overlay__/sleep@id0";
		aboard_pin_gpio0_active = "/fragment@16/__overlay__/active@id0";
		aboard_pin_gpio0_idle = "/fragment@16/__overlay__/idle@id0";
		gps_pins_default = "/fragment@17/__overlay__/gps_default";
		gps_l1_lna_pins_ol = "/fragment@17/__overlay__/gps_l1_lna@0";
		gps_l1_lna_pins_dsp_ctrl = "/fragment@17/__overlay__/gps_l1_lna@1";
		gps_l1_lna_pins_oh = "/fragment@17/__overlay__/gps_l1_lna@2";
		gps_l5_lna_pins_ol = "/fragment@17/__overlay__/gps_l5_lna@0";
		gps_l5_lna_pins_dsp_ctrl = "/fragment@17/__overlay__/gps_l5_lna@1";
		gps_l5_lna_pins_oh = "/fragment@17/__overlay__/gps_l5_lna@2";
		ps_enable = "/fragment@22/__overlay__/ps_enable";
		ps_disable = "/fragment@22/__overlay__/ps_disable";
		sel_up = "/fragment@22/__overlay__/sel_up";
		sel_down = "/fragment@22/__overlay__/sel_down";
		tfa98xx = "/fragment@25/__overlay__/tfa98xx@34";
		gate_ic = "/fragment@25/__overlay__/gate_ic@11";
		fsa_hs_det = "/fragment@26/__overlay__/fsa_hs_det";
		fsa4480 = "/fragment@27/__overlay__/fsa4480@42";
		gpio_id0_default = "/fragment@29/__overlay__/gpio_id0_default";
		oplus_fp = "/fragment@33/__overlay__/fingerprint@0";
		gpio_goodix_reset_default = "/fragment@34/__overlay__/gpio_goodix_reset_default";
		gpio_goodix_irq_default = "/fragment@34/__overlay__/gpio_goodix_irq_default";
		gpio_goodix_clk_6mA = "/fragment@34/__overlay__/gpio_goodix_clk_6mA";
		gpio_goodix_mosi_6mA = "/fragment@34/__overlay__/gpio_goodix_mosi_6mA";
		gpio_goodix_miso_6mA = "/fragment@34/__overlay__/gpio_goodix_miso_6mA";
		gpio_goodix_cs_func = "/fragment@34/__overlay__/gpio_goodix_cs_func";
		camera_main_mtk = "/fragment@40/__overlay__/camera_main@1a";
		camera_main_af_mtk = "/fragment@40/__overlay__/camera_main_af@72";
		nfc_mtk = "/fragment@41/__overlay__/nfc@08";
		camera_main_two_mtk = "/fragment@42/__overlay__/camera_main_two@1a";
		camera_sub_mtk = "/fragment@42/__overlay__/camera_sub@10";
		camera_sub_two_mtk = "/fragment@42/__overlay__/camera_sub_two@37";
		subpmic_mtk = "/fragment@43/__overlay__/subpmic@34";
		usb_type_c_mtk = "/fragment@43/__overlay__/usb_type_c@4e";
		subpmic_pmic_mtk = "/fragment@43/__overlay__/subpmic_pmic@1a";
		subpmic_ldo_mtk = "/fragment@43/__overlay__/subpmic_ldo@64";
		i2c_lcd_bias_mtk = "/fragment@44/__overlay__/i2c_lcd_bias@11";
		aw8697_haptic = "/fragment@67/__overlay__/aw8697_haptic@5A";
		charger_pins_default = "/fragment@72/__overlay__/eint0default";
		charger_pins_eint_output0 = "/fragment@72/__overlay__/charger_gpio_as_output_low";
		charger_pins_eint_output1 = "/fragment@72/__overlay__/charger_gpio_as_output_high";
		ship_sleep_gpio = "/fragment@72/__overlay__/ship_sleep";
		ship_active_gpio = "/fragment@72/__overlay__/ship_active";
		dischg_enable = "/fragment@72/__overlay__/dischg_enable";
		dischg_disable = "/fragment@72/__overlay__/dischg_disable";
		chgvin_enable = "/fragment@72/__overlay__/chgvin_enable";
		chgvin_disable = "/fragment@72/__overlay__/chgvin_disable";
		pmic_chgfunc_enable = "/fragment@72/__overlay__/pmic_chgfunc_enable";
		pmic_chgfunc_disable = "/fragment@72/__overlay__/pmic_chgfunc_disable";
		vooc_ap_data = "/fragment@74/__overlay__/vooc_ap_data";
		vooc_ap_data_new_function = "/fragment@74/__overlay__/vooc_ap_data_new_function";
		charging_switch1_active = "/fragment@76/__overlay__/charging_switch1_active";
		charging_switch1_sleep = "/fragment@76/__overlay__/charging_switch1_sleep";
		charging_clock_active = "/fragment@76/__overlay__/charging_clock_active";
		charging_clock_sleep = "/fragment@76/__overlay__/charging_clock_sleep";
		charging_data_active = "/fragment@76/__overlay__/charging_data_active";
		charging_data_sleep = "/fragment@76/__overlay__/charging_data_sleep";
		charging_reset_active = "/fragment@76/__overlay__/charging_reset_active";
		charging_reset_sleep = "/fragment@76/__overlay__/charging_reset_sleep";
		vooc_asic_id_active = "/fragment@76/__overlay__/vooc_asic_id_active";
		vooc_asic_id_sleep = "/fragment@76/__overlay__/vooc_asic_id_sleep";
		charge_pump_hwid_active = "/fragment@78/__overlay__/charge_pump_hwid_active";
		charge_pump_hwid_sleep = "/fragment@78/__overlay__/charge_pump_hwid_sleep";
		charge_pump_hwid_default = "/fragment@78/__overlay__/charge_pump_hwid_default";
		mps_otg_en_active = "/fragment@78/__overlay__/mps_otg_en_active";
		mps_otg_en_sleep = "/fragment@78/__overlay__/mps_otg_en_sleep";
		mps_otg_en_default = "/fragment@78/__overlay__/mps_otg_en_default";
		uart0_rx_gpio_input = "/fragment@81/__overlay__/uart0_rx_gpio";
		uart0_tx_gpio_input = "/fragment@81/__overlay__/uart0_tx_gpio";
		usbphy_tuning = "/fragment@85/__overlay__/usbphy_tuning";
		i2c7_i2c_state = "/fragment@88/__overlay__/i2c7_sda_i2c_state";
		i2c7_output_low_state = "/fragment@88/__overlay__/i2c7_sda_output_low_state";
		ctp_pins_default = "/fragment@92/__overlay__/eintdefault";
		ctp_gt9896s_pins_default = "/fragment@92/__overlay__/pins_default";
		ctp_ts_int_active = "/fragment@92/__overlay__/int_active";
		ctp_ts_reset_active = "/fragment@92/__overlay__/reset_active";
		ctp_ts_int_suspend = "/fragment@92/__overlay__/int_suspend";
		ctp_ts_reset_suspend = "/fragment@92/__overlay__/reset_suspend";
		ctp_ts_i2c_mode = "/fragment@92/__overlay__/i2cmode_default";
		ctp_ts_int_as_gpio = "/fragment@92/__overlay__/int_high";
		ctp_gt9896s_int_active = "/fragment@92/__overlay__/int1_active";
		ctp_gt9896s_reset_active = "/fragment@92/__overlay__/reset1_active";
		ctp_gt9896s_int_suspend = "/fragment@92/__overlay__/int1_suspend";
		ctp_gt9896s_reset_suspend = "/fragment@92/__overlay__/reset1_suspend";
		ctp_gt9896s_spi_mode = "/fragment@92/__overlay__/spimode_default";
		camera_pins_cam0_rst_0 = "/fragment@93/__overlay__/cam0@0";
		camera_pins_cam0_rst_1 = "/fragment@93/__overlay__/cam0@1";
		camera_pins_cam1_rst_0 = "/fragment@93/__overlay__/cam1@0";
		camera_pins_cam1_rst_1 = "/fragment@93/__overlay__/cam1@1";
		camera_pins_cam2_rst_0 = "/fragment@93/__overlay__/cam2@0";
		camera_pins_cam2_rst_1 = "/fragment@93/__overlay__/cam2@1";
		camera_pins_cam3_rst_0 = "/fragment@93/__overlay__/cam3@0";
		camera_pins_cam3_rst_1 = "/fragment@93/__overlay__/cam3@1";
		camera_pins_cam0_mclk_off = "/fragment@93/__overlay__/camera_pins_cam0_mclk_off";
		camera_pins_cam0_mclk_2ma = "/fragment@93/__overlay__/camera_pins_cam0_mclk_2ma";
		camera_pins_cam0_mclk_4ma = "/fragment@93/__overlay__/camera_pins_cam0_mclk_4ma";
		camera_pins_cam0_mclk_6ma = "/fragment@93/__overlay__/camera_pins_cam0_mclk_6ma";
		camera_pins_cam0_mclk_8ma = "/fragment@93/__overlay__/camera_pins_cam0_mclk_8ma";
		camera_pins_cam1_mclk_off = "/fragment@93/__overlay__/camera_pins_cam1_mclk_off";
		camera_pins_cam1_mclk_2ma = "/fragment@93/__overlay__/camera_pins_cam1_mclk_2ma";
		camera_pins_cam1_mclk_4ma = "/fragment@93/__overlay__/camera_pins_cam1_mclk_4ma";
		camera_pins_cam1_mclk_6ma = "/fragment@93/__overlay__/camera_pins_cam1_mclk_6ma";
		camera_pins_cam1_mclk_8ma = "/fragment@93/__overlay__/camera_pins_cam1_mclk_8ma";
		camera_pins_cam2_mclk_off = "/fragment@93/__overlay__/camera_pins_cam2_mclk_off";
		camera_pins_cam2_mclk_2ma = "/fragment@93/__overlay__/camera_pins_cam2_mclk_2ma";
		camera_pins_cam2_mclk_4ma = "/fragment@93/__overlay__/camera_pins_cam2_mclk_4ma";
		camera_pins_cam2_mclk_6ma = "/fragment@93/__overlay__/camera_pins_cam2_mclk_6ma";
		camera_pins_cam2_mclk_8ma = "/fragment@93/__overlay__/camera_pins_cam2_mclk_8ma";
		camera_pins_cam3_mclk_off = "/fragment@93/__overlay__/camera_pins_cam3_mclk_off";
		camera_pins_cam3_mclk_2ma = "/fragment@93/__overlay__/camera_pins_cam3_mclk_2ma";
		camera_pins_cam3_mclk_4ma = "/fragment@93/__overlay__/camera_pins_cam3_mclk_4ma";
		camera_pins_cam3_mclk_6ma = "/fragment@93/__overlay__/camera_pins_cam3_mclk_6ma";
		camera_pins_cam3_mclk_8ma = "/fragment@93/__overlay__/camera_pins_cam3_mclk_8ma";
		camera_pins_default = "/fragment@93/__overlay__/camdefault";
		mtk_camera_eeprom0 = "/fragment@95/__overlay__/camera_eeprom0@50";
		mtk_camera_eeprom2 = "/fragment@96/__overlay__/camera_eeprom2@51";
		mtk_camera_eeprom3 = "/fragment@96/__overlay__/camera_eeprom3@52";
		mtk_camera_eeprom1 = "/fragment@96/__overlay__/camera_eeprom1@54";
	};

	__fixups__ {
		chosen = "/fragment@0:target:0";
		irtx_pwm = "/fragment@1:target:0";
		pio = "/fragment@2:target:0\0/fragment@3/__overlay__:mt6360,intr_gpio:0\0/fragment@5/__overlay__:mt6360pd,intr_gpio:0\0/fragment@6/__overlay__/Focaltech20181@38:interrupt-parent:0\0/fragment@6/__overlay__/Focaltech20181@38:irq-gpio:0\0/fragment@6/__overlay__/Focaltech20181@38:reset-gpio:0\0/fragment@7:target:0\0/fragment@8:target:0\0/fragment@11/__overlay__/panel4@0:pm-enable-gpios:0\0/fragment@11/__overlay__/panel4@0:reset-gpios:0\0/fragment@11/__overlay__/panel4@0:bias-gpios:0\0/fragment@13/__overlay__/nfc_nxp@28:nxp,pn544-irq:0\0/fragment@13/__overlay__/nfc_nxp@28:nxp,pn544-ven:0\0/fragment@13/__overlay__/nfc_nxp@28:nxp,pn544-fw-dwnld:0\0/fragment@13/__overlay__/nfc_nxp@28:interrupt-parent:0\0/fragment@14/__overlay__/kpd_volume_down:interrupt-parent:0\0/fragment@15/__overlay__:keypad,volume-up:0\0/fragment@15/__overlay__:keypad,volume-down:0\0/fragment@16:target:0\0/fragment@17:target:0\0/fragment@22:target:0\0/fragment@24/__overlay__/fan53870@35:en-gpios:0\0/fragment@25/__overlay__/tfa98xx@34:reset-gpio:0\0/fragment@25/__overlay__/gate_ic@11:gate-power-gpios:0\0/fragment@26:target:0\0/fragment@27/__overlay__/fsa4480@42:fsa4480,hs-det-gpio:0\0/fragment@27/__overlay__/fsa4480@42:fsa4480,reset-gpio:0\0/fragment@28/__overlay__:oplus,fp_gpio_0:0\0/fragment@29:target:0\0/fragment@30/__overlay__:goodix,gpio_irq:0\0/fragment@30/__overlay__:goodix,gpio_reset:0\0/fragment@30/__overlay__:goodix,gpio_cs:0\0/fragment@31/__overlay__:cd-gpios:0\0/fragment@33/__overlay__/fingerprint@0:pw_en_gpio:0\0/fragment@34:target:0\0/fragment@50/__overlay__:GPIO_FDD_BAND_SUPPORT_DETECT_1ST_PIN:0\0/fragment@50/__overlay__:GPIO_FDD_BAND_SUPPORT_DETECT_2ND_PIN:0\0/fragment@50/__overlay__:GPIO_FDD_BAND_SUPPORT_DETECT_3RD_PIN:0\0/fragment@50/__overlay__:GPIO_FDD_BAND_SUPPORT_DETECT_4TH_PIN:0\0/fragment@50/__overlay__:GPIO_RF_PWREN_RST_PIN:0\0/fragment@50/__overlay__:GPIO_SIM2_SIO:0\0/fragment@50/__overlay__:GPIO_SIM2_SCLK:0\0/fragment@50/__overlay__:GPIO_SIM2_SRST:0\0/fragment@50/__overlay__:GPIO_SIM1_SRST:0\0/fragment@50/__overlay__:GPIO_SIM1_SCLK:0\0/fragment@50/__overlay__:GPIO_SIM1_SIO:0\0/fragment@50/__overlay__:GPIO_SIM1_HOT_PLUG:0\0/fragment@50/__overlay__:GPIO_SIM2_HOT_PLUG:0\0/fragment@52/__overlay__:interrupt-parent:0\0/fragment@53/__overlay__:interrupt-parent:0\0/fragment@54/__overlay__:interrupt-parent:0\0/fragment@55/__overlay__:interrupt-parent:0\0/fragment@56/__overlay__:interrupt-parent:0\0/fragment@57/__overlay__:interrupt-parent:0\0/fragment@58/__overlay__:interrupt-parent:0\0/fragment@58/__overlay__:deb-gpios:0\0/fragment@59/__overlay__:interrupt-parent:0\0/fragment@68/__overlay__:mt6360,intr_gpio:0\0/fragment@69/__overlay__:mt6360pd,intr_gpio:0\0/fragment@71/__overlay__:qcom,chargerid_switch-gpio:0\0/fragment@71/__overlay__:qcom,ship-gpio:0\0/fragment@71/__overlay__:qcom,dischg-gpio:0\0/fragment@71/__overlay__:qcom,chgvin:0\0/fragment@71/__overlay__:qcom,pmic_chgfunc:0\0/fragment@72:target:0\0/fragment@75/__overlay__/rk826_fastcg@0a:qcom,charging_switch1-gpio:0\0/fragment@75/__overlay__/rk826_fastcg@0a:qcom,charging_reset-gpio:0\0/fragment@75/__overlay__/rk826_fastcg@0a:qcom,charging_clock-gpio:0\0/fragment@75/__overlay__/rk826_fastcg@0a:qcom,charging_data-gpio:0\0/fragment@75/__overlay__/rk826_fastcg@0a:qcom,vooc_asic_id-gpio:0\0/fragment@76:target:0\0/fragment@77/__overlay__/charge_pump-divider@68:oplus,charge_pump-hwid-gpio:0\0/fragment@77/__overlay__/mp2650-charger@5c:qcom,mps_otg_en-gpio:0\0/fragment@78:target:0\0/fragment@81:target:0\0/fragment@88:target:0\0/fragment@90/__overlay__/gt9886@5d:interrupt-parent:0\0/fragment@90/__overlay__/gt9886@5d:goodix,irq-gpio:0\0/fragment@90/__overlay__/gt9886@5d:goodix,reset-gpio:0\0/fragment@91/__overlay__/gt9896s@0:goodix,irq-gpio:0\0/fragment@91/__overlay__/gt9896s@0:goodix,reset-gpio:0\0/fragment@92:target:0\0/fragment@93:target:0\0/fragment@97/__overlay__/fan53870@35:en-gpios:0\0/fragment@97/__overlay__/wl2868c@2f:en-gpios:0";
		mt6360_pmu = "/fragment@3:target:0\0/fragment@68:target:0";
		mt6360_pmic = "/fragment@4:target:0";
		mt6360_typec = "/fragment@5:target:0\0/fragment@69:target:0";
		i2c0 = "/fragment@6:target:0\0/fragment@38:target:0\0/fragment@90:target:0";
		mt_pmic_vtp_ldo_reg = "/fragment@6/__overlay__/Focaltech20181@38:vdd_2v8-supply:0\0/fragment@63:target:0\0/fragment@65/__overlay__:vtouch-supply:0\0/fragment@90/__overlay__/gt9886@5d:vtouch-supply:0\0/fragment@91/__overlay__/gt9896s@0:vtouch-supply:0";
		mtkfb = "/fragment@9:target:0";
		dispsys_config = "/fragment@10:target:0";
		dsi0 = "/fragment@11:target:0";
		mt_pmic_vmc_ldo_reg = "/fragment@11/__overlay__/panel4@0:ldo3-supply:0";
		disp_leds = "/fragment@12:target:0";
		i2c8 = "/fragment@13:target:0\0/fragment@24:target:0\0/fragment@46:target:0\0/fragment@97:target:0";
		odm = "/fragment@14:target:0\0/fragment@74:target:0\0/fragment@85:target:0";
		auxadc = "/fragment@14/__overlay__/oplus_devinfo:io-channels:0\0/fragment@35:target:0\0/fragment@36/__overlay__:io-channels:0\0/fragment@71/__overlay__:io-channels:0\0/fragment@71/__overlay__:io-channels:8\0/fragment@71/__overlay__:io-channels:16";
		keypad = "/fragment@15:target:0\0/fragment@66:target:0";
		gps = "/fragment@18:target:0";
		accdet = "/fragment@19:target:0";
		ps5169 = "/fragment@20:target:0\0/fragment@83:target:0";
		fusb340 = "/fragment@21:target:0\0/fragment@84:target:0";
		swtp = "/fragment@23:target:0\0/fragment@58:target:0";
		i2c6 = "/fragment@25:target:0\0/fragment@27:target:0\0/fragment@44:target:0";
		oplus_fp_common = "/fragment@28:target:0";
		goodix_fp = "/fragment@30:target:0";
		msdc1 = "/fragment@31:target:0";
		mt_pmic_vmch_ldo_reg = "/fragment@31/__overlay__:vmmc-supply:0";
		mt6360_ldo = "/fragment@32:target:0";
		spi5 = "/fragment@33:target:0";
		md_auxadc = "/fragment@36:target:0";
		pmic_clock_buffer_ctrl = "/fragment@37:target:0";
		i2c1 = "/fragment@39:target:0";
		i2c2 = "/fragment@40:target:0\0/fragment@95:target:0";
		i2c3 = "/fragment@41:target:0";
		i2c4 = "/fragment@42:target:0\0/fragment@96:target:0";
		i2c5 = "/fragment@43:target:0";
		i2c7 = "/fragment@45:target:0\0/fragment@75:target:0\0/fragment@87:target:0";
		i2c9 = "/fragment@47:target:0\0/fragment@67:target:0";
		i2c10 = "/fragment@48:target:0\0/fragment@77:target:0";
		i2c11 = "/fragment@49:target:0";
		gpio_usage_mapping = "/fragment@50:target:0";
		gpio = "/fragment@51:target:0";
		mrdump_ext_rst = "/fragment@52:target:0";
		msdc1_ins = "/fragment@53:target:0";
		subpmic_pmu_eint = "/fragment@54:target:0";
		irq_nfc = "/fragment@55:target:0\0/fragment@56:target:0";
		touch_panel = "/fragment@57:target:0";
		dsi_te = "/fragment@59:target:0";
		md1_sim1_hot_plug_eint = "/fragment@60:target:0";
		md1_sim2_hot_plug_eint = "/fragment@61:target:0";
		mt_pmic_vcamio_ldo_reg = "/fragment@62:target:0\0/fragment@64/__overlay__:vcamio-supply:0\0/fragment@94/__overlay__:cam0_vcamio-supply:0\0/fragment@94/__overlay__:cam1_vcamio-supply:0\0/fragment@94/__overlay__:cam2_vcamio-supply:0\0/fragment@94/__overlay__:cam3_vcamio-supply:0";
		kd_camera_hw1 = "/fragment@64:target:0\0/fragment@94:target:0";
		touch = "/fragment@65:target:0";
		lk_charger = "/fragment@70:target:0";
		charger = "/fragment@71:target:0";
		bat_gm30 = "/fragment@73:target:0";
		apuart0 = "/fragment@79:target:0";
		apuart1 = "/fragment@80:target:0";
		typec_mux_switch = "/fragment@82:target:0";
		usb_boost_manager = "/fragment@86:target:0";
		rt5133 = "/fragment@89:target:0";
		spi4 = "/fragment@91:target:0";
		mt_pmic_vs2_buck_reg = "/fragment@97/__overlay__/wl2868c@2f:vs2-supply:0";
	};

	__local_fixups__ {

		fragment@1 {

			__overlay__ {
				pinctrl-0 = <0x00>;
				pinctrl-1 = <0x00>;
			};
		};

		fragment@9 {

			__overlay__ {
				pinctrl-0 = <0x00>;
				pinctrl-1 = <0x00>;
				pinctrl-2 = <0x00>;
				pinctrl-3 = <0x00>;
				pinctrl-4 = <0x00>;
				pinctrl-5 = <0x00>;
				pinctrl-6 = <0x00>;
				pinctrl-7 = <0x00>;
				pinctrl-8 = <0x00>;
			};
		};

		fragment@10 {

			__overlay__ {
				pinctrl-0 = <0x00>;
				pinctrl-1 = <0x00>;
				pinctrl-2 = <0x00>;
			};
		};

		fragment@11 {

			__overlay__ {

				panel4@0 {

					port {

						endpoint {
							remote-endpoint = <0x00>;
						};
					};
				};

				ports {

					port {

						endpoint {
							remote-endpoint = <0x00>;
						};
					};
				};
			};
		};

		fragment@15 {

			__overlay__ {
				pinctrl-0 = <0x00>;
				pinctrl-1 = <0x00>;
			};
		};

		fragment@18 {

			__overlay__ {
				pinctrl-0 = <0x00>;
				pinctrl-1 = <0x00>;
				pinctrl-2 = <0x00>;
				pinctrl-3 = <0x00>;
				pinctrl-4 = <0x00>;
				pinctrl-5 = <0x00>;
				pinctrl-6 = <0x00>;
			};
		};

		fragment@20 {

			__overlay__ {
				pinctrl-0 = <0x00>;
				pinctrl-1 = <0x00>;
			};
		};

		fragment@21 {

			__overlay__ {
				pinctrl-0 = <0x00>;
				pinctrl-1 = <0x00>;
			};
		};

		fragment@27 {

			__overlay__ {

				fsa4480@42 {
					pinctrl-0 = <0x00>;
				};
			};
		};

		fragment@28 {

			__overlay__ {
				pinctrl-0 = <0x00>;
			};
		};

		fragment@30 {

			__overlay__ {
				pinctrl-0 = <0x00 0x04>;
				pinctrl-1 = <0x00 0x04 0x08>;
				pinctrl-2 = <0x00>;
			};
		};

		fragment@71 {

			__overlay__ {
				pinctrl-0 = <0x00>;
				pinctrl-1 = <0x00>;
				pinctrl-2 = <0x00>;
				pinctrl-3 = <0x00>;
				pinctrl-4 = <0x00>;
				pinctrl-5 = <0x00>;
				pinctrl-6 = <0x00>;
				pinctrl-7 = <0x00>;
				pinctrl-8 = <0x00>;
				pinctrl-9 = <0x00>;
				pinctrl-10 = <0x00>;
			};
		};

		fragment@75 {

			__overlay__ {

				rk826_fastcg@0a {
					pinctrl-0 = <0x00>;
					pinctrl-1 = <0x00>;
					pinctrl-2 = <0x00>;
					pinctrl-3 = <0x00>;
					pinctrl-4 = <0x00>;
					pinctrl-5 = <0x00>;
					pinctrl-6 = <0x00>;
					pinctrl-7 = <0x00>;
					pinctrl-8 = <0x00>;
					pinctrl-9 = <0x00>;
					pinctrl-10 = <0x00>;
					pinctrl-11 = <0x00>;
					pinctrl-12 = <0x00>;
					pinctrl-13 = <0x00>;
				};
			};
		};

		fragment@77 {

			__overlay__ {

				charge_pump-divider@68 {
					pinctrl-0 = <0x00>;
					pinctrl-1 = <0x00>;
					pinctrl-2 = <0x00>;
				};

				mp2650-charger@5c {
					pinctrl-0 = <0x00>;
					pinctrl-1 = <0x00>;
					pinctrl-2 = <0x00>;
				};
			};
		};

		fragment@79 {

			__overlay__ {
				pinctrl-0 = <0x00>;
				pinctrl-1 = <0x00>;
			};
		};

		fragment@87 {

			__overlay__ {
				pinctrl-0 = <0x00>;
				pinctrl-1 = <0x00>;
			};
		};

		fragment@90 {

			__overlay__ {
				pinctrl-0 = <0x00>;
				pinctrl-1 = <0x00>;
				pinctrl-2 = <0x00>;
				pinctrl-3 = <0x00>;
				pinctrl-4 = <0x00>;
				pinctrl-5 = <0x00>;
			};
		};

		fragment@91 {

			__overlay__ {
				pinctrl-0 = <0x00>;
				pinctrl-1 = <0x00>;
				pinctrl-2 = <0x00>;
				pinctrl-3 = <0x00>;
				pinctrl-4 = <0x00>;
				pinctrl-5 = <0x00>;
			};
		};

		fragment@94 {

			__overlay__ {
				pinctrl-0 = <0x00>;
				pinctrl-1 = <0x00>;
				pinctrl-2 = <0x00>;
				pinctrl-3 = <0x00>;
				pinctrl-4 = <0x00>;
				pinctrl-5 = <0x00>;
				pinctrl-6 = <0x00>;
				pinctrl-7 = <0x00>;
				pinctrl-8 = <0x00>;
				pinctrl-9 = <0x00>;
				pinctrl-10 = <0x00>;
				pinctrl-11 = <0x00>;
				pinctrl-12 = <0x00>;
				pinctrl-13 = <0x00>;
				pinctrl-14 = <0x00>;
				pinctrl-15 = <0x00>;
				pinctrl-16 = <0x00>;
				pinctrl-17 = <0x00>;
				pinctrl-18 = <0x00>;
				pinctrl-19 = <0x00>;
				pinctrl-20 = <0x00>;
				pinctrl-21 = <0x00>;
				pinctrl-22 = <0x00>;
				pinctrl-23 = <0x00>;
				pinctrl-24 = <0x00>;
				pinctrl-25 = <0x00>;
				pinctrl-26 = <0x00>;
				pinctrl-27 = <0x00>;
				pinctrl-28 = <0x00>;
			};
		};
	};
};
