/dts-v1/;

/ {

	fragment@0 {
		target = <0xffffffff>;

		__overlay__ {
			atag,videolfb-fb_base_l = "~`P";
			atag,videolfb-fb_base_h = <0x00>;
			atag,videolfb-islcmfound = <0x01>;
			atag,videolfb-islcm_inited = <0x00>;
			atag,videolfb-fps = <0x1770>;
			atag,videolfb-vramSize = <0x1be0000>;
			atag,videolfb-lcmname = "td4330_fhdp_dsi_cmd_auo_rt4831_drv";
		};
	};

	fragment@1 {
		target = <0xffffffff>;

		__overlay__ {
			pinctrl-names = "irtx_gpio_led_default\0irtx_gpio_led_set";
			pinctrl-0 = <0x01>;
			pinctrl-1 = <0x02>;
			status = "okay";
		};
	};

	fragment@2 {
		target = <0xffffffff>;

		__overlay__ {

			irtx_gpio_led_def@gpio139 {
				phandle = <0x01>;

				pins_cmd_dat {
					pinmux = <0x8b00>;
					slew-rate = <0x01>;
					bias-disable;
					output-low;
					input-schmitt-enable = <0x00>;
				};
			};

			irtx_gpio_led_set@gpio139 {
				phandle = <0x02>;

				pins_cmd_dat {
					pinmux = <0x8b02>;
					slew-rate = <0x01>;
					output-high;
				};
			};
		};
	};

	fragment@3 {
		target = <0xffffffff>;

		__overlay__ {
			mt6360,intr_gpio_num = <0x04>;
			mt6360,intr_gpio = <0xffffffff 0x04 0x00>;
		};
	};

	fragment@4 {
		target = <0xffffffff>;

		__overlay__ {
			pwr_off_seq = <0x4000002>;
		};
	};

	fragment@5 {
		target = <0xffffffff>;

		__overlay__ {
			mt6360pd,intr_gpio_num = <0x05>;
			mt6360pd,intr_gpio = <0xffffffff 0x05 0x00>;
		};
	};

	fragment@6 {
		target = <0xffffffff>;

		__overlay__ {
			status = "okay";

			Focaltech20181@38 {
				compatible = "focaltech,fts";
				reg = <0x38>;
				chip-name = "FT3518";
				interrupt-parent = <0xffffffff>;
				interrupts = <0x0e 0x2002>;
				vdd_2v8-supply = <0xffffffff>;
				vdd_2v8_volt = <0x2dc6c0>;
				irq-gpio = <0xffffffff 0x0e 0x2002>;
				reset-gpio = <0xffffffff 0x0f 0x01>;
				vid_len = <0x02>;
				tp_type = <0x08>;
				platform_support_project = <0x5259>;
				platform_support_project_dir = <0x5259>;
				platform_support_project_commandline = "default_commandline";
				touchpanel,max-num-support = <0x0a>;
				touchpanel,tx-rx-num = <0x10 0x22>;
				touchpanel,panel-coords = <0x10e0 0x2580>;
				touchpanel,display-coords = <0x438 0x960>;
				touchpanel,touchmajor-limit = <0x00 0xd8>;
				touchpanel,report-rate = <0x78 0xb4>;
				touchpanel,smooth-level = <0xff 0x02 0x0f 0x19 0x2d 0x3c>;
				touchpanel,smooth-level-charging = <0xff 0x0f 0x14 0x19 0x2d 0x3c>;
				touchpanel,sensitive-level = <0xff 0x14 0x10 0x0d 0x0a 0x05>;
				touchpanel,single-optimized-time = <0x08>;
				touchpanel,game_perf_para_default = <0x19 0x07>;
				black_gesture_support;
				fw_edge_limit_support;
				pressure_report_support;
				charger_pump_support;
				game_switch_support;
				smart_gesture_support;
				fw_update_app_support;
				fingerprint_underscreen_support;
				headset_pump_support;
				health_monitor_v2_support;
				high_resolution_support;
				lcd_tp_refresh_support;
				touchpanel,button-type = <0x04>;
				touchpanel.button-TRx = <0x00 0x00>;
			};
		};
	};

	fragment@7 {
		target = <0xffffffff>;

		__overlay__ {

			eintdefault {
				phandle = <0x5f>;
			};

			int_active {
				phandle = <0x60>;

				pins_cmd_dat {
					pinmux = <0xe00>;
					slew-rate = <0x00>;
					bias-pull-down = <0x00>;
				};
			};

			reset_active {
				phandle = <0x61>;

				pins_cmd_dat {
					pinmux = <0xf00>;
					slew-rate = <0x01>;
					output-high;
				};
			};

			int_suspend {
				phandle = <0x62>;

				pins_cmd_dat {
					pinmux = <0xe00>;
					slew-rate = <0x01>;
					output-low;
				};
			};

			reset_suspend {
				phandle = <0x63>;

				pins_cmd_dat {
					pinmux = <0xf00>;
					slew-rate = <0x00>;
					output-low;
				};
			};
		};
	};

	fragment@8 {
		target = <0xffffffff>;

		__overlay__ {

			lcm_led_en1_gpio {
				phandle = <0x03>;

				pins_cmd_dat {
					pinmux = <0x6b00>;
					slew-rate = <0x01>;
					output-high;
				};
			};

			lcm_led_en0_gpio {
				phandle = <0x04>;

				pins_cmd_dat {
					pinmux = <0x6b00>;
					slew-rate = <0x01>;
					output-low;
				};
			};

			lcd_bias_enp1_gpio {
				phandle = <0x05>;

				pins_cmd_dat {
					pinmux = <0x6c00>;
					slew-rate = <0x01>;
					output-high;
				};
			};

			lcd_bias_enp0_gpio {
				phandle = <0x06>;

				pins_cmd_dat {
					pinmux = <0x6c00>;
					slew-rate = <0x01>;
					output-low;
				};
			};

			lcd_bias_enn1_gpio {
				phandle = <0x07>;

				pins_cmd_dat {
					pinmux = <0x6f00>;
					slew-rate = <0x01>;
					output-high;
				};
			};

			lcd_bias_enn0_gpio {
				phandle = <0x08>;

				pins_cmd_dat {
					pinmux = <0x6f00>;
					slew-rate = <0x01>;
					output-low;
				};
			};

			lcm_rst_out1_gpio {
				phandle = <0x09>;

				pins_cmd_dat {
					pinmux = <0x2800>;
					slew-rate = <0x01>;
					output-high;
				};
			};

			lcm_rst_out0_gpio {
				phandle = <0x0a>;

				pins_cmd_dat {
					pinmux = <0x2800>;
					slew-rate = <0x01>;
					output-low;
				};
			};

			lcm_dsi_te {
				phandle = <0x0b>;

				pins_cmd_dat {
					pinmux = <0x2701>;
				};
			};
		};
	};

	fragment@9 {
		target = <0xffffffff>;

		__overlay__ {
			pinctrl-names = "lcm_led_en1_gpio\0lcm_led_en0_gpio\0lcd_bias_enp1_gpio\0lcd_bias_enp0_gpio\0lcd_bias_enn1_gpio\0lcd_bias_enn0_gpio\0lcm_rst_out1_gpio\0lcm_rst_out0_gpio\0mode_te_te";
			pinctrl-0 = <0x03>;
			pinctrl-1 = <0x04>;
			pinctrl-2 = <0x05>;
			pinctrl-3 = <0x06>;
			pinctrl-4 = <0x07>;
			pinctrl-5 = <0x08>;
			pinctrl-6 = <0x09>;
			pinctrl-7 = <0x0a>;
			pinctrl-8 = <0x0b>;
			status = "disable";
		};
	};

	fragment@10 {
		target = <0xffffffff>;

		__overlay__ {
			pinctrl-names = "lcm_rst_out1_gpio\0lcm_rst_out0_gpio\0mode_te_te";
			pinctrl-0 = <0x09>;
			pinctrl-1 = <0x0a>;
			pinctrl-2 = <0x0b>;
			status = "okay";
			helper-value = <0x00 0x01 0x01 0x00 0x01 0x00 0x01 0x00 0x00 0x00 0x01 0x00 0x01 0x01 0x01 0x01 0x00 0x01 0x01 0x01 0x00 0x01 0x00 0x01 0x00 0x00 0x00 0x00 0x01 0x00 0x00 0x00 0x00 0x00 0x01 0x00 0x00 0x00 0x01 0x01>;
		};
	};

	fragment@11 {
		target = <0xffffffff>;

		__overlay__ {
			status = "okay";
			#address-cells = <0x01>;
			#size-cells = <0x00>;

			panel3@0 {
				compatible = "oplus21081_samsung_ams643ag01_1080p_dsi_cmd,lcm";
				reg = <0x01>;
				pm-enable-gpios = <0xffffffff 0x27 0x00>;
				reset-gpios = <0xffffffff 0x28 0x00>;
				bias-gpios = <0xffffffff 0x6e 0x00>;
				ldo3-supply = <0xffffffff>;
				pinctrl-names = "default";

				port {

					endpoint {
						remote-endpoint = <0x0c>;
						phandle = <0x0d>;
					};
				};
			};

			ports {

				port {

					endpoint {
						remote-endpoint = <0x0d>;
						phandle = <0x0c>;
					};
				};
			};
		};
	};

	fragment@12 {
		target = <0xffffffff>;

		__overlay__ {
			compatible = "mediatek,disp-leds";

			backlight {
				label = "lcd-backlight";
				max-brightness = <0xfff>;
				led-bits = <0x0c>;
				trans-bits = <0x0c>;
				default-state = "on";
			};
		};
	};

	fragment@13 {
		target = <0xffffffff>;

		__overlay__ {

			led@0 {
				compatible = "mediatek,red";
				led_mode = <0x00>;
				data = <0x01>;
				pwm_config = <0x00 0x00 0x00 0x00 0x00>;
				phandle = <0x64>;
			};

			led@1 {
				compatible = "mediatek,green";
				led_mode = <0x00>;
				data = <0x01>;
				pwm_config = <0x00 0x00 0x00 0x00 0x00>;
				phandle = <0x65>;
			};

			led@2 {
				compatible = "mediatek,blue";
				led_mode = <0x00>;
				data = <0x01>;
				pwm_config = <0x00 0x00 0x00 0x00 0x00>;
				phandle = <0x66>;
			};

			led@3 {
				compatible = "mediatek,jogball-backlight";
				led_mode = <0x00>;
				data = <0x01>;
				pwm_config = <0x00 0x00 0x00 0x00 0x00>;
				phandle = <0x67>;
			};

			led@4 {
				compatible = "mediatek,keyboard-backlight";
				led_mode = <0x00>;
				data = <0x01>;
				pwm_config = <0x00 0x00 0x00 0x00 0x00>;
				phandle = <0x68>;
			};

			led@5 {
				compatible = "mediatek,button-backlight";
				led_mode = <0x00>;
				data = <0x01>;
				pwm_config = <0x00 0x00 0x00 0x00 0x00>;
				phandle = <0x69>;
			};

			led@6 {
				compatible = "mediatek,lcd-backlight";
				led_mode = <0x04>;
				data = <0x01>;
				led_config = <0x08 0x0b>;
				phandle = <0x6a>;
			};

			vibrator@0 {
				compatible = "mediatek,vibrator";
				vib_timer = <0x1e>;
				vib_limit = <0x00>;
				vib_vol = <0x0b>;
				lk_vib_vol = <0x0b>;
				status = "okay";
				phandle = <0x6b>;
			};

			sensor_fb {
				compatible = "oplus,sensor-feedback";
				phandle = <0x6c>;
			};

			gsensor_1 {
				status = "okay";
				sensor_name = <0x07>;
				device_name = "icm4x6xx";
				i2c_num = <0x02>;
				i2c_addr = <0x00>;
				direction = <0x00>;
				eint_num = <0x01>;
				step_count_7_en = <0x01>;
				config_miso = <0x01>;
				correct_y_bias = <0x01>;
				gyro_cali_version = <0x02>;
				acc_cali_range = <0x12c 0x12c 0x12c>;
				phandle = <0x6d>;
			};

			gsensor_2 {
				status = "okay";
				sensor_name = <0x06>;
				device_name = "lsm6dso";
				i2c_num = <0x02>;
				i2c_addr = <0x00>;
				direction = <0x05>;
				eint_num = <0x14>;
				gyro_cali_version = <0x02>;
				acc_cali_range = <0xc8 0xc8 0xc8>;
				phandle = <0x6e>;
			};

			gsensor_3 {
				status = "okay";
				sensor_name = <0x04>;
				device_name = "lsm6dsm";
				i2c_num = <0x02>;
				i2c_addr = <0x00>;
				direction = <0x00>;
				eint_num = <0x01>;
				gyro_cali_version = <0x02>;
				acc_cali_range = <0x12c 0x12c 0x12c>;
				phandle = <0x6f>;
			};

			msensor_1 {
				status = "okay";
				sensor_name = <0x00>;
				i2c_num = <0x00>;
				i2c_addr = <0x0c>;
				direction = <0x01>;
				eint_num = <0x00>;
				soft-mag-parameter = <0x2533 0x00 0xa2 0x01 0xb6 0x00 0xf0 0x01 0x2914 0x00 0x29 0x01 0x53 0x00 0x39 0x00 0x28cc 0x00>;
				phandle = <0x70>;
			};

			msensor_2 {
				status = "okay";
				sensor_name = <0x02>;
				i2c_num = <0x00>;
				i2c_addr = <0x30>;
				direction = <0x01>;
				eint_num = <0x00>;
				soft-mag-parameter = <0x2705 0x00 0xef 0x00 0x184 0x00 0x27 0x01 0x2b0f 0x00 0x1e 0x00 0x25 0x00 0xca 0x00 0x2d8a 0x00>;
				phandle = <0x71>;
			};

			sar_1 {
				status = "okay";
				sensor_name = <0x00>;
				i2c_num = <0x00>;
				i2c_addr = <0x28>;
				direction = <0x04>;
				eint_num = <0x0d>;
				channel_num = <0x03>;
				channel_0_min = <0x18af>;
				channel_0_max = <0x2506>;
				channel_1_min = <0x2452>;
				channel_1_max = <0x367a>;
				channel_2_min = <0x2a9>;
				channel_2_max = <0x3fe>;
				channel_3_min = <0x00>;
				channel_3_max = <0x11170>;
				reg_table_num = <0x03>;
				phandle = <0x72>;
			};

			proximity_1 {
				status = "okay";
				sensor_name = <0x06>;
				i2c_num = <0x00>;
				i2c_addr = <0x48>;
				direction = <0x04>;
				eint_num = <0x02>;
				low_step = <0x12c>;
				high_step = <0x190>;
				low_limit = <0x190>;
				high_limit = <0x258>;
				dirty_low_step = <0x12c>;
				dirty_high_step = <0x190>;
				ps_dirty_limit = <0x708>;
				ps_ir_limit = <0x7d0>;
				ps_adjust_min = <0x00>;
				ps_adjust_max = <0x73a>;
				sampling_count = <0x05>;
				step_max = <0x190>;
				step_min = <0x64>;
				step_div = <0x7d0>;
				anti_shake_delta = <0x46>;
				dynamic_cali_max = <0x7d0>;
				raw2offset_radio = <0x3e8>;
				offset_max = <0xea60>;
				offset_range_min = <0x00>;
				offset_range_max = <0xffff>;
				force_cali_limit = <0x7d0>;
				cali_jitter_limit = <0x14>;
				cal_offset_margin = <0xbb8>;
				sensor-reg = <0x03 0x28>;
				phandle = <0x73>;
			};

			light_1 {
				status = "okay";
				sensor_name = <0x06>;
				i2c_num = <0x00>;
				i2c_addr = <0x48>;
				direction = <0x04>;
				eint_num = <0x02>;
				als_buffer_length = <0x08>;
				als_ratio = <0x6e>;
				als_type = <0x02>;
				device_name = "stk32600";
				use_als_c2 = <0x01>;
				use_lb_algo = <0x01>;
				linear_comp_scope = <0x7c>;
				linear_comp_intercept = <0x36f5>;
				temp_lux = <0x0a>;
				coef = <0x85>;
				ir_coef_stage0 = <0x40>;
				ir_coef_stage1 = <0x59>;
				ir_coef_stage2 = <0x73>;
				ir_coef_stage3 = <0x7f>;
				ir_coef_val1 = <0x1b8>;
				ir_coef_val2 = <0x122>;
				ir_coef_val3 = <0xbe>;
				ir_coef_val4 = <0xaa>;
				phandle = <0x74>;
			};

			proximity_2 {
				status = "okay";
				sensor_name = <0x05>;
				i2c_num = <0x00>;
				i2c_addr = <0x39>;
				direction = <0x04>;
				eint_num = <0x02>;
				low_step = <0x12c>;
				high_step = <0x190>;
				low_limit = <0x190>;
				high_limit = <0x258>;
				dirty_low_step = <0xb4>;
				dirty_high_step = <0xfa>;
				ps_dirty_limit = <0x3ff>;
				ps_ir_limit = <0x1f4>;
				ps_adjust_min = <0x00>;
				ps_adjust_max = <0x258>;
				sampling_count = <0x05>;
				step_max = <0x190>;
				step_min = <0x6e>;
				step_div = <0x5dc>;
				anti_shake_delta = <0x50>;
				dynamic_cali_max = <0x400>;
				raw2offset_radio = <0x5140>;
				offset_max = <0xfa>;
				offset_range_min = <0xff>;
				offset_range_max = <0xff>;
				force_cali_limit = <0x7d0>;
				cali_jitter_limit = <0x1e>;
				cal_offset_margin = <0x78>;
				phandle = <0x75>;
			};

			light_2 {
				status = "okay";
				sensor_name = <0x05>;
				i2c_num = <0x00>;
				i2c_addr = <0x39>;
				direction = <0x04>;
				eint_num = <0x02>;
				als_ratio = <0x6e>;
				als_buffer_length = <0x0a>;
				als_type = <0x02>;
				device_name = "tcs3701";
				phandle = <0x76>;
			};

			rear_cct_1 {
				status = "okay";
				sensor_name = <0x00>;
				i2c_num = <0x01>;
				i2c_addr = <0x48>;
				direction = <0x00>;
				eint_num = <0x0a>;
				available_sensor = <0x07>;
				gold_rear_cct_3k = <0x2b4b 0x36ec 0x6a4 0x1e8 0x40 0xa498>;
				gold_rear_cct_6k = <0x2128 0x330c 0xf58 0x174 0x40 0xa7d4>;
				device_name = "stk37600";
				cct_coef_Lir = <0x207e9a8 0x00 0x116c730 0x00 0xdaa4a8 0x00 0xcfe2c0 0x01 0x285050 0x01 0xbc5ea8 0x01 0x1cc1928 0x00 0x1ae7f08 0x00 0x44a6380 0x00 0x1c6588 0x01 0x1817f8 0x01 0x1d2108 0x01>;
				cct_coef_Hir = <0xb72d98 0x01 0xdb2e46 0x01 0x1339108 0x01 0x169bed6 0x00 0x176babe 0x00 0xfa6a4a 0x00 0xfaf6e 0x00 0x798ea2 0x00 0x330b68e 0x00 0x193ca 0x01 0x7c9b6 0x01 0x9e106 0x01>;
				phandle = <0x77>;
			};

			rear_cct_2 {
				status = "okay";
				sensor_name = <0x02>;
				i2c_num = <0x01>;
				i2c_addr = <0x39>;
				direction = <0x00>;
				eint_num = <0x0a>;
				available_sensor = <0x07>;
				gold_rear_cct_3k = <0x113a 0x87f 0x43e 0x1bea 0xa51 0x113a>;
				gold_rear_cct_6k = <0xb5c 0x927 0x62d 0x196a 0x94e 0xb5c>;
				device_name = "tcs3408";
				phandle = <0x78>;
			};

			pick_up {
				status = "okay";
				use-proximity = <0x01>;
				phandle = <0x79>;
			};

			lux_aod {
				status = "okay";
				use-proximity = <0x01>;
				phandle = <0x7a>;
			};

			alsps_arch {
				status = "okay";
				new-arch-supported = <0x01>;
				phandle = <0x7b>;
			};

			cali_arch {
				status = "okay";
				new-arch-supported = <0x01>;
				phandle = <0x7c>;
			};

			oplus_boardid {
				compatible = "oplus,oplus_boardid";
				oplus_boardid,dtsino = "21081";
				oplus_boardid,pcbmask = "0xffff";
				phandle = <0x7d>;
			};

			oplus_project {
				compatible = "oplus,oplus_project";
				phandle = <0x7e>;
			};

			oplus_devinfo {
				compatible = "oplus-devinfo";
				pinctrl-names = "default\0aboard_gpio0_sleep\0aboard_gpio0_active\0aboard_gpio0_idle";
				pinctrl-0 = <0x0e>;
				pinctrl-1 = <0x0f>;
				pinctrl-2 = <0x10>;
				pinctrl-3 = <0x11>;
				phandle = <0x7f>;

				main-sub {
					use_tristate_gpio;
					compatible = "hw-match, main-sub";
					aboard-gpio0 = <0xffffffff 0x1e 0x00>;
					aboard-patterns = <0x01>;
					match-projects = <0x5259>;
				};
			};

			kpd_volume_down {
				compatible = "mediatek, VOLUME_DOWN-eint";
				interrupt-parent = <0xffffffff>;
				interrupts = <0x1d 0x02 0x1d 0x00>;
				debounce = <0x7d00>;
				status = "okay";
				phandle = <0x80>;
			};
		};
	};

	fragment@14 {
		target = <0xffffffff>;

		__overlay__ {
			keypad,volume-up = <0xffffffff 0x78 0x00>;
			keypad,volume-down = <0xffffffff 0x1d 0x00>;
			pinctrl-names = "volume_up_as_int\0volume_down_as_int";
			pinctrl-0 = <0x12>;
			pinctrl-1 = <0x13>;
			status = "okay";
		};
	};

	fragment@15 {
		target = <0xffffffff>;

		__overlay__ {

			volume_up@0 {
				phandle = <0x12>;

				pins_cmd_dat {
					pinmux = <0x7800>;
					slew-rate = <0x00>;
					input-enable;
				};
			};

			volume_down@0 {
				phandle = <0x13>;

				pins_cmd_dat {
					pinmux = <0x1d00>;
					slew-rate = <0x00>;
					input-enable;
				};
			};

			default@hw_sub_id {
				phandle = <0x0e>;
			};

			sleep@id0 {
				phandle = <0x0f>;

				pins_cmd_dat {
					pinmux = <0x1e00>;
					slew-rate = <0x00>;
					bias-pull-down;
					input-enable;
				};
			};

			active@id0 {
				phandle = <0x10>;

				pins_cmd_dat {
					pinmux = <0x1e00>;
					slew-rate = <0x00>;
					bias-pull-up;
					input-enable;
				};
			};

			idle@id0 {
				phandle = <0x11>;

				pins_cmd_dat {
					pinmux = <0x1e00>;
					slew-rate = <0x00>;
					bias-disable;
					input-enable;
				};
			};
		};
	};

	fragment@16 {
		target = <0xffffffff>;

		__overlay__ {

			gps_default {
				phandle = <0x14>;
			};

			gps_l1_lna@0 {
				phandle = <0x15>;

				pins_cmd_dat {
					pinmux = <0xbc00>;
					output-low;
				};
			};

			gps_l1_lna@1 {
				phandle = <0x16>;

				pins_cmd_dat {
					pinmux = <0xbc04>;
				};
			};

			gps_l1_lna@2 {
				phandle = <0x17>;

				pins_cmd_dat {
					pinmux = <0xbc00>;
					output-high;
				};
			};

			gps_l5_lna@0 {
				phandle = <0x18>;

				pins_cmd_dat {
					pinmux = <0xbd00>;
					output-low;
				};
			};

			gps_l5_lna@1 {
				phandle = <0x19>;

				pins_cmd_dat {
					pinmux = <0xbd04>;
				};
			};

			gps_l5_lna@2 {
				phandle = <0x1a>;

				pins_cmd_dat {
					pinmux = <0xbd00>;
					output-high;
				};
			};
		};
	};

	fragment@17 {
		target = <0xffffffff>;

		__overlay__ {
			pinctrl-names = "default\0gps_l1_lna_disable\0gps_l1_lna_dsp_ctrl\0gps_l1_lna_enable\0gps_l5_lna_disable\0gps_l5_lna_dsp_ctrl\0gps_l5_lna_enable";
			pinctrl-0 = <0x14>;
			pinctrl-1 = <0x15>;
			pinctrl-2 = <0x16>;
			pinctrl-3 = <0x17>;
			pinctrl-4 = <0x18>;
			pinctrl-5 = <0x19>;
			pinctrl-6 = <0x1a>;
			status = "okay";
		};
	};

	fragment@18 {
		target = <0xffffffff>;

		__overlay__ {
			accdet-mic-vol = <0x08>;
			headset-mode-setting = <0x500 0x500 0x01 0x1f0 0x800 0x800 0x20 0x44 0x04 0x01 0x05 0x03 0x03 0x05 0x0e>;
			accdet-plugout-debounce = <0x01>;
			accdet-mic-mode = <0x02>;
			headset-three-key-threshold = <0x00 0x52 0xaa 0x132>;
			headset-three-key-threshold-CDD = <0x00 0x79 0xc0 0x258>;
			headset-four-key-threshold = <0x00 0x3a 0x79 0xc0 0x190>;
			eint_use_ext_res = <0x00>;
			status = "okay";
		};
	};

	fragment@19 {
		target = <0xffffffff>;

		__overlay__ {
			pinctrl-names = "enable\0disable";
			pinctrl-0 = <0x1b>;
			pinctrl-1 = <0x1c>;
			status = "okay";
		};
	};

	fragment@20 {
		target = <0xffffffff>;

		__overlay__ {
			pinctrl-names = "sel_up\0sel_down";
			pinctrl-0 = <0x1d>;
			pinctrl-1 = <0x1e>;
			status = "okay";
		};
	};

	fragment@21 {
		target = <0xffffffff>;

		__overlay__ {

			ps_enable {
				phandle = <0x1b>;

				pins_cmd_dat {
					pinmux = <0x7900>;
					output-high;
				};
			};

			ps_disable {
				phandle = <0x1c>;

				pins_cmd_dat {
					pinmux = <0x7900>;
					output-low;
				};
			};

			sel_up {
				phandle = <0x1d>;

				pins_cmd_dat {
					pinmux = <0x600>;
					output-low;
				};
			};

			sel_down {
				phandle = <0x1e>;

				pins_cmd_dat {
					pinmux = <0x600>;
					output-high;
				};
			};
		};
	};

	fragment@22 {
		target = <0xffffffff>;

		__overlay__ {
			oplus,fp_gpio_num = <0x01>;
			oplus,fp_gpio = <0x23>;
			oplus,fp_gpio_0 = <0xffffffff 0x23 0x00>;
			pinctrl-names = "default";
			pinctrl-0 = <0x1f>;

			jiiov_0302 {
				oplus,fp-id = <0x00>;
				vendor-chip = <0x17>;
				eng-menu = "-1,-1";
				chip-name = "JIIOV_0302";
			};
		};
	};

	fragment@23 {
		target = <0xffffffff>;

		__overlay__ {

			gpio_id0_default {
				phandle = <0x1f>;

				pins_cmd_dat {
					pinmux = <0x2300>;
					slew-rate = <0x00>;
					bias-pull-up = <0x00>;
					input-enable;
				};
			};
		};
	};

	fragment@24 {
		target = <0xffffffff>;

		__overlay__ {
			#address-cells = <0x01>;
			#size-cells = <0x00>;
			status = "okay";

			fingerprint@0 {
				compatible = "oplus,oplus_fp";
				reg = <0x00>;
				spi-max-frequency = <0x2faf080>;
				spi-id = <0x05>;
				spi-irq = <0x16>;
				spi-reg = <0xa822f8>;
				dvdd-supply = <0xffffffff>;
				dvdd-config = <0x325aa0 0x325aa0 0x249f0>;
				power-num = <0x01>;
				status = "okay";
				phandle = <0x81>;

				power_source_1 {
					power-mode = <0x01>;
					power-name = "dvdd";
					power-config = "dvdd-config";
					delay-time = <0x00>;
				};
			};
		};
	};

	fragment@25 {
		target = <0xffffffff>;

		__overlay__ {
			anc,gpio_irq = <0xffffffff 0x16 0x00>;
			anc,gpio_rst = <0xffffffff 0x15 0x00>;
			ldo-supply = <0xffffffff>;
			pinctrl-names = "anc_reset_reset\0anc_reset_active\0anc_irq_active";
			pinctrl-0 = <0x20>;
			pinctrl-1 = <0x21 0x22 0x23 0x24 0x25>;
			pinctrl-2 = <0x25>;
			status = "okay";
		};
	};

	fragment@26 {
		target = <0xffffffff>;

		__overlay__ {

			jiiov_fp_reset_output_low {
				phandle = <0x20>;

				pins_cmd_dat {
					pinmux = <0x1500>;
					slew-rate = <0x01>;
					output-low;
				};
			};

			jiiov_fp_gpio_clk {
				phandle = <0x21>;

				pins_cmd_dat {
					pinmux = <0x6201>;
					drive-strength = <0x02>;
				};
			};

			jiiov_fp_gpio_mosi {
				phandle = <0x22>;

				pins_cmd_dat {
					pinmux = <0x6501>;
					drive-strength = <0x02>;
				};
			};

			jiiov_fp_gpio_miso {
				phandle = <0x23>;

				pins_cmd_dat {
					pinmux = <0x6401>;
					drive-strength = <0x03>;
				};
			};

			jiiov_fp_gpio_cs {
				phandle = <0x24>;

				pins_cmd_dat {
					pinmux = <0x6301>;
					drive-strength = <0x02>;
				};
			};

			jiiov_fp_irq_active {
				phandle = <0x25>;

				pins_cmd_dat {
					pinmux = <0x1600>;
					slew-rate = <0x00>;
					input-enable;
					bias-pull-down;
				};
			};
		};
	};

	fragment@27 {
		target = <0xffffffff>;

		__overlay__ {
			compatible = "mediatek, swtp-eint";
			debounce = <0x7d000>;
		};
	};

	fragment@28 {
		target = <0xffffffff>;

		__overlay__ {

			tfa98xx@34 {
				compatible = "nxp,tfa98xx";
				reg = <0x34>;
				reset-gpio = <0xffffffff 0x6b 0x00>;
				status = "okay";
				phandle = <0x82>;
			};

			gate_ic@11 {
				compatible = "mediatek,gate-ic-i2c";
				gate-power-gpios = <0xffffffff 0x6b 0x00>;
				reg = <0x11>;
				status = "disable";
				phandle = <0x83>;
			};
		};
	};

	fragment@29 {
		target = <0xffffffff>;

		__overlay__ {

			fsa_hs_det {
				phandle = <0x26>;

				pins_cmd_dat {
					pinmux = <0xa900>;
					slew-rate = <0x01>;
					output-high;
				};
			};
		};
	};

	fragment@30 {
		target = <0xffffffff>;

		__overlay__ {

			fsa4480@42 {
				compatible = "qcom,fsa4480-i2c";
				reg = <0x42>;
				pinctrl-names = "default";
				pinctrl-0 = <0x26>;
				fsa4480,hs-det-gpio = <0xffffffff 0xa9 0x00>;
				fsa4480,reset-gpio = <0xffffffff 0x6f 0x00>;
				phandle = <0x84>;
			};
		};
	};

	fragment@31 {
		target = <0xffffffff>;

		__overlay__ {

			adc_channel@ {
				compatible = "mediatek,adc_channel";
				mediatek,temperature0 = <0x00>;
				mediatek,temperature1 = <0x01>;
				mediatek,adc_fdd_rf_params_dynamic_custom_ch = <0x02>;
				status = "okay";
			};
		};
	};

	fragment@32 {
		target = <0xffffffff>;

		__overlay__ {
			io-channels = <0xffffffff 0x02>;
		};
	};

	fragment@33 {
		target = <0xffffffff>;

		__overlay__ {
			mediatek,clkbuf-quantity = <0x07>;
			mediatek,clkbuf-config = <0x02 0x01 0x01 0x02 0x00 0x00 0x01>;
			mediatek,clkbuf-output-impedance = <0x03 0x04 0x03 0x04 0x00 0x00 0x03>;
			mediatek,clkbuf-controls-for-desense = <0x00 0x04 0x00 0x04 0x00 0x00 0x00>;
			status = "okay";
		};
	};

	fragment@34 {
		target = <0xffffffff>;

		__overlay__ {
			#address-cells = <0x01>;
			#size-cells = <0x00>;
			clock-frequency = <0x61a80>;
			mediatek,use-open-drain;
		};
	};

	fragment@35 {
		target = <0xffffffff>;

		__overlay__ {
			#address-cells = <0x01>;
			#size-cells = <0x00>;
			clock-frequency = <0x61a80>;
			mediatek,use-open-drain;
		};
	};

	fragment@36 {
		target = <0xffffffff>;

		__overlay__ {
			#address-cells = <0x01>;
			#size-cells = <0x00>;
			clock-frequency = <0xf4240>;
			mediatek,use-open-drain;

			camera_main@1a {
				compatible = "mediatek,camera_main";
				reg = <0x1a>;
				status = "okay";
				phandle = <0x85>;
			};

			camera_main_af@0c {
				compatible = "mediatek,camera_main_af";
				reg = <0x0c>;
				status = "okay";
				phandle = <0x86>;
			};
		};
	};

	fragment@37 {
		target = <0xffffffff>;

		__overlay__ {
			#address-cells = <0x01>;
			#size-cells = <0x00>;
			clock-frequency = <0x61a80>;
			mediatek,use-open-drain;
		};
	};

	fragment@38 {
		target = <0xffffffff>;

		__overlay__ {
			#address-cells = <0x01>;
			#size-cells = <0x00>;
			clock-frequency = <0x61a80>;
			mediatek,use-open-drain;

			camera_sub@1a {
				compatible = "mediatek,camera_sub";
				reg = <0x1a>;
				status = "okay";
				phandle = <0x87>;
			};

			camera_sub_two@10 {
				compatible = "mediatek,camera_sub_two";
				reg = <0x10>;
				status = "okay";
				phandle = <0x88>;
			};
		};
	};

	fragment@39 {
		target = <0xffffffff>;

		__overlay__ {
			#address-cells = <0x01>;
			#size-cells = <0x00>;
			clock-frequency = <0x33e140>;
			mediatek,use-push-pull;

			subpmic@34 {
				compatible = "mediatek,subpmic";
				reg = <0x34>;
				status = "okay";
				phandle = <0x89>;
			};

			usb_type_c@4e {
				compatible = "mediatek,usb_type_c";
				reg = <0x4e>;
				status = "okay";
				phandle = <0x8a>;
			};

			subpmic_pmic@1a {
				compatible = "mediatek,subpmic_pmic";
				reg = <0x1a>;
				status = "okay";
				phandle = <0x8b>;
			};

			subpmic_ldo@64 {
				compatible = "mediatek,subpmic_ldo";
				reg = <0x64>;
				status = "okay";
				phandle = <0x8c>;
			};
		};
	};

	fragment@40 {
		target = <0xffffffff>;

		__overlay__ {
			#address-cells = <0x01>;
			#size-cells = <0x00>;
			clock-frequency = <0x61a80>;
			mediatek,use-open-drain;

			i2c_lcd_bias@11 {
				compatible = "mediatek,i2c_lcd_bias";
				reg = <0x11>;
				status = "okay";
				phandle = <0x8d>;
			};
		};
	};

	fragment@41 {
		target = <0xffffffff>;

		__overlay__ {
			#address-cells = <0x01>;
			#size-cells = <0x00>;
			clock-frequency = <0x186a0>;
			mediatek,use-open-drain;
		};
	};

	fragment@42 {
		target = <0xffffffff>;

		__overlay__ {
			#address-cells = <0x01>;
			#size-cells = <0x00>;
			clock-frequency = <0x61a80>;
			mediatek,use-open-drain;

			nfc@28 {
				compatible = "mediatek,nfc";
				reg = <0x28>;
				status = "okay";
				phandle = <0x8e>;
			};
		};
	};

	fragment@43 {
		target = <0xffffffff>;

		__overlay__ {
			#address-cells = <0x01>;
			#size-cells = <0x00>;
			clock-frequency = <0x61a80>;
			mediatek,use-open-drain;

			camera_main_two@11 {
				compatible = "mediatek,camera_main_two";
				reg = <0x11>;
				status = "okay";
				phandle = <0x8f>;
			};
		};
	};

	fragment@44 {
		target = <0xffffffff>;

		__overlay__ {
			#address-cells = <0x01>;
			#size-cells = <0x00>;
			clock-frequency = <0x61a80>;
			mediatek,use-open-drain;
		};
	};

	fragment@45 {
		target = <0xffffffff>;

		__overlay__ {
			#address-cells = <0x01>;
			#size-cells = <0x00>;
			clock-frequency = <0x61a80>;
			mediatek,use-open-drain;
		};
	};

	fragment@46 {
		target = <0xffffffff>;

		__overlay__ {
			GPIO_FDD_BAND_SUPPORT_DETECT_1ST_PIN = <0xffffffff 0x47 0x00>;
			GPIO_FDD_BAND_SUPPORT_DETECT_2ND_PIN = <0xffffffff 0x48 0x00>;
			GPIO_FDD_BAND_SUPPORT_DETECT_3RD_PIN = <0xffffffff 0x49 0x00>;
			GPIO_FDD_BAND_SUPPORT_DETECT_4TH_PIN = <0xffffffff 0x4a 0x00>;
			GPIO_RF_PWREN_RST_PIN = <0xffffffff 0x4b 0x00>;
			GPIO_SIM2_SIO = <0xffffffff 0xaa 0x00>;
			GPIO_SIM2_SCLK = <0xffffffff 0xab 0x00>;
			GPIO_SIM2_SRST = <0xffffffff 0xac 0x00>;
			GPIO_SIM1_SRST = <0xffffffff 0xad 0x00>;
			GPIO_SIM1_SCLK = <0xffffffff 0xae 0x00>;
			GPIO_SIM1_SIO = <0xffffffff 0xaf 0x00>;
			GPIO_SIM1_HOT_PLUG = <0xffffffff 0xb0 0x00>;
			GPIO_SIM2_HOT_PLUG = <0xffffffff 0xb1 0x00>;
		};
	};

	fragment@47 {
		target = <0xffffffff>;

		__overlay__ {
			gpio_init_default = <0x00 0x00 0x00 0x00 0x01 0x01 0x01 0x01 0x00 0x00 0x00 0x01 0x00 0x01 0x02 0x00 0x00 0x00 0x01 0x01 0x01 0x03 0x00 0x00 0x00 0x01 0x00 0x01 0x04 0x00 0x00 0x00 0x01 0x01 0x01 0x05 0x00 0x00 0x00 0x01 0x01 0x01 0x06 0x00 0x00 0x00 0x00 0x00 0x00 0x07 0x00 0x01 0x00 0x01 0x00 0x00 0x08 0x00 0x00 0x00 0x01 0x01 0x00 0x09 0x00 0x00 0x00 0x01 0x00 0x00 0x0a 0x00 0x00 0x00 0x00 0x00 0x00 0x0b 0x00 0x00 0x00 0x00 0x00 0x01 0x0c 0x00 0x00 0x00 0x01 0x00 0x00 0x0d 0x02 0x00 0x00 0x01 0x01 0x00 0x0e 0x00 0x00 0x00 0x01 0x01 0x01 0x0f 0x00 0x01 0x00 0x01 0x00 0x01 0x10 0x07 0x00 0x00 0x01 0x01 0x00 0x11 0x07 0x00 0x00 0x01 0x01 0x00 0x12 0x07 0x00 0x00 0x01 0x01 0x00 0x13 0x00 0x00 0x00 0x01 0x01 0x00 0x14 0x07 0x00 0x00 0x00 0x00 0x00 0x15 0x00 0x01 0x00 0x00 0x00 0x00 0x16 0x00 0x00 0x00 0x01 0x00 0x00 0x17 0x07 0x00 0x00 0x01 0x01 0x00 0x18 0x00 0x01 0x00 0x01 0x00 0x00 0x19 0x00 0x01 0x00 0x01 0x00 0x00 0x1a 0x01 0x00 0x00 0x01 0x01 0x00 0x1b 0x01 0x00 0x00 0x00 0x00 0x00 0x1c 0x01 0x00 0x00 0x01 0x01 0x00 0x1d 0x00 0x00 0x00 0x00 0x00 0x00 0x1e 0x00 0x00 0x00 0x00 0x00 0x00 0x1f 0x00 0x00 0x00 0x00 0x00 0x00 0x20 0x00 0x01 0x01 0x00 0x00 0x01 0x21 0x00 0x00 0x00 0x01 0x00 0x00 0x22 0x00 0x00 0x00 0x01 0x00 0x00 0x23 0x01 0x00 0x00 0x01 0x01 0x00 0x24 0x01 0x00 0x00 0x01 0x01 0x01 0x25 0x01 0x00 0x00 0x01 0x01 0x01 0x26 0x01 0x00 0x00 0x01 0x01 0x01 0x27 0x01 0x00 0x00 0x01 0x00 0x01 0x28 0x00 0x01 0x00 0x00 0x00 0x01 0x29 0x01 0x00 0x00 0x00 0x00 0x01 0x2a 0x01 0x00 0x00 0x00 0x00 0x01 0x2b 0x01 0x00 0x00 0x01 0x00 0x01 0x2c 0x01 0x00 0x00 0x01 0x00 0x01 0x2d 0x01 0x00 0x00 0x01 0x01 0x01 0x2e 0x01 0x00 0x00 0x00 0x00 0x00 0x2f 0x01 0x00 0x00 0x00 0x00 0x00 0x30 0x01 0x00 0x00 0x00 0x00 0x00 0x31 0x01 0x00 0x00 0x00 0x00 0x00 0x32 0x01 0x00 0x00 0x01 0x00 0x00 0x33 0x01 0x00 0x00 0x01 0x00 0x00 0x34 0x01 0x00 0x00 0x01 0x00 0x00 0x35 0x01 0x00 0x00 0x01 0x00 0x00 0x36 0x01 0x00 0x00 0x01 0x00 0x01 0x37 0x01 0x00 0x00 0x01 0x00 0x00 0x38 0x01 0x00 0x00 0x01 0x00 0x00 0x39 0x01 0x00 0x00 0x01 0x00 0x00 0x3a 0x01 0x00 0x00 0x01 0x00 0x00 0x3b 0x01 0x00 0x00 0x01 0x00 0x00 0x3c 0x01 0x00 0x00 0x00 0x00 0x01 0x3d 0x01 0x00 0x00 0x00 0x00 0x01 0x3e 0x01 0x00 0x00 0x00 0x00 0x01 0x3f 0x01 0x00 0x00 0x00 0x00 0x01 0x40 0x01 0x00 0x00 0x01 0x01 0x01 0x41 0x01 0x00 0x00 0x01 0x01 0x01 0x42 0x01 0x00 0x00 0x01 0x00 0x01 0x43 0x01 0x00 0x00 0x01 0x00 0x01 0x44 0x01 0x00 0x00 0x00 0x00 0x00 0x45 0x01 0x00 0x00 0x01 0x00 0x00 0x46 0x01 0x00 0x00 0x01 0x00 0x01 0x47 0x00 0x00 0x00 0x01 0x00 0x01 0x48 0x00 0x00 0x00 0x01 0x00 0x01 0x49 0x00 0x00 0x00 0x01 0x00 0x01 0x4a 0x00 0x00 0x00 0x01 0x00 0x01 0x4b 0x00 0x01 0x01 0x01 0x00 0x01 0x4c 0x01 0x00 0x00 0x00 0x00 0x01 0x4d 0x01 0x00 0x00 0x00 0x00 0x01 0x4e 0x01 0x00 0x00 0x00 0x00 0x01 0x4f 0x01 0x00 0x00 0x00 0x00 0x01 0x50 0x01 0x00 0x00 0x00 0x00 0x01 0x51 0x01 0x00 0x00 0x00 0x00 0x01 0x52 0x01 0x00 0x00 0x00 0x00 0x00 0x53 0x01 0x00 0x00 0x01 0x00 0x00 0x54 0x01 0x00 0x00 0x00 0x00 0x00 0x55 0x01 0x00 0x00 0x01 0x00 0x00 0x56 0x01 0x00 0x00 0x01 0x00 0x01 0x57 0x01 0x00 0x00 0x00 0x00 0x01 0x58 0x01 0x00 0x00 0x00 0x00 0x01 0x59 0x01 0x00 0x00 0x00 0x00 0x01 0x5a 0x01 0x00 0x00 0x00 0x00 0x01 0x5b 0x01 0x00 0x00 0x00 0x00 0x01 0x5c 0x01 0x00 0x00 0x00 0x00 0x01 0x5d 0x01 0x00 0x00 0x00 0x00 0x01 0x5e 0x01 0x00 0x00 0x00 0x00 0x01 0x5f 0x01 0x00 0x00 0x00 0x00 0x01 0x60 0x01 0x00 0x00 0x00 0x00 0x01 0x61 0x01 0x00 0x00 0x00 0x00 0x01 0x62 0x01 0x01 0x00 0x00 0x00 0x00 0x63 0x00 0x01 0x00 0x00 0x00 0x00 0x64 0x01 0x00 0x00 0x01 0x00 0x00 0x65 0x01 0x01 0x00 0x00 0x00 0x00 0x66 0x01 0x00 0x00 0x01 0x01 0x00 0x67 0x01 0x00 0x00 0x01 0x01 0x00 0x68 0x01 0x00 0x00 0x01 0x01 0x00 0x69 0x01 0x00 0x00 0x01 0x01 0x00 0x6a 0x01 0x00 0x00 0x01 0x01 0x00 0x6b 0x00 0x01 0x00 0x01 0x00 0x01 0x6c 0x00 0x00 0x00 0x01 0x00 0x01 0x6d 0x00 0x01 0x01 0x01 0x00 0x00 0x6e 0x00 0x01 0x01 0x01 0x00 0x00 0x6f 0x00 0x01 0x00 0x01 0x00 0x00 0x70 0x01 0x00 0x00 0x01 0x01 0x00 0x71 0x00 0x00 0x00 0x01 0x01 0x00 0x72 0x01 0x00 0x00 0x01 0x01 0x00 0x73 0x02 0x00 0x00 0x01 0x00 0x00 0x74 0x01 0x00 0x00 0x01 0x01 0x01 0x75 0x00 0x00 0x00 0x01 0x00 0x00 0x76 0x00 0x00 0x00 0x01 0x00 0x00 0x77 0x00 0x00 0x00 0x01 0x00 0x00 0x78 0x00 0x00 0x00 0x01 0x00 0x00 0x79 0x00 0x00 0x00 0x01 0x00 0x00 0x7a 0x07 0x00 0x00 0x01 0x01 0x01 0x7b 0x07 0x00 0x00 0x01 0x01 0x00 0x7c 0x07 0x00 0x00 0x01 0x01 0x00 0x7d 0x07 0x00 0x00 0x01 0x01 0x00 0x7e 0x02 0x00 0x00 0x01 0x00 0x00 0x7f 0x02 0x00 0x00 0x01 0x00 0x00 0x80 0x02 0x00 0x00 0x01 0x01 0x01 0x81 0x02 0x00 0x00 0x01 0x00 0x01 0x82 0x02 0x00 0x00 0x01 0x01 0x01 0x83 0x02 0x00 0x00 0x01 0x01 0x01 0x84 0x01 0x00 0x00 0x01 0x01 0x01 0x85 0x01 0x00 0x00 0x01 0x01 0x01 0x86 0x01 0x00 0x00 0x01 0x01 0x01 0x87 0x01 0x00 0x00 0x01 0x01 0x01 0x88 0x01 0x00 0x00 0x01 0x01 0x01 0x89 0x01 0x00 0x00 0x01 0x01 0x01 0x8a 0x04 0x00 0x00 0x01 0x01 0x00 0x8b 0x04 0x00 0x00 0x01 0x01 0x00 0x8c 0x00 0x01 0x00 0x01 0x00 0x01 0x8d 0x00 0x01 0x00 0x01 0x00 0x01 0x8e 0x00 0x01 0x00 0x01 0x00 0x00 0x8f 0x01 0x00 0x00 0x01 0x01 0x01 0x90 0x01 0x00 0x00 0x01 0x01 0x01 0x91 0x01 0x00 0x00 0x01 0x01 0x01 0x92 0x01 0x00 0x00 0x01 0x01 0x01 0x93 0x01 0x00 0x00 0x01 0x01 0x01 0x94 0x01 0x00 0x00 0x01 0x01 0x01 0x95 0x01 0x00 0x00 0x00 0x00 0x00 0x96 0x01 0x00 0x00 0x00 0x00 0x00 0x97 0x01 0x00 0x00 0x00 0x00 0x00 0x98 0x00 0x01 0x00 0x01 0x00 0x00 0x99 0x01 0x00 0x00 0x00 0x00 0x00 0x9a 0x00 0x01 0x00 0x01 0x00 0x00 0x9b 0x00 0x01 0x00 0x01 0x00 0x00 0x9c 0x00 0x00 0x00 0x01 0x01 0x00 0x9d 0x00 0x01 0x00 0x01 0x00 0x00 0x9e 0x00 0x00 0x00 0x01 0x01 0x00 0x9f 0x00 0x01 0x00 0x01 0x00 0x00 0xa0 0x00 0x00 0x00 0x01 0x01 0x00 0xa1 0x00 0x01 0x00 0x01 0x00 0x00 0xa2 0x00 0x00 0x00 0x01 0x01 0x00 0xa3 0x00 0x00 0x00 0x01 0x01 0x00 0xa4 0x01 0x00 0x00 0x01 0x01 0x00 0xa5 0x01 0x00 0x00 0x00 0x00 0x00 0xa6 0x01 0x00 0x00 0x01 0x01 0x00 0xa7 0x00 0x01 0x00 0x01 0x00 0x00 0xa8 0x01 0x00 0x00 0x01 0x01 0x00 0xa9 0x01 0x00 0x00 0x01 0x01 0x00 0xaa 0x01 0x00 0x00 0x01 0x01 0x01 0xab 0x01 0x00 0x00 0x00 0x00 0x01 0xac 0x01 0x00 0x00 0x00 0x00 0x01 0xad 0x01 0x00 0x00 0x00 0x00 0x01 0xae 0x01 0x00 0x00 0x00 0x00 0x01 0xaf 0x01 0x00 0x00 0x01 0x01 0x01 0xb0 0x01 0x00 0x00 0x01 0x01 0x01 0xb1 0x01 0x00 0x00 0x01 0x01 0x01 0xb2 0x01 0x00 0x00 0x01 0x00 0x00 0xb3 0x01 0x00 0x00 0x01 0x00 0x00 0xb4 0x00 0x00 0x00 0x01 0x00 0x01 0xb5 0x00 0x00 0x00 0x01 0x00 0x01 0xb6 0x01 0x00 0x00 0x00 0x00 0x00 0xb7 0x01 0x00 0x00 0x00 0x00 0x00 0xb8 0x01 0x00 0x00 0x01 0x01 0x00 0xb9 0x01 0x00 0x00 0x01 0x00 0x00 0xba 0x03 0x00 0x00 0x01 0x01 0x01 0xbb 0x03 0x00 0x00 0x01 0x01 0x01 0xbc 0x00 0x01 0x00 0x01 0x01 0x00 0xbd 0x00 0x01 0x00 0x01 0x01 0x00 0xbe 0x01 0x00 0x00 0x01 0x01 0x00 0xbf 0x00 0x00 0x00 0x01 0x00 0x00 0xc0 0x00 0x00 0x00 0x01 0x00 0x00 0xc1 0x00 0x00 0x00 0x01 0x01 0x00 0xc2 0x00 0x00 0x00 0x01 0x01 0x00 0xc3 0x00 0x00 0x00 0x01 0x01 0x00 0xc4 0x00 0x00 0x00 0x01 0x00 0x00 0xc5 0x00 0x00 0x00 0x01 0x00 0x00 0xc6 0x00 0x00 0x00 0x01 0x00 0x00 0xc7 0x00 0x00 0x00 0x01 0x00 0x00 0xc8 0x00 0x00 0x00 0x01 0x00 0x00 0xc9 0x00 0x00 0x00 0x01 0x00 0x00 0xca 0x00 0x00 0x00 0x01 0x00 0x00 0xcb 0x00 0x00 0x00 0x01 0x00 0x00 0xcc 0x00 0x00 0x00 0x01 0x00 0x00 0xcd 0x00 0x00 0x00 0x01 0x00 0x00 0xce 0x00 0x00 0x00 0x01 0x00 0x00 0xcf 0x00 0x00 0x00 0x01 0x00 0x00 0xd0 0x00 0x00 0x00 0x01 0x00 0x00>;
		};
	};

	fragment@48 {
		target = <0xffffffff>;

		__overlay__ {
			interrupt-parent = <0xffffffff>;
			interrupts = <0x00 0x08>;
			status = "okay";
		};
	};

	fragment@49 {
		target = <0xffffffff>;

		__overlay__ {
			interrupt-parent = <0xffffffff>;
			interrupts = <0x04 0x02>;
			status = "okay";
		};
	};

	fragment@50 {
		target = <0xffffffff>;

		__overlay__ {
			interrupt-parent = <0xffffffff>;
			interrupts = <0x08 0x04>;
			status = "okay";
		};
	};

	fragment@51 {
		target = <0xffffffff>;

		__overlay__ {
			interrupt-parent = <0xffffffff>;
			interrupts = <0x0e 0x08>;
			status = "okay";
		};
	};

	fragment@52 {
		target = <0xffffffff>;

		__overlay__ {
			interrupt-parent = <0xffffffff>;
			interrupts = <0x13 0x04>;
			deb-gpios = <0xffffffff 0x13 0x00>;
			debounce = <0x7d000>;
			status = "okay";
		};
	};

	fragment@53 {
		target = <0xffffffff>;

		__overlay__ {
			interrupt-parent = <0xffffffff>;
			interrupts = <0x25 0x01>;
			status = "okay";
		};
	};

	fragment@54 {
		target = <0xffffffff>;

		__overlay__ {
			interrupt-parent = <0xffffffff>;
			interrupts = <0xa2 0x08>;
			status = "okay";
		};
	};

	fragment@55 {
		target = <0xffffffff>;

		__overlay__ {
			compatible = "mediatek,md1_sim1_hot_plug_eint-eint";
			interrupts = <0x00 0x08>;
			debounce = <0x00 0x2710>;
			dedicated = <0x00 0x00>;
			src_pin = <0x00 0x01>;
			sockettype = <0x00 0x00>;
			status = "okay";
		};
	};

	fragment@56 {
		target = <0xffffffff>;

		__overlay__ {
			compatible = "mediatek,md1_sim2_hot_plug_eint-eint";
			interrupts = <0x01 0x08>;
			debounce = <0x01 0x2710>;
			dedicated = <0x01 0x00>;
			src_pin = <0x01 0x02>;
			sockettype = <0x01 0x00>;
			status = "okay";
		};
	};

	fragment@57 {
		target = <0xffffffff>;

		__overlay__ {
			regulator-name = "vcamio";
			regulator-default-on = <0x01>;
			status = "okay";
		};
	};

	fragment@58 {
		target = <0xffffffff>;

		__overlay__ {
			regulator-name = "vtp";
			regulator-default-on = <0x01>;
			status = "okay";
		};
	};

	fragment@59 {
		target = <0xffffffff>;

		__overlay__ {
			vcamio-supply = <0xffffffff>;
			status = "okay";
		};
	};

	fragment@60 {
		target = <0xffffffff>;

		__overlay__ {
			vtouch-supply = <0xffffffff>;
			status = "okay";
		};
	};

	fragment@61 {
		target = <0xffffffff>;

		__overlay__ {
			mediatek,kpd-key-debounce = <0x400>;
			mediatek,kpd-sw-pwrkey = <0x74>;
			mediatek,kpd-hw-pwrkey = <0x08>;
			mediatek,kpd-sw-rstkey = <0x73>;
			mediatek,kpd-hw-rstkey = <0x11>;
			mediatek,kpd-use-extend-type = <0x00>;
			mediatek,kpd-hw-map-num = <0x48>;
			mediatek,kpd-hw-init-map = <0x00 0x72 0x00 0x00 0x00 0x00 0x00 0x00 0x00 0x00 0x00 0x00 0x00 0x00 0x00 0x00 0x00 0x00 0x00 0x00 0x00 0x00 0x00 0x00 0x00 0x00 0x00 0x00 0x00 0x00 0x00 0x00 0x00 0x00 0x00 0x00 0x00 0x00 0x00 0x00 0x00 0x00 0x00 0x00 0x00 0x00 0x00 0x00 0x00 0x00 0x00 0x00 0x00 0x00 0x00 0x00 0x00 0x00 0x00 0x00 0x00 0x00 0x00 0x00 0x00 0x00 0x00 0x00 0x00 0x00 0x00 0x00>;
			mediatek,kpd-pwrkey-eint-gpio = <0x00>;
			mediatek,kpd-pwkey-gpio-din = <0x00>;
			mediatek,kpd-hw-dl-key0 = <0x11>;
			mediatek,kpd-hw-dl-key2 = <0x08>;
			mediatek,kpd-hw-recovery-key = <0x11>;
			status = "okay";
		};
	};

	fragment@62 {
		target = <0xffffffff>;

		__overlay__ {
			mt6360,intr_gpio_num = <0x04>;
			mt6360,intr_gpio = <0xffffffff 0x04 0x00>;
			disable_lpsd = <0x01>;

			chg {
				support_hvdcp;
			};
		};
	};

	fragment@63 {
		target = <0xffffffff>;

		__overlay__ {
			mt6360pd,intr_gpio_num = <0x05>;
			mt6360pd,intr_gpio = <0xffffffff 0x05 0x00>;
			mt-tcpc,role_def = <0x01>;
			mt-tcpc,vconn_supply = <0x01>;

			pd-data {
				pd,source-pdo-size = <0x01>;
				pd,source-pdo-data = <0x19096>;
				pd,sink-pdo-size = <0x02>;
				pd,sink-pdo-data = <0x190c8 0x1912c>;
				pd,id-vdo-size = <0x03>;
				pd,id-vdo-data = <0xd10029cf 0x00 0x63600000>;
				bat,nr = <0x01>;

				bat-info0 {
					bat,vid = <0x29cf>;
					bat,pid = <0x6360>;
					bat,mfrs = "bat1";
					bat,design_cap = <0x11>;
				};
			};

			dpm_caps {
				attemp_discover_svid;
			};
		};
	};

	fragment@64 {
		target = <0xffffffff>;

		__overlay__ {
			support_tuv_authentication;
			max_charger_voltage = <0x989680>;
		};
	};

	fragment@65 {
		target = <0xffffffff>;

		__overlay__ {
			io-channels = <0xffffffff 0x04 0xffffffff 0x05 0xffffffff 0x06 0xffffffff 0x07 0xffffffff 0x08>;
			io-channel-names = "auxadc4-usb_temp_v_l\0auxadc5-usb_temp_v_r\0auxadc3-chargeric_temp\0batcon_temp\0usbcon_temp";
			pinctrl-names = "default\0charger_gpio_as_output_low\0charger_gpio_as_output_high\0dischg_enable\0dischg_disable\0ccdetect_active\0ccdetect_sleep";
			pinctrl-0 = <0x27>;
			pinctrl-1 = <0x28>;
			pinctrl-2 = <0x29>;
			pinctrl-3 = <0x2a>;
			pinctrl-4 = <0x2b>;
			pinctrl-5 = <0x2c>;
			pinctrl-6 = <0x2d>;
			qcom,input_current_charger_ma = <0x7d0>;
			qcom,pd_input_current_charger_ma = <0x7d0>;
			qcom,qc_input_current_charger_ma = <0x7d0>;
			qcom,input_current_usb_ma = <0x1f4>;
			qcom,input_current_cdp_ma = <0x5dc>;
			qcom,input_current_camera_ma = <0x4b0>;
			qcom,input_current_calling_ma = <0x5dc>;
			qcom,led_warm_bat_decidegc = <0x15e>;
			qcom,led_high_bat_decidegc = <0x172>;
			qcom,input_current_led_ma = <0x4b0>;
			qcom,input_current_led_ma_high = <0x4b0>;
			qcom,input_current_led_ma_warm = <0x5dc>;
			qcom,input_current_led_ma_normal = <0x7d0>;
			qcom,vooc_temp_bat_normal_decidegc = <0x15e>;
			qcom,vooc_temp_bat_warm_decidegc = <0x172>;
			qcom,vooc_temp_bat_hot_decidegc = <0x1b8>;
			qcom,input_current_vooc_led_ma_high = <0x4b0>;
			qcom,input_current_vooc_led_ma_warm = <0x708>;
			qcom,input_current_vooc_led_ma_normal = <0xe10>;
			qcom,input_current_vooc_ma_normal = <0xe10>;
			qcom,input_current_vooc_ma_warm = <0xc80>;
			qcom,input_current_vooc_ma_high = <0x898>;
			qcom,charger_current_vooc_ma_normal = <0x708>;
			qcom,iterm_disabled = <0x00>;
			qcom,iterm_ma = <0xe5>;
			qcom,recharge-mv = <0x64>;
			qcom,batt_capacity_mah = <0x1194>;
			qcom,removed_bat_decidegc = <0xbe>;
			qcom,cold_bat_decidegc = <0x14>;
			qcom,temp_cold_vfloat_mv = <0xf8c>;
			qcom,temp_cold_fastchg_current_ma = <0x12c>;
			qcom,little_cold_bat_decidegc = <0x00>;
			qcom,temp_little_cold_vfloat_mv = <0x1153>;
			qcom,temp_little_cold_fastchg_current_ma_high = <0x898>;
			qcom,temp_little_cold_fastchg_current_ma_low = <0x898>;
			qcom,temp_little_cold_fastchg_current_ma = <0x802>;
			qcom,pd_temp_little_cold_fastchg_current_ma_high = <0xb54>;
			qcom,pd_temp_little_cold_fastchg_current_ma_low = <0x802>;
			qcom,qc_temp_little_cold_fastchg_current_ma_high = <0xb54>;
			qcom,qc_temp_little_cold_fastchg_current_ma_low = <0x802>;
			qcom,cool_bat_decidegc = <0x32>;
			qcom,temp_cool_vfloat_mv = <0x1153>;
			qcom,temp_cool_fastchg_current_ma_high = <0x898>;
			qcom,temp_cool_fastchg_current_ma_low = <0x898>;
			qcom,pd_temp_cool_fastchg_current_ma_high = <0xce4>;
			qcom,pd_temp_cool_fastchg_current_ma_low = <0xb54>;
			qcom,qc_temp_cool_fastchg_current_ma_high = <0xce4>;
			qcom,qc_temp_cool_fastchg_current_ma_low = <0xb54>;
			qcom,little_cool_bat_decidegc = <0x78>;
			qcom,temp_little_cool_vfloat_mv = <0x1153>;
			qcom,temp_little_cool_fastchg_current_ma = <0x898>;
			qcom,pd_temp_little_cool_fastchg_current_ma = <0xce4>;
			qcom,qc_temp_little_cool_fastchg_current_ma = <0xce4>;
			qcom,normal_bat_decidegc = <0xa0>;
			qcom,temp_normal_vfloat_mv = <0x1153>;
			qcom,temp_normal_fastchg_current_ma = <0x898>;
			qcom,pd_temp_normal_fastchg_current_ma = <0xce4>;
			qcom,qc_temp_normal_fastchg_current_ma = <0xce4>;
			qcom,warm_bat_decidegc = <0x1c2>;
			qcom,temp_warm_vfloat_mv = <0x1022>;
			qcom,temp_warm_fastchg_current_ma = <0x4b0>;
			qcom,pd_temp_warm_fastchg_current_ma = <0x4b0>;
			qcom,qc_temp_warm_fastchg_current_ma = <0x4b0>;
			qcom,temp_warm_fastchg_current_ma_led_on = <0x1f4>;
			qcom,hot_bat_decidegc = <0x212>;
			qcom,non_standard_vfloat_mv = <0xf8c>;
			qcom,non_standard_fastchg_current_ma = <0x200>;
			qcom,short_c_bat_cv_mv = <0x10ea>;
			qcom,short_c_bat_vfloat_mv = <0xed8>;
			qcom,short_c_bat_fastchg_current_ma = <0x200>;
			qcom,cold_vfloat_sw_limit = <0xf5a>;
			qcom,little_cold_vfloat_sw_limit = <0x1121>;
			qcom,cool_vfloat_sw_limit = <0x1121>;
			qcom,little_cool_vfloat_sw_limit = <0x1121>;
			qcom,normal_vfloat_sw_limit = <0x1121>;
			qcom,warm_vfloat_sw_limit = <0xff0>;
			qcom,non_standard_vfloat_sw_limit = <0xf5a>;
			qcom,short_c_bat_vfloat_sw_limit = <0xea6>;
			qcom,max_chg_time_sec = <0xfd20>;
			qcom,charger_hv_thr = <0x2710>;
			qcom,charger_recv_thr = <0x2648>;
			qcom,charger_lv_thr = <0xd48>;
			qcom,vbatt_full_thr = <0x1153>;
			qcom,vbatt_hv_thr = <0x11f8>;
			qcom,vfloat_step_mv = <0x08>;
			qcom,cold_vfloat_over_sw_limit = <0xf96>;
			qcom,little_cold_vfloat_over_sw_limit = <0x115d>;
			qcom,cool_vfloat_over_sw_limit = <0x115d>;
			qcom,little_cool_vfloat_over_sw_limit = <0x115d>;
			qcom,normal_vfloat_over_sw_limit = <0x115d>;
			qcom,warm_vfloat_over_sw_limit = <0x102c>;
			qcom,non_standard_vfloat_over_sw_limit = <0xf96>;
			qcom,vbatt_power_off = <0xce4>;
			qcom,vbatt_soc_1 = <0xcee>;
			qcom,vooc_project = <0x05>;
			qcom,vbatt_num = <0x01>;
			qcom,new_ui_warning_support;
			qcom,voocphy_support = <0x02>;
			qcom,chargerid_support;
			qcom,ffc_support;
			qcom,dual_ffc;
			qcom,smart_charging_screenoff;
			qcom,vooc_show_ui_soc_decimal;
			qcom,ui_soc_decimal_speedmin = <0x14>;
			qcom,check_batt_full_by_sw;
			qcom,chg_ctrl_by_lcd;
			qcom,chg_ctrl_by_camera;
			qcom,chg_ctrl_by_calling;
			qcom,support_ntc_01c_precision;
			qcom,sw_vfloat_over_protect_enable;
			qcom,normal_vterm_hw_inc = <0x12>;
			qcom,non_normal_vterm_hw_inc = <0x12>;
			qcom,usbtemp_batttemp_gap = <0x0c>;
			qcom,ff1_normal_fastchg_ma = <0x640>;
			qcom,ff1_warm_fastchg_ma = <0x640>;
			qcom,ffc2_normal_fastchg_ma = <0x514>;
			qcom,ffc2_temp_warm_decidegc = <0x15e>;
			qcom,ffc2_warm_fastchg_ma = <0x578>;
			qcom,ffc2_temp_high_decidegc = <0x190>;
			qcom,ffc2_temp_low_decidegc = <0x78>;
			qcom,ff1_exit_step_ma = <0x1c2>;
			qcom,ff1_warm_exit_step_ma = <0x15e>;
			qcom,ffc2_exit_step_ma = <0x96>;
			qcom,ffc2_warm_exit_step_ma = <0x96>;
			qcom,ffc_normal_vfloat_sw_limit = <0x117b>;
			qcom,ffc_temp_normal_vfloat_mv = <0x11c6>;
			qcom,ffc_normal_vfloat_over_sw_limit = <0x11c6>;
			qcom,ffc_warm_vfloat_sw_limit = <0x117b>;
			qcom,ffc2_normal_vfloat_sw_limit = <0x117b>;
			qcom,ffc2_temp_normal_vfloat_mv = <0x11c6>;
			qcom,ffc2_normal_vfloat_over_sw_limit = <0x11c6>;
			qcom,ffc2_warm_vfloat_sw_limit = <0x117b>;
			qcom,default_iterm_ma = <0xe5>;
			qcom,default_temp_normal_fastchg_current_ma = <0x898>;
			qcom,default_normal_vfloat_sw_limit = <0x1121>;
			qcom,default_temp_normal_vfloat_mv = <0x1153>;
			qcom,default_normal_vfloat_over_sw_limit = <0x115d>;
			qcom,default_temp_little_cool_fastchg_current_ma = <0x898>;
			qcom,default_little_cool_vfloat_sw_limit = <0x1121>;
			qcom,default_temp_little_cool_vfloat_mv = <0x1153>;
			qcom,default_little_cool_vfloat_over_sw_limit = <0x115d>;
			qcom,vbatt_pdqc_to_5v_thr = <0x1194>;
			qcom,vbatt_pdqc_to_9v_thr = <0x1194>;
			qcom,chargerid_switch-gpio = <0xffffffff 0x19 0x00>;
			qcom,dischg-gpio = <0xffffffff 0xa7 0x00>;
			qcom,ccdetect-gpio = <0xffffffff 0x06 0x00>;
			qcom,vooc-max-input-volt-support = <0x2710>;
			qcom,vooc-max-input-current-support = <0xbb8>;
			qcom,disable-ship-mode;
		};
	};

	fragment@66 {
		target = <0xffffffff>;

		__overlay__ {

			eint0default {
				phandle = <0x27>;
			};

			charger_gpio_as_output_low {
				phandle = <0x28>;

				pins_cmd_dat {
					pinmux = <0x1900>;
					slew-rate = <0x01>;
					output-low;
				};
			};

			charger_gpio_as_output_high {
				phandle = <0x29>;

				pins_cmd_dat {
					pinmux = <0x1900>;
					slew-rate = <0x01>;
					output-high;
				};
			};

			dischg_enable {
				phandle = <0x2a>;

				pins_cmd_dat {
					pinmux = <0xa700>;
					slew-rate = <0x01>;
					output-high;
				};
			};

			dischg_disable {
				phandle = <0x2b>;

				pins_cmd_dat {
					pinmux = <0xa700>;
					slew-rate = <0x01>;
					output-low;
				};
			};

			ccdetect_active {
				phandle = <0x2c>;

				pins_cmd_dat {
					pinmux = <0x600>;
					input-enable;
					slew-rate = <0x00>;
					bias-disable;
				};
			};

			ccdetect_sleep {
				phandle = <0x2d>;

				pins_cmd_dat {
					pinmux = <0x600>;
					input-enable;
					slew-rate = <0x00>;
					bias-disable;
				};
			};
		};
	};

	fragment@67 {
		target = <0xffffffff>;

		__overlay__ {
			FUELGAGUE_APPLY = <0x01>;
			ENABLE_IS_FORCE_FULL = <0x01>;
			USE_MT6360 = <0x01>;
			RBAT_TYPE = <0x0a>;
			RBAT_PULL_UP_R = <0x2ee0>;
			FG_METER_RESISTANCE = <0x00>;
			COM_FG_METER_RESISTANCE = <0x00>;
			NO_BAT_TEMP_COMPENSATE = <0x00>;
			R_FG_VALUE = <0x05>;
			COM_R_FG_VALUE = <0x05>;
			EMBEDDED_SEL = <0x01>;
			DIFFERENCE_FULLOCV_ITH = <0x12c>;
			SHUTDOWN_1_TIME = <0x3c>;
			KEEP_100_PERCENT = <0x02>;
			g_FG_PSEUDO100_T0 = <0x62>;
			g_FG_PSEUDO100_T1 = <0x61>;
			g_FG_PSEUDO100_T2 = <0x60>;
			g_FG_PSEUDO100_T3 = <0x5e>;
			g_FG_PSEUDO100_T4 = <0x5e>;
			battery0_profile_t0_num = <0x64>;
			battery0_profile_t0_col = <0x06>;
			battery0_profile_t0 = <0x00 0xabf0 0x2f8 0x2ca 0x2ca 0x2ca 0x1c3 0xab66 0x29d 0x275 0x275 0x275 0x386 0xaaea 0x2a7 0x27e 0x27e 0x27e 0x549 0xaa72 0x29b 0x273 0x273 0x273 0x70c 0xa9fe 0x2a2 0x27a 0x27a 0x27a 0x8d0 0xa98a 0x2a0 0x278 0x278 0x278 0xa93 0xa91d 0x2a7 0x27e 0x27e 0x27e 0xc56 0xa8a9 0x2ab 0x282 0x282 0x282 0xe19 0xa82b 0x29c 0x274 0x274 0x274 0xfdc 0xa7b9 0x2ab 0x282 0x282 0x282 0x119f 0xa73b 0x2aa 0x282 0x282 0x282 0x1362 0xa6c2 0x2b1 0x288 0x288 0x288 0x1525 0xa64b 0x2b9 0x290 0x290 0x290 0x16e9 0xa5cd 0x2ba 0x290 0x290 0x290 0x18ac 0xa550 0x2ad 0x284 0x284 0x284 0x1a6f 0xa4d7 0x2b9 0x28f 0x28f 0x28f 0x1c32 0xa45a 0x2b9 0x290 0x290 0x290 0x1df5 0xa3dd 0x2b9 0x290 0x290 0x290 0x1fb8 0xa366 0x2be 0x294 0x294 0x294 0x217b 0xa2ec 0x2c2 0x297 0x297 0x297 0x233e 0xa271 0x2ba 0x290 0x290 0x290 0x2502 0xa1ff 0x2c4 0x29a 0x29a 0x29a 0x26c5 0xa18a 0x2cb 0x2a0 0x2a0 0x2a0 0x2888 0xa112 0x2c9 0x29e 0x29e 0x29e 0x2a4b 0xa0a8 0x2d8 0x2ac 0x2ac 0x2ac 0x2c0e 0xa034 0x2da 0x2ae 0x2ae 0x2ae 0x2dd1 0x9fc9 0x2da 0x2ae 0x2ae 0x2ae 0x2f94 0x9f58 0x2d9 0x2ad 0x2ad 0x2ad 0x3157 0x9ef0 0x2e2 0x2b6 0x2b6 0x2b6 0x331b 0x9e85 0x2e7 0x2bb 0x2bb 0x2bb 0x34de 0x9e1a 0x2d9 0x2ad 0x2ad 0x2ad 0x36a1 0x9db7 0x2e7 0x2ba 0x2ba 0x2ba 0x3864 0x9d50 0x2e7 0x2ba 0x2ba 0x2ba 0x3a27 0x9cf3 0x2ed 0x2c0 0x2c0 0x2c0 0x3bea 0x9c96 0x2fe 0x2d0 0x2d0 0x2d0 0x3dad 0x9c3c 0x307 0x2d8 0x2d8 0x2d8 0x3f70 0x9be1 0x311 0x2e2 0x2e2 0x2e2 0x4133 0x9b89 0x316 0x2e7 0x2e7 0x2e7 0x42f7 0x9b33 0x332 0x301 0x301 0x301 0x44ba 0x9adf 0x338 0x307 0x307 0x307 0x467d 0x9a81 0x351 0x31e 0x31e 0x31e 0x4840 0x9a0f 0x33a 0x308 0x308 0x308 0x4a03 0x9975 0x30a 0x2db 0x2db 0x2db 0x4bc6 0x98d8 0x2cd 0x2a2 0x2a2 0x2a2 0x4d89 0x9866 0x2ba 0x290 0x290 0x290 0x4f4c 0x980e 0x2c6 0x29b 0x29b 0x29b 0x5110 0x97c6 0x2ba 0x290 0x290 0x290 0x52d3 0x9785 0x2c7 0x29d 0x29d 0x29d 0x5496 0x973c 0x2b9 0x290 0x290 0x290 0x5659 0x9703 0x2b9 0x290 0x290 0x290 0x581c 0x96c6 0x2c1 0x296 0x296 0x296 0x59df 0x9692 0x2c9 0x29e 0x29e 0x29e 0x5ba2 0x9658 0x2be 0x293 0x293 0x293 0x5d65 0x9624 0x2c9 0x29e 0x29e 0x29e 0x5f29 0x95f2 0x2c9 0x29e 0x29e 0x29e 0x60ec 0x95c8 0x2cb 0x2a0 0x2a0 0x2a0 0x62af 0x9597 0x2d6 0x2aa 0x2aa 0x2aa 0x6472 0x9568 0x2c9 0x29e 0x29e 0x29e 0x6635 0x9541 0x2d0 0x2a5 0x2a5 0x2a5 0x67f8 0x9516 0x2d9 0x2ad 0x2ad 0x2ad 0x69bb 0x94ef 0x2da 0x2ae 0x2ae 0x2ae 0x6b7e 0x94cc 0x2e7 0x2bb 0x2bb 0x2bb 0x6d42 0x94a9 0x2e9 0x2bc 0x2bc 0x2bc 0x6f05 0x9486 0x2eb 0x2bf 0x2bf 0x2bf 0x70c8 0x9463 0x2f8 0x2ca 0x2ca 0x2ca 0x728b 0x9443 0x2fe 0x2d0 0x2d0 0x2d0 0x744e 0x9426 0x307 0x2d8 0x2d8 0x2d8 0x7611 0x9402 0x307 0x2d8 0x2d8 0x2d8 0x77d4 0x93bf 0x2d7 0x2ab 0x2ab 0x2ab 0x7997 0x936c 0x2bb 0x291 0x291 0x291 0x7b5b 0x931a 0x2cb 0x2a0 0x2a0 0x2a0 0x7d1e 0x92e3 0x2c9 0x29e 0x29e 0x29e 0x7ee1 0x92b2 0x2ca 0x29f 0x29f 0x29f 0x80a4 0x9281 0x2d0 0x2a5 0x2a5 0x2a5 0x8267 0x924f 0x2d9 0x2ad 0x2ad 0x2ad 0x842a 0x921a 0x2c2 0x298 0x298 0x298 0x85ed 0x91f2 0x2d5 0x2a9 0x2a9 0x2a9 0x87b0 0x91cf 0x2da 0x2ae 0x2ae 0x2ae 0x8973 0x91ab 0x2e7 0x2bb 0x2bb 0x2bb 0x8b37 0x9175 0x2d7 0x2ac 0x2ac 0x2ac 0x8cfa 0x912f 0x2d7 0x2ac 0x2ac 0x2ac 0x8ebd 0x90ec 0x2d9 0x2ad 0x2ad 0x2ad 0x9080 0x90ae 0x2da 0x2ae 0x2ae 0x2ae 0x9243 0x906a 0x2da 0x2ae 0x2ae 0x2ae 0x9406 0x900e 0x2cb 0x2a0 0x2a0 0x2a0 0x95c9 0x8fde 0x2c9 0x29e 0x29e 0x29e 0x978c 0x8fd6 0x2d8 0x2ac 0x2ac 0x2ac 0x9950 0x8fc9 0x2d1 0x2a6 0x2a6 0x2a6 0x9b13 0x8fbb 0x2e2 0x2b6 0x2b6 0x2b6 0x9cd6 0x8f9f 0x2df 0x2b3 0x2b3 0x2b3 0x9e99 0x8f6f 0x2f2 0x2c5 0x2c5 0x2c5 0xa05c 0x8ecc 0x2f8 0x2ca 0x2ca 0x2ca 0xa21f 0x8d51 0x2ea 0x2be 0x2be 0x2be 0xa3e2 0x8b5b 0x317 0x2e8 0x2e8 0x2e8 0xa5a5 0x88b7 0x33b 0x30a 0x30a 0x30a 0xa769 0x84eb 0x37e 0x348 0x348 0x348 0xa92c 0x7e33 0x5e0 0x585 0x585 0x585 0xaaef 0x793f 0x89b 0x816 0x816 0x816 0xacb2 0x793f 0x89b 0x816 0x816 0x816 0xae75 0x793f 0x89b 0x816 0x816 0x816>;
			battery0_profile_t1_num = <0x64>;
			battery0_profile_t1_col = <0x06>;
			battery0_profile_t1 = <0x00 0xac85 0x2e4 0x2b0 0x2b0 0x2b0 0x1c3 0xabe7 0x2e9 0x2b5 0x2b5 0x2b5 0x386 0xab66 0x2fc 0x2c6 0x2c6 0x2c6 0x549 0xaaf6 0x30d 0x2d6 0x2d6 0x2d6 0x70c 0xaa8d 0x30e 0x2d8 0x2d8 0x2d8 0x8d0 0xaa1e 0x2fd 0x2c8 0x2c8 0x2c8 0xa93 0xa9ae 0x304 0x2ce 0x2ce 0x2ce 0xc56 0xa938 0x307 0x2d1 0x2d1 0x2d1 0xe19 0xa8cd 0x324 0x2ec 0x2ec 0x2ec 0xfdc 0xa851 0x307 0x2d1 0x2d1 0x2d1 0x119f 0xa7d8 0x307 0x2d1 0x2d1 0x2d1 0x1362 0xa75f 0x30d 0x2d6 0x2d6 0x2d6 0x1525 0xa6e8 0x316 0x2df 0x2df 0x2df 0x16e9 0xa66a 0x316 0x2df 0x2df 0x2df 0x18ac 0xa5f2 0x316 0x2df 0x2df 0x2df 0x1a6f 0xa575 0x324 0x2ec 0x2ec 0x2ec 0x1c32 0xa4f7 0x318 0x2e1 0x2e1 0x2e1 0x1df5 0xa47a 0x316 0x2df 0x2df 0x2df 0x1fb8 0xa404 0x31c 0x2e5 0x2e5 0x2e5 0x217b 0xa38a 0x320 0x2e8 0x2e8 0x2e8 0x233e 0xa313 0x320 0x2e8 0x2e8 0x2e8 0x2502 0xa29a 0x327 0x2ee 0x2ee 0x2ee 0x26c5 0xa221 0x325 0x2ed 0x2ed 0x2ed 0x2888 0xa1b0 0x333 0x2fa 0x2fa 0x2fa 0x2a4b 0xa13b 0x329 0x2f0 0x2f0 0x2f0 0x2c0e 0xa0cb 0x339 0x2ff 0x2ff 0x2ff 0x2dd1 0xa05a 0x33e 0x304 0x304 0x304 0x2f94 0x9feb 0x33c 0x302 0x302 0x302 0x3157 0x9f82 0x34e 0x313 0x313 0x313 0x331b 0x9f17 0x34a 0x30f 0x30f 0x30f 0x34de 0x9ead 0x352 0x317 0x317 0x317 0x36a1 0x9e4a 0x354 0x319 0x319 0x319 0x3864 0x9de1 0x364 0x327 0x327 0x327 0x3a27 0x9d7f 0x367 0x32a 0x32a 0x32a 0x3bea 0x9d1d 0x379 0x33a 0x33a 0x33a 0x3dad 0x9cbc 0x384 0x345 0x345 0x345 0x3f70 0x9c5e 0x38d 0x34e 0x34e 0x34e 0x4133 0x9c03 0x39e 0x35d 0x35d 0x35d 0x42f7 0x9ba3 0x3a2 0x361 0x361 0x361 0x44ba 0x9b4c 0x3cf 0x38b 0x38b 0x38b 0x467d 0x9aec 0x3c4 0x381 0x381 0x381 0x4840 0x9a8f 0x3d1 0x38c 0x38c 0x38c 0x4a03 0x9a24 0x3c5 0x381 0x381 0x381 0x4bc6 0x99a0 0x3a3 0x362 0x362 0x362 0x4d89 0x9910 0x360 0x324 0x324 0x324 0x4f4c 0x9890 0x32c 0x2f3 0x2f3 0x2f3 0x5110 0x9829 0x325 0x2ed 0x2ed 0x2ed 0x52d3 0x97db 0x316 0x2df 0x2df 0x2df 0x5496 0x9795 0x316 0x2df 0x2df 0x2df 0x5659 0x9751 0x312 0x2db 0x2db 0x2db 0x581c 0x9711 0x30d 0x2d6 0x2d6 0x2d6 0x59df 0x96d6 0x316 0x2df 0x2df 0x2df 0x5ba2 0x96a2 0x316 0x2df 0x2df 0x2df 0x5d65 0x9671 0x322 0x2ea 0x2ea 0x2ea 0x5f29 0x963a 0x317 0x2e0 0x2e0 0x2e0 0x60ec 0x9609 0x317 0x2df 0x2df 0x2df 0x62af 0x95de 0x327 0x2ef 0x2ef 0x2ef 0x6472 0x95af 0x325 0x2ed 0x2ed 0x2ed 0x6635 0x9585 0x325 0x2ed 0x2ed 0x2ed 0x67f8 0x955b 0x326 0x2ee 0x2ee 0x2ee 0x69bb 0x9532 0x328 0x2ef 0x2ef 0x2ef 0x6b7e 0x950d 0x334 0x2fa 0x2fa 0x2fa 0x6d42 0x94ea 0x337 0x2fd 0x2fd 0x2fd 0x6f05 0x94cd 0x347 0x30c 0x30c 0x30c 0x70c8 0x94a9 0x352 0x316 0x316 0x316 0x728b 0x9483 0x345 0x30b 0x30b 0x30b 0x744e 0x9464 0x34c 0x311 0x311 0x311 0x7611 0x9445 0x354 0x319 0x319 0x319 0x77d4 0x942d 0x36a 0x32d 0x32d 0x32d 0x7997 0x940d 0x372 0x335 0x335 0x335 0x7b5b 0x93df 0x356 0x31a 0x31a 0x31a 0x7d1e 0x93a0 0x337 0x2fd 0x2fd 0x2fd 0x7ee1 0x9369 0x32f 0x2f6 0x2f6 0x2f6 0x80a4 0x9335 0x31c 0x2e4 0x2e4 0x2e4 0x8267 0x930b 0x327 0x2ef 0x2ef 0x2ef 0x842a 0x92e1 0x32f 0x2f6 0x2f6 0x2f6 0x85ed 0x92ae 0x320 0x2e8 0x2e8 0x2e8 0x87b0 0x9286 0x325 0x2ed 0x2ed 0x2ed 0x8973 0x9263 0x328 0x2ef 0x2ef 0x2ef 0x8b37 0x923f 0x334 0x2fb 0x2fb 0x2fb 0x8cfa 0x920f 0x329 0x2f1 0x2f1 0x2f1 0x8ebd 0x91dc 0x32a 0x2f2 0x2f2 0x2f2 0x9080 0x9196 0x31e 0x2e6 0x2e6 0x2e6 0x9243 0x9158 0x325 0x2ed 0x2ed 0x2ed 0x9406 0x9120 0x33e 0x304 0x304 0x304 0x95c9 0x90d2 0x329 0x2f0 0x2f0 0x2f0 0x978c 0x9079 0x328 0x2ef 0x2ef 0x2ef 0x9950 0x9052 0x327 0x2ef 0x2ef 0x2ef 0x9b13 0x9044 0x326 0x2ed 0x2ed 0x2ed 0x9cd6 0x9036 0x32c 0x2f4 0x2f4 0x2f4 0x9e99 0x9025 0x335 0x2fc 0x2fc 0x2fc 0xa05c 0x9010 0x340 0x306 0x306 0x306 0xa21f 0x8fe3 0x351 0x316 0x316 0x316 0xa3e2 0x8f45 0x337 0x2fd 0x2fd 0x2fd 0xa5a5 0x8dc4 0x347 0x30c 0x30c 0x30c 0xa769 0x8bab 0x36b 0x32e 0x32e 0x32e 0xa92c 0x88ea 0x3aa 0x368 0x368 0x368 0xaaef 0x84f9 0x436 0x3ea 0x3ea 0x3ea 0xacb2 0x7dc7 0x862 0x7cc 0x7cc 0x7cc 0xae75 0x79f2 0xb6f 0xaa3 0xaa3 0xaa3>;
			battery0_profile_t2_num = <0x64>;
			battery0_profile_t2_col = <0x06>;
			battery0_profile_t2 = <0x00 0xac28 0x50a 0x489 0x489 0x489 0x1c3 0xaba5 0x509 0x488 0x488 0x488 0x386 0xab37 0x513 0x491 0x491 0x491 0x549 0xaacc 0x502 0x482 0x482 0x482 0x70c 0xaa5f 0x500 0x480 0x480 0x480 0x8d0 0xa9f6 0x4fe 0x47e 0x47e 0x47e 0xa93 0xa98d 0x504 0x484 0x484 0x484 0xc56 0xa919 0x4ea 0x46c 0x46c 0x46c 0xe19 0xa8a2 0x4e7 0x46a 0x46a 0x46a 0xfdc 0xa832 0x4f6 0x477 0x477 0x477 0x119f 0xa7b9 0x4e3 0x466 0x466 0x466 0x1362 0xa73d 0x4de 0x462 0x462 0x462 0x1525 0xa6c6 0x4e7 0x469 0x469 0x469 0x16e9 0xa64b 0x4dd 0x460 0x460 0x460 0x18ac 0xa5ce 0x4d8 0x45c 0x45c 0x45c 0x1a6f 0xa555 0x4e6 0x468 0x468 0x468 0x1c32 0xa4d8 0x4c9 0x44f 0x44f 0x44f 0x1df5 0xa45b 0x4cc 0x451 0x451 0x451 0x1fb8 0xa3e4 0x4d3 0x458 0x458 0x458 0x217b 0xa36d 0x4d0 0x454 0x454 0x454 0x233e 0xa2f3 0x4d0 0x454 0x454 0x454 0x2502 0xa27d 0x4c9 0x44e 0x44e 0x44e 0x26c5 0xa209 0x4d5 0x45a 0x45a 0x45a 0x2888 0xa192 0x4d8 0x45c 0x45c 0x45c 0x2a4b 0xa121 0x4d8 0x45c 0x45c 0x45c 0x2c0e 0xa0b2 0x4dc 0x45f 0x45f 0x45f 0x2dd1 0xa042 0x4e9 0x46b 0x46b 0x46b 0x2f94 0x9fd1 0x4e7 0x46a 0x46a 0x46a 0x3157 0x9f65 0x4f0 0x471 0x471 0x471 0x331b 0x9efc 0x4f6 0x477 0x477 0x477 0x34de 0x9e99 0x511 0x490 0x490 0x490 0x36a1 0x9e31 0x517 0x494 0x494 0x494 0x3864 0x9dc8 0x529 0x4a4 0x4a4 0x4a4 0x3a27 0x9d65 0x543 0x4bd 0x4bd 0x4bd 0x3bea 0x9cfe 0x54a 0x4c2 0x4c2 0x4c2 0x3dad 0x9c9d 0x555 0x4cd 0x4cd 0x4cd 0x3f70 0x9c3e 0x55e 0x4d5 0x4d5 0x4d5 0x4133 0x9be8 0x57a 0x4ee 0x4ee 0x4ee 0x42f7 0x9b94 0x58f 0x501 0x501 0x501 0x44ba 0x9b3a 0x5a3 0x512 0x512 0x512 0x467d 0x9ad8 0x5a4 0x514 0x514 0x514 0x4840 0x9a71 0x5a5 0x515 0x515 0x515 0x4a03 0x99f8 0x57c 0x4f0 0x4f0 0x4f0 0x4bc6 0x9970 0x54b 0x4c4 0x4c4 0x4c4 0x4d89 0x98e1 0x4ea 0x46c 0x46c 0x46c 0x4f4c 0x9869 0x4bd 0x444 0x444 0x444 0x5110 0x9809 0x49d 0x427 0x427 0x427 0x52d3 0x97b5 0x499 0x423 0x423 0x423 0x5496 0x9769 0x48b 0x416 0x416 0x416 0x5659 0x9725 0x486 0x412 0x412 0x412 0x581c 0x96e8 0x47c 0x409 0x409 0x409 0x59df 0x96ad 0x484 0x410 0x410 0x410 0x5ba2 0x9676 0x495 0x41f 0x41f 0x41f 0x5d65 0x9640 0x48e 0x419 0x419 0x419 0x5f29 0x9609 0x48b 0x416 0x416 0x416 0x60ec 0x95de 0x49c 0x426 0x426 0x426 0x62af 0x95ad 0x49a 0x424 0x424 0x424 0x6472 0x9582 0x49f 0x429 0x429 0x429 0x6635 0x9553 0x4aa 0x433 0x433 0x433 0x67f8 0x952c 0x4b1 0x439 0x439 0x439 0x69bb 0x9505 0x4b7 0x43f 0x43f 0x43f 0x6b7e 0x94e0 0x4c6 0x44c 0x44c 0x44c 0x6d42 0x94b8 0x4bb 0x442 0x442 0x442 0x6f05 0x949a 0x4c9 0x44f 0x44f 0x44f 0x70c8 0x9479 0x4cc 0x451 0x451 0x451 0x728b 0x945d 0x4e3 0x466 0x466 0x466 0x744e 0x943f 0x4f1 0x473 0x473 0x473 0x7611 0x941f 0x4e9 0x46c 0x46c 0x46c 0x77d4 0x9403 0x4e8 0x46a 0x46a 0x46a 0x7997 0x93ec 0x4f4 0x475 0x475 0x475 0x7b5b 0x93d1 0x4ea 0x46c 0x46c 0x46c 0x7d1e 0x93bb 0x507 0x487 0x487 0x487 0x7ee1 0x939e 0x500 0x480 0x480 0x480 0x80a4 0x937b 0x4e1 0x465 0x465 0x465 0x8267 0x9355 0x4d1 0x455 0x455 0x455 0x842a 0x9327 0x4c9 0x44f 0x44f 0x44f 0x85ed 0x92f6 0x4be 0x444 0x444 0x444 0x87b0 0x92d0 0x4d4 0x459 0x459 0x459 0x8973 0x92ad 0x4d8 0x45c 0x45c 0x45c 0x8b37 0x928a 0x4f8 0x479 0x479 0x479 0x8cfa 0x9262 0x503 0x483 0x483 0x483 0x8ebd 0x922a 0x4fd 0x47d 0x47d 0x47d 0x9080 0x91ef 0x517 0x495 0x495 0x495 0x9243 0x91ac 0x51c 0x499 0x499 0x499 0x9406 0x916f 0x52e 0x4a9 0x4a9 0x4a9 0x95c9 0x912c 0x535 0x4af 0x4af 0x4af 0x978c 0x90d4 0x534 0x4af 0x4af 0x4af 0x9950 0x908e 0x523 0x4a0 0x4a0 0x4a0 0x9b13 0x9073 0x51b 0x498 0x498 0x498 0x9cd6 0x9061 0x533 0x4ae 0x4ae 0x4ae 0x9e99 0x9050 0x556 0x4ce 0x4ce 0x4ce 0xa05c 0x903b 0x584 0x4f7 0x4f7 0x4f7 0xa21f 0x901c 0x5b8 0x525 0x525 0x525 0xa3e2 0x8fd6 0x5f9 0x560 0x560 0x560 0xa5a5 0x8eed 0x614 0x578 0x578 0x578 0xa769 0x8d23 0x68b 0x5e3 0x5e3 0x5e3 0xa92c 0x8ab7 0x764 0x6a7 0x6a7 0x6a7 0xaaef 0x8765 0x916 0x82e 0x82e 0x82e 0xacb2 0x823b 0xfb2 0xe20 0xe20 0xe20 0xae75 0x7fdb 0x139f 0x11a8 0x11a8 0x11a8>;
			battery0_profile_t3_num = <0x64>;
			battery0_profile_t3_col = <0x06>;
			battery0_profile_t3 = <0x00 0xac47 0x960 0x870 0x870 0x870 0x1c3 0xabc4 0x963 0x872 0x872 0x872 0x386 0xab4f 0x95b 0x86b 0x86b 0x86b 0x549 0xaae1 0x944 0x856 0x856 0x856 0x70c 0xaa72 0x933 0x847 0x847 0x847 0x8d0 0xaa07 0x85f 0x789 0x789 0x789 0xa93 0xa997 0x89f 0x7c2 0x7c2 0x7c2 0xc56 0xa920 0x8c9 0x7e8 0x7e8 0x7e8 0xe19 0xa8b0 0x8d6 0x7f4 0x7f4 0x7f4 0xfdc 0xa838 0x8b6 0x7d7 0x7d7 0x7d7 0x119f 0xa7bc 0x8a8 0x7ca 0x7ca 0x7ca 0x1362 0xa743 0x897 0x7bb 0x7bb 0x7bb 0x1525 0xa6c5 0x87a 0x7a1 0x7a1 0x7a1 0x16e9 0xa64b 0x870 0x798 0x798 0x798 0x18ac 0xa5d0 0x854 0x77f 0x77f 0x77f 0x1a6f 0xa552 0x83d 0x76a 0x76a 0x76a 0x1c32 0xa4db 0x84c 0x778 0x778 0x778 0x1df5 0xa45e 0x82d 0x75b 0x75b 0x75b 0x1fb8 0xa3e8 0x828 0x758 0x758 0x758 0x217b 0xa371 0x81e 0x74e 0x74e 0x74e 0x233e 0xa2f6 0x81e 0x74e 0x74e 0x74e 0x2502 0xa281 0x814 0x745 0x745 0x745 0x26c5 0xa20d 0x80f 0x740 0x740 0x740 0x2888 0xa196 0x81c 0x74d 0x74d 0x74d 0x2a4b 0xa125 0x81e 0x74e 0x74e 0x74e 0x2c0e 0xa0b6 0x82f 0x75e 0x75e 0x75e 0x2dd1 0xa046 0x835 0x762 0x762 0x762 0x2f94 0x9fd8 0x824 0x753 0x753 0x753 0x3157 0x9f73 0x83e 0x76b 0x76b 0x76b 0x331b 0x9f09 0x855 0x780 0x780 0x780 0x34de 0x9e9e 0x874 0x79b 0x79b 0x79b 0x36a1 0x9e35 0x888 0x7ae 0x7ae 0x7ae 0x3864 0x9dc6 0x85e 0x788 0x788 0x788 0x3a27 0x9d56 0x889 0x7af 0x7af 0x7af 0x3bea 0x9cea 0x88b 0x7b0 0x7b0 0x7b0 0x3dad 0x9c8d 0x89d 0x7c0 0x7c0 0x7c0 0x3f70 0x9c32 0x7f6 0x72a 0x72a 0x72a 0x4133 0x9bd0 0x81c 0x74c 0x74c 0x74c 0x42f7 0x9b78 0x790 0x6ce 0x6ce 0x6ce 0x44ba 0x9b07 0x840 0x76d 0x76d 0x76d 0x467d 0x9a95 0x857 0x781 0x781 0x781 0x4840 0x9a17 0x810 0x742 0x742 0x742 0x4a03 0x9998 0x7bf 0x6f9 0x6f9 0x6f9 0x4bc6 0x991b 0x782 0x6c2 0x6c2 0x6c2 0x4d89 0x98af 0x771 0x6b2 0x6b2 0x6b2 0x4f4c 0x984f 0x758 0x69c 0x69c 0x69c 0x5110 0x97f4 0x737 0x67f 0x67f 0x67f 0x52d3 0x97ab 0x744 0x68a 0x68a 0x68a 0x5496 0x9765 0x742 0x688 0x688 0x688 0x5659 0x9723 0x737 0x67e 0x67e 0x67e 0x581c 0x96eb 0x744 0x68a 0x68a 0x68a 0x59df 0x96b0 0x73b 0x682 0x682 0x682 0x5ba2 0x9679 0x746 0x68c 0x68c 0x68c 0x5d65 0x9648 0x760 0x6a3 0x6a3 0x6a3 0x5f29 0x9611 0x755 0x69a 0x69a 0x69a 0x60ec 0x95e0 0x764 0x6a7 0x6a7 0x6a7 0x62af 0x95b5 0x764 0x6a7 0x6a7 0x6a7 0x6472 0x958a 0x772 0x6b3 0x6b3 0x6b3 0x6635 0x955c 0x779 0x6ba 0x6ba 0x6ba 0x67f8 0x9535 0x782 0x6c2 0x6c2 0x6c2 0x69bb 0x9512 0x797 0x6d5 0x6d5 0x6d5 0x6b7e 0x94ef 0x798 0x6d5 0x6d5 0x6d5 0x6d42 0x94c6 0x775 0x6b6 0x6b6 0x6b6 0x6f05 0x94aa 0x794 0x6d2 0x6d2 0x6d2 0x70c8 0x9488 0x7a5 0x6e1 0x6e1 0x6e1 0x728b 0x946b 0x7b6 0x6f1 0x6f1 0x6f1 0x744e 0x9452 0x7cd 0x705 0x705 0x705 0x7611 0x9436 0x7c6 0x6ff 0x6ff 0x6ff 0x77d4 0x941b 0x7ce 0x706 0x706 0x706 0x7997 0x9406 0x7eb 0x720 0x720 0x720 0x7b5b 0x93f7 0x7fe 0x731 0x731 0x731 0x7d1e 0x93e3 0x7ef 0x724 0x724 0x724 0x7ee1 0x93d4 0x801 0x734 0x734 0x734 0x80a4 0x93bd 0x791 0x6d0 0x6d0 0x6d0 0x8267 0x939a 0x813 0x744 0x744 0x744 0x842a 0x936c 0x80e 0x73f 0x73f 0x73f 0x85ed 0x9343 0x809 0x73c 0x73c 0x73c 0x87b0 0x931d 0x834 0x762 0x762 0x762 0x8973 0x92ef 0x85a 0x784 0x784 0x784 0x8b37 0x92be 0x87d 0x7a4 0x7a4 0x7a4 0x8cfa 0x9289 0x8be 0x7de 0x7de 0x7de 0x8ebd 0x9241 0x8e0 0x7fd 0x7fd 0x7fd 0x9080 0x91fc 0x911 0x829 0x829 0x829 0x9243 0x91bd 0x944 0x857 0x857 0x857 0x9406 0x9173 0x993 0x89e 0x89e 0x89e 0x95c9 0x9112 0x9bc 0x8c3 0x8c3 0x8c3 0x978c 0x90cc 0xa08 0x907 0x907 0x907 0x9950 0x90a8 0xa71 0x965 0x965 0x965 0x9b13 0x9086 0xaf3 0x9db 0x9db 0x9db 0x9cd6 0x9069 0xb31 0xa13 0xa13 0xa13 0x9e99 0x9043 0xbbb 0xa8e 0xa8e 0xa8e 0xa05c 0x9012 0xdee 0xc89 0xc89 0xc89 0xa21f 0x8fae 0x1038 0xe99 0xe99 0xe99 0xa3e2 0x8eb9 0x13ba 0x11c1 0x11c1 0x11c1 0xa5a5 0x8ce1 0x1a12 0x1777 0x1777 0x1777 0xa769 0x8a3c 0x2a35 0x25fc 0x25fc 0x25fc 0xa92c 0x8751 0x3f07 0x38ba 0x38ba 0x38ba 0xaaef 0x8751 0x3f07 0x38ba 0x38ba 0x38ba 0xacb2 0x8751 0x3f07 0x38ba 0x38ba 0x38ba 0xae75 0x8751 0x3f07 0x38ba 0x38ba 0x38ba>;
			battery0_profile_t4_num = <0x64>;
			battery0_profile_t4_col = <0x06>;
			battery0_profile_t4 = <0x00 0xac4d 0xf82 0xebc 0xebc 0xebc 0x1c3 0xabb0 0xf80 0xeb9 0xeb9 0xeb9 0x386 0xab31 0xf64 0xe9f 0xe9f 0xe9f 0x549 0xaab6 0xf29 0xe67 0xe67 0xe67 0x70c 0xaa42 0xf0d 0xe4c 0xe4c 0xe4c 0x8d0 0xa9d6 0xf3d 0xe7a 0xe7a 0xe7a 0xa93 0xa962 0xf51 0xe8c 0xe8c 0xe8c 0xc56 0xa8eb 0xf52 0xe8e 0xe8e 0xe8e 0xe19 0xa873 0xf50 0xe8c 0xe8c 0xe8c 0xfdc 0xa7f8 0xf55 0xe91 0xe91 0xe91 0x119f 0xa784 0xf5d 0xe98 0xe98 0xe98 0x1362 0xa702 0xf44 0xe81 0xe81 0xe81 0x1525 0xa688 0xf32 0xe70 0xe70 0xe70 0x16e9 0xa613 0xf34 0xe71 0xe71 0xe71 0x18ac 0xa591 0xf0c 0xe4c 0xe4c 0xe4c 0x1a6f 0xa518 0xee5 0xe27 0xe27 0xe27 0x1c32 0xa49a 0xeb6 0xdf9 0xdf9 0xdf9 0x1df5 0xa41d 0xe9f 0xde4 0xde4 0xde4 0x1fb8 0xa3a4 0xe7d 0xdc3 0xdc3 0xdc3 0x217b 0xa32e 0xe79 0xdc0 0xdc0 0xdc0 0x233e 0xa2bd 0xe7e 0xdc5 0xdc5 0xdc5 0x2502 0xa241 0xe6e 0xdb5 0xdb5 0xdb5 0x26c5 0xa1d4 0xe85 0xdcb 0xdcb 0xdcb 0x2888 0xa15e 0xe6a 0xdb2 0xdb2 0xdb2 0x2a4b 0xa0ed 0xe79 0xdc0 0xdc0 0xdc0 0x2c0e 0xa077 0xe70 0xdb7 0xdb7 0xdb7 0x2dd1 0xa00a 0xe68 0xdaf 0xdaf 0xdaf 0x2f94 0x9fa0 0xe81 0xdc8 0xdc8 0xdc8 0x3157 0x9f37 0xe9e 0xde3 0xde3 0xde3 0x331b 0x9ece 0xec1 0xe04 0xe04 0xe04 0x34de 0x9e58 0xed5 0xe17 0xe17 0xe17 0x36a1 0x9de2 0xed6 0xe18 0xe18 0xe18 0x3864 0x9d72 0xed9 0xe1b 0xe1b 0xe1b 0x3a27 0x9d01 0xee1 0xe22 0xe22 0xe22 0x3bea 0x9c91 0xed6 0xe18 0xe18 0xe18 0x3dad 0x9c21 0xec3 0xe06 0xe06 0xe06 0x3f70 0x9bba 0xec3 0xe06 0xe06 0xe06 0x4133 0x9b4d 0xeb9 0xdfd 0xdfd 0xdfd 0x42f7 0x9ae3 0xea6 0xdeb 0xdeb 0xdeb 0x44ba 0x9a77 0xeb9 0xdfd 0xdfd 0xdfd 0x467d 0x99f7 0xed1 0xe14 0xe14 0xe14 0x4840 0x9979 0xef5 0xe36 0xe36 0xe36 0x4a03 0x9908 0xedc 0xe1d 0xe1d 0xe1d 0x4bc6 0x9898 0xea7 0xdeb 0xdeb 0xdeb 0x4d89 0x9837 0xe97 0xddc 0xddc 0xddc 0x4f4c 0x97dc 0xe89 0xdcf 0xdcf 0xdcf 0x5110 0x9787 0xe7a 0xdc1 0xdc1 0xdc1 0x52d3 0x9740 0xe85 0xdcb 0xdcb 0xdcb 0x5496 0x96f7 0xe83 0xdc9 0xdc9 0xdc9 0x5659 0x96b5 0xe90 0xdd6 0xdd6 0xdd6 0x581c 0x9676 0xe9b 0xde0 0xde0 0xde0 0x59df 0x963e 0xea7 0xdeb 0xdeb 0xdeb 0x5ba2 0x9606 0xeb5 0xdf9 0xdf9 0xdf9 0x5d65 0x95ce 0xed5 0xe17 0xe17 0xe17 0x5f29 0x959e 0xeea 0xe2b 0xe2b 0xe2b 0x60ec 0x9570 0xf07 0xe46 0xe46 0xe46 0x62af 0x953d 0xf20 0xe5f 0xe5f 0xe5f 0x6472 0x9513 0xf3b 0xe78 0xe78 0xe78 0x6635 0x94ec 0xf5f 0xe9b 0xe9b 0xe9b 0x67f8 0x94c4 0xf7c 0xeb6 0xeb6 0xeb6 0x69bb 0x94a0 0xf9d 0xed5 0xed5 0xed5 0x6b7e 0x947d 0xfb1 0xee8 0xee8 0xee8 0x6d42 0x945b 0xfe1 0xf16 0xf16 0xf16 0x6f05 0x943d 0x1001 0xf34 0xf34 0xf34 0x70c8 0x941f 0x1013 0xf45 0xf45 0xf45 0x728b 0x940e 0x1036 0xf67 0xf67 0xf67 0x744e 0x93fc 0x106b 0xf99 0xf99 0xf99 0x7611 0x93eb 0x109f 0xfca 0xfca 0xfca 0x77d4 0x93de 0x10d4 0xffd 0xffd 0xffd 0x7997 0x93cf 0x111a 0x103f 0x103f 0x103f 0x7b5b 0x93bb 0x115f 0x1080 0x1080 0x1080 0x7d1e 0x93ad 0x11b1 0x10cf 0x10cf 0x10cf 0x7ee1 0x9396 0x120a 0x1123 0x1123 0x1123 0x80a4 0x9377 0x125a 0x116f 0x116f 0x116f 0x8267 0x9356 0x12a6 0x11b7 0x11b7 0x11b7 0x842a 0x9333 0x1307 0x1214 0x1214 0x1214 0x85ed 0x9309 0x137f 0x1285 0x1285 0x1285 0x87b0 0x92d3 0x13df 0x12e1 0x12e1 0x12e1 0x8973 0x92a1 0x1473 0x136d 0x136d 0x136d 0x8b37 0x9269 0x1522 0x1414 0x1414 0x1414 0x8cfa 0x9223 0x15d2 0x14bb 0x14bb 0x14bb 0x8ebd 0x91d8 0x1695 0x1574 0x1574 0x1574 0x9080 0x918f 0x1775 0x1649 0x1649 0x1649 0x9243 0x9149 0x1876 0x173d 0x173d 0x173d 0x9406 0x90f6 0x198f 0x1848 0x1848 0x1848 0x95c9 0x909a 0x1ad5 0x197d 0x197d 0x197d 0x978c 0x904c 0x1c63 0x1af8 0x1af8 0x1af8 0x9950 0x901d 0x1e60 0x1cdb 0x1cdb 0x1cdb 0x9b13 0x8fec 0x20d3 0x1f2f 0x1f2f 0x1f2f 0x9cd6 0x8fc2 0x243d 0x226e 0x226e 0x226e 0x9e99 0x8f93 0x28f4 0x26e7 0x26e7 0x26e7 0xa05c 0x8f50 0x2fef 0x2d89 0x2d89 0x2d89 0xa21f 0x8ed0 0x3afd 0x380a 0x380a 0x380a 0xa3e2 0x8d8f 0x49a6 0x45f7 0x45f7 0x45f7 0xa5a5 0x8c3c 0x57ad 0x534b 0x534b 0x534b 0xa769 0x8c3c 0x57ad 0x534b 0x534b 0x534b 0xa92c 0x8c3c 0x57ad 0x534b 0x534b 0x534b 0xaaef 0x8c3c 0x57ad 0x534b 0x534b 0x534b 0xacb2 0x8c3c 0x57ad 0x534b 0x534b 0x534b 0xae75 0x8c3c 0x57ad 0x534b 0x534b 0x534b>;
			battery1_profile_t0_num = <0x64>;
			battery1_profile_t0_col = <0x06>;
			battery1_profile_t0 = <0x00 0xabd7 0x2ab 0x282 0x282 0x282 0x1c6 0xab45 0x2a8 0x280 0x280 0x280 0x38c 0xaac8 0x29b 0x273 0x273 0x273 0x552 0xaa55 0x2a2 0x279 0x279 0x279 0x718 0xa9e4 0x2a2 0x27a 0x27a 0x27a 0x8de 0xa970 0x29a 0x272 0x272 0x272 0xaa3 0xa8ff 0x2a8 0x27f 0x27f 0x27f 0xc69 0xa888 0x29c 0x274 0x274 0x274 0xe2f 0xa816 0x29b 0x273 0x273 0x273 0xff5 0xa79d 0x29e 0x275 0x275 0x275 0x11bb 0xa723 0x2ab 0x282 0x282 0x282 0x1381 0xa6aa 0x2b3 0x289 0x289 0x289 0x1547 0xa630 0x2ae 0x284 0x284 0x284 0x170d 0xa5b2 0x2aa 0x281 0x281 0x281 0x18d3 0xa532 0x29a 0x272 0x272 0x272 0x1a99 0xa4bf 0x2b9 0x290 0x290 0x290 0x1c5f 0xa440 0x2ba 0x290 0x290 0x290 0x1e24 0xa3c6 0x2b9 0x290 0x290 0x290 0x1fea 0xa34e 0x2ba 0x290 0x290 0x290 0x21b0 0xa2d3 0x2b9 0x290 0x290 0x290 0x2376 0xa25f 0x2ba 0x290 0x290 0x290 0x253c 0xa1e9 0x2c8 0x29d 0x29d 0x29d 0x2702 0xa171 0x2c9 0x29f 0x29f 0x29f 0x28c8 0xa100 0x2bd 0x293 0x293 0x293 0x2a8e 0xa08c 0x2c3 0x299 0x299 0x299 0x2c54 0xa01b 0x2c1 0x297 0x297 0x297 0x2e1a 0x9fb1 0x2d4 0x2a8 0x2a8 0x2a8 0x2fdf 0x9f42 0x2da 0x2ae 0x2ae 0x2ae 0x31a5 0x9ed7 0x2cc 0x2a1 0x2a1 0x2a1 0x336b 0x9e6c 0x2d8 0x2ac 0x2ac 0x2ac 0x3531 0x9e0a 0x2dd 0x2b1 0x2b1 0x2b1 0x36f7 0x9da4 0x2e9 0x2bc 0x2bc 0x2bc 0x38bd 0x9d40 0x2e8 0x2bb 0x2bb 0x2bb 0x3a83 0x9ce0 0x2e6 0x2ba 0x2ba 0x2ba 0x3c49 0x9c82 0x2f4 0x2c7 0x2c7 0x2c7 0x3e0f 0x9c26 0x2f8 0x2ca 0x2ca 0x2ca 0x3fd5 0x9bd1 0x308 0x2d9 0x2d9 0x2d9 0x419b 0x9b76 0x316 0x2e7 0x2e7 0x2e7 0x4360 0x9b21 0x320 0x2f0 0x2f0 0x2f0 0x4526 0x9acc 0x33c 0x30b 0x30b 0x30b 0x46ec 0x9a6c 0x33c 0x30b 0x30b 0x30b 0x48b2 0x99fd 0x342 0x310 0x310 0x310 0x4a78 0x9965 0x2f1 0x2c3 0x2c3 0x2c3 0x4c3e 0x98d1 0x2c9 0x29e 0x29e 0x29e 0x4e04 0x9869 0x2c6 0x29b 0x29b 0x29b 0x4fca 0x980f 0x2b5 0x28b 0x28b 0x28b 0x5190 0x97c2 0x2b1 0x288 0x288 0x288 0x5356 0x977b 0x2a8 0x27f 0x27f 0x27f 0x551c 0x973b 0x2b2 0x288 0x288 0x288 0x56e1 0x96fe 0x2b9 0x290 0x290 0x290 0x58a7 0x96be 0x29c 0x274 0x274 0x274 0x5a6d 0x9687 0x2af 0x286 0x286 0x286 0x5c33 0x9657 0x2c0 0x295 0x295 0x295 0x5df9 0x961d 0x2b1 0x288 0x288 0x288 0x5fbf 0x95f0 0x2c4 0x299 0x299 0x299 0x6185 0x95c0 0x2be 0x294 0x294 0x294 0x634b 0x958f 0x2c6 0x29c 0x29c 0x29c 0x6511 0x9564 0x2cb 0x2a0 0x2a0 0x2a0 0x66d7 0x9539 0x2c6 0x29c 0x29c 0x29c 0x689d 0x950f 0x2be 0x294 0x294 0x294 0x6a62 0x94e7 0x2cf 0x2a4 0x2a4 0x2a4 0x6c28 0x94c4 0x2d8 0x2ac 0x2ac 0x2ac 0x6dee 0x94a0 0x2d8 0x2ac 0x2ac 0x2ac 0x6fb4 0x9482 0x2e4 0x2b8 0x2b8 0x2b8 0x717a 0x945a 0x2e9 0x2bc 0x2bc 0x2bc 0x7340 0x943d 0x2e8 0x2bc 0x2bc 0x2bc 0x7506 0x9421 0x2f6 0x2c9 0x2c9 0x2c9 0x76cc 0x9400 0x2f1 0x2c4 0x2c4 0x2c4 0x7892 0x93cb 0x2e0 0x2b4 0x2b4 0x2b4 0x7a58 0x937f 0x2b9 0x290 0x290 0x290 0x7c1d 0x932a 0x2b7 0x28d 0x28d 0x28d 0x7de3 0x92ed 0x2b9 0x290 0x290 0x290 0x7fa9 0x92c1 0x2ba 0x290 0x290 0x290 0x816f 0x9290 0x2bb 0x291 0x291 0x291 0x8335 0x925e 0x2b4 0x28a 0x28a 0x28a 0x84fb 0x9230 0x2b2 0x289 0x289 0x289 0x86c1 0x9205 0x2ba 0x290 0x290 0x290 0x8887 0x91db 0x2ba 0x290 0x290 0x290 0x8a4d 0x91bc 0x2c8 0x29d 0x29d 0x29d 0x8c13 0x918b 0x2b8 0x28e 0x28e 0x28e 0x8dd9 0x9151 0x2ae 0x285 0x285 0x285 0x8f9e 0x910f 0x2b3 0x28a 0x28a 0x28a 0x9164 0x90cc 0x2a9 0x280 0x280 0x280 0x932a 0x908c 0x2ab 0x282 0x282 0x282 0x94f0 0x9043 0x2aa 0x282 0x282 0x282 0x96b6 0x8ff5 0x2a8 0x27f 0x27f 0x27f 0x987c 0x8fd7 0x2ac 0x283 0x283 0x283 0x9a42 0x8fd0 0x2bd 0x293 0x293 0x293 0x9c08 0x8fc7 0x2c9 0x29e 0x29e 0x29e 0x9dce 0x8fb9 0x2d0 0x2a5 0x2a5 0x2a5 0x9f94 0x8f9e 0x2e1 0x2b5 0x2b5 0x2b5 0xa15a 0x8f63 0x2e6 0x2ba 0x2ba 0x2ba 0xa31f 0x8e95 0x2db 0x2af 0x2af 0x2af 0xa4e5 0x8d02 0x2d9 0x2ae 0x2ae 0x2ae 0xa6ab 0x8af6 0x2fe 0x2d0 0x2d0 0x2d0 0xa871 0x884c 0x330 0x2ff 0x2ff 0x2ff 0xaa37 0x8498 0x3a6 0x36e 0x36e 0x36e 0xabfd 0x7e72 0x5bc 0x564 0x564 0x564 0xadc3 0x7be9 0x6d9 0x66f 0x66f 0x66f 0xaf89 0x7be9 0x6d9 0x66f 0x66f 0x66f>;
			battery1_profile_t1_num = <0x64>;
			battery1_profile_t1_col = <0x06>;
			battery1_profile_t1 = <0x00 0xabea 0x375 0x349 0x349 0x349 0x1c6 0xab72 0x373 0x346 0x346 0x346 0x38c 0xaafc 0x35f 0x334 0x334 0x334 0x552 0xaa8d 0x35b 0x330 0x330 0x330 0x718 0xaa20 0x35b 0x330 0x330 0x330 0x8de 0xa9af 0x35f 0x334 0x334 0x334 0xaa3 0xa943 0x370 0x344 0x344 0x344 0xc69 0xa8cd 0x355 0x32b 0x32b 0x32b 0xe2f 0xa856 0x356 0x32b 0x32b 0x32b 0xff5 0xa7e3 0x364 0x338 0x338 0x338 0x11bb 0xa769 0x363 0x338 0x338 0x338 0x1381 0xa6ed 0x363 0x338 0x338 0x338 0x1547 0xa671 0x35a 0x32f 0x32f 0x32f 0x170d 0xa5f7 0x361 0x335 0x335 0x335 0x18d3 0xa57f 0x366 0x33a 0x33a 0x33a 0x1a99 0xa500 0x363 0x338 0x338 0x338 0x1c5f 0xa481 0x363 0x338 0x338 0x338 0x1e24 0xa406 0x36a 0x33e 0x33e 0x33e 0x1fea 0xa38f 0x36c 0x340 0x340 0x340 0x21b0 0xa314 0x36f 0x343 0x343 0x343 0x2376 0xa29c 0x373 0x347 0x347 0x347 0x253c 0xa224 0x365 0x339 0x339 0x339 0x2702 0xa1ac 0x374 0x348 0x348 0x348 0x28c8 0xa140 0x38b 0x35d 0x35d 0x35d 0x2a8e 0xa0c8 0x378 0x34c 0x34c 0x34c 0x2c54 0xa056 0x38b 0x35e 0x35e 0x35e 0x2e1a 0x9fe8 0x388 0x35b 0x35b 0x35b 0x2fdf 0x9f77 0x38f 0x361 0x361 0x361 0x31a5 0x9f11 0x3ae 0x37e 0x37e 0x37e 0x336b 0x9ea8 0x3a2 0x374 0x374 0x374 0x3531 0x9e3e 0x3b1 0x382 0x382 0x382 0x36f7 0x9dd6 0x3b6 0x386 0x386 0x386 0x38bd 0x9d73 0x3c8 0x397 0x397 0x397 0x3a83 0x9d11 0x3d1 0x3a1 0x3a1 0x3a1 0x3c49 0x9cb2 0x3e7 0x3b5 0x3b5 0x3b5 0x3e0f 0x9c56 0x3f0 0x3bd 0x3bd 0x3bd 0x3fd5 0x9bfa 0x40d 0x3d9 0x3d9 0x3d9 0x419b 0x9b9f 0x412 0x3de 0x3de 0x3de 0x4360 0x9b47 0x42e 0x3f8 0x3f8 0x3f8 0x4526 0x9ae7 0x42e 0x3f8 0x3f8 0x3f8 0x46ec 0x9a85 0x42e 0x3f8 0x3f8 0x3f8 0x48b2 0x9a12 0x418 0x3e3 0x3e3 0x3e3 0x4a78 0x999a 0x3e8 0x3b6 0x3b6 0x3b6 0x4c3e 0x990a 0x3a4 0x376 0x376 0x376 0x4e04 0x988d 0x364 0x338 0x338 0x338 0x4fca 0x982a 0x35c 0x331 0x331 0x331 0x5190 0x97d0 0x34a 0x320 0x320 0x320 0x5356 0x9787 0x34d 0x322 0x322 0x322 0x551c 0x9741 0x33a 0x311 0x311 0x311 0x56e1 0x96fc 0x334 0x30b 0x30b 0x30b 0x58a7 0x96c2 0x336 0x30d 0x30d 0x30d 0x5a6d 0x968f 0x342 0x318 0x318 0x318 0x5c33 0x9653 0x336 0x30d 0x30d 0x30d 0x5df9 0x9621 0x335 0x30c 0x30c 0x30c 0x5fbf 0x95f3 0x345 0x31b 0x31b 0x31b 0x6185 0x95c4 0x34b 0x321 0x321 0x321 0x634b 0x9598 0x345 0x31c 0x31c 0x31c 0x6511 0x956d 0x353 0x329 0x329 0x329 0x66d7 0x9543 0x354 0x32a 0x32a 0x32a 0x689d 0x9519 0x357 0x32d 0x32d 0x32d 0x6a62 0x94f6 0x363 0x338 0x338 0x338 0x6c28 0x94d3 0x363 0x338 0x338 0x338 0x6dee 0x94af 0x36d 0x341 0x341 0x341 0x6fb4 0x948c 0x372 0x346 0x346 0x346 0x717a 0x946f 0x375 0x348 0x348 0x348 0x7340 0x9453 0x384 0x357 0x357 0x357 0x7506 0x9436 0x386 0x359 0x359 0x359 0x76cc 0x941a 0x397 0x369 0x369 0x369 0x7892 0x93f8 0x38d 0x360 0x360 0x360 0x7a58 0x93d1 0x372 0x346 0x346 0x346 0x7c1d 0x93aa 0x368 0x33c 0x33c 0x33c 0x7de3 0x937a 0x359 0x32e 0x32e 0x32e 0x7fa9 0x9349 0x346 0x31c 0x31c 0x31c 0x816f 0x931e 0x346 0x31c 0x31c 0x31c 0x8335 0x92f4 0x34a 0x320 0x320 0x320 0x84fb 0x92c2 0x344 0x31a 0x31a 0x31a 0x86c1 0x9290 0x330 0x307 0x307 0x307 0x8887 0x926d 0x337 0x30d 0x30d 0x30d 0x8a4d 0x924f 0x337 0x30d 0x30d 0x30d 0x8c13 0x9227 0x345 0x31b 0x31b 0x31b 0x8dd9 0x91f4 0x334 0x30b 0x30b 0x30b 0x8f9e 0x91b9 0x337 0x30d 0x30d 0x30d 0x9164 0x9177 0x33c 0x313 0x313 0x313 0x932a 0x913e 0x344 0x31a 0x31a 0x31a 0x94f0 0x90fe 0x343 0x319 0x319 0x319 0x96b6 0x90ae 0x345 0x31b 0x31b 0x31b 0x987c 0x9064 0x346 0x31c 0x31c 0x31c 0x9a42 0x9046 0x346 0x31c 0x31c 0x31c 0x9c08 0x9038 0x345 0x31b 0x31b 0x31b 0x9dce 0x902a 0x349 0x31f 0x31f 0x31f 0x9f94 0x901c 0x35d 0x332 0x332 0x332 0xa15a 0x9003 0x36f 0x343 0x343 0x343 0xa31f 0x8fc3 0x37f 0x352 0x352 0x352 0xa4e5 0x8eea 0x359 0x32e 0x32e 0x32e 0xa6ab 0x8d41 0x365 0x339 0x339 0x339 0xa871 0x8b13 0x38f 0x361 0x361 0x361 0xaa37 0x8828 0x3d4 0x3a3 0x3a3 0x3a3 0xabfd 0x83d3 0x453 0x41c 0x41c 0x41c 0xadc3 0x7b9f 0xaa9 0xa21 0xa21 0xa21 0xaf89 0x77be 0xec7 0xe09 0xe09 0xe09>;
			battery1_profile_t2_num = <0x64>;
			battery1_profile_t2_col = <0x06>;
			battery1_profile_t2 = <0x00 0xac15 0x508 0x4a1 0x4a1 0x4a1 0x1c6 0xab99 0x507 0x4a0 0x4a0 0x4a0 0x38c 0xab2a 0x50c 0x4a4 0x4a4 0x4a4 0x552 0xaabe 0x509 0x4a2 0x4a2 0x4a2 0x718 0xaa4d 0x4f6 0x490 0x490 0x490 0x8de 0xa9e1 0x502 0x49b 0x49b 0x49b 0xaa3 0xa972 0x4fb 0x495 0x495 0x495 0xc69 0xa8fb 0x4e8 0x484 0x484 0x484 0xe2f 0xa88a 0x4e7 0x483 0x483 0x483 0xff5 0xa813 0x4e7 0x483 0x483 0x483 0x11bb 0xa799 0x4e2 0x47e 0x47e 0x47e 0x1381 0xa71d 0x4d8 0x475 0x475 0x475 0x1547 0xa6a6 0x4d8 0x475 0x475 0x475 0x170d 0xa629 0x4d8 0x475 0x475 0x475 0x18d3 0xa5ab 0x4cb 0x469 0x469 0x469 0x1a99 0xa532 0x4d8 0x475 0x475 0x475 0x1c5f 0xa4b4 0x4c9 0x467 0x467 0x467 0x1e24 0xa437 0x4c9 0x467 0x467 0x467 0x1fea 0xa3bf 0x4cf 0x46d 0x46d 0x46d 0x21b0 0xa348 0x4d8 0x475 0x475 0x475 0x2376 0xa2d0 0x4d8 0x475 0x475 0x475 0x253c 0xa25d 0x4e4 0x480 0x480 0x480 0x2702 0xa1e7 0x4e7 0x483 0x483 0x483 0x28c8 0xa170 0x4d8 0x475 0x475 0x475 0x2a8e 0xa0fa 0x4df 0x47b 0x47b 0x47b 0x2c54 0xa08d 0x4f7 0x491 0x491 0x491 0x2e1a 0xa018 0x4f1 0x48c 0x48c 0x48c 0x2fdf 0x9fac 0x4f3 0x48e 0x48e 0x48e 0x31a5 0x9f42 0x510 0x4a8 0x4a8 0x4a8 0x336b 0x9ed9 0x509 0x4a2 0x4a2 0x4a2 0x3531 0x9e75 0x526 0x4bc 0x4bc 0x4bc 0x36f7 0x9e05 0x526 0x4bc 0x4bc 0x4bc 0x38bd 0x9d9f 0x52f 0x4c5 0x4c5 0x4c5 0x3a83 0x9d42 0x545 0x4d9 0x4d9 0x4d9 0x3c49 0x9cdf 0x54c 0x4e0 0x4e0 0x4e0 0x3e0f 0x9c81 0x56a 0x4fb 0x4fb 0x4fb 0x3fd5 0x9c26 0x573 0x503 0x503 0x503 0x419b 0x9bca 0x582 0x511 0x511 0x511 0x4360 0x9b6f 0x585 0x514 0x514 0x514 0x4526 0x9b10 0x59c 0x529 0x529 0x529 0x46ec 0x9aa9 0x591 0x51f 0x51f 0x51f 0x48b2 0x9a3a 0x57a 0x50a 0x50a 0x50a 0x4a78 0x99b7 0x53b 0x4d0 0x4d0 0x4d0 0x4c3e 0x9931 0x4e9 0x484 0x484 0x484 0x4e04 0x98b7 0x4af 0x44f 0x44f 0x44f 0x4fca 0x984e 0x48b 0x42e 0x42e 0x42e 0x5190 0x97f3 0x485 0x428 0x428 0x428 0x5356 0x97a3 0x471 0x416 0x416 0x416 0x551c 0x975d 0x475 0x419 0x419 0x419 0x56e1 0x971d 0x47e 0x422 0x422 0x422 0x58a7 0x96dc 0x468 0x40e 0x40e 0x40e 0x5a6d 0x96a6 0x46a 0x410 0x410 0x410 0x5c33 0x966e 0x47b 0x420 0x420 0x420 0x5df9 0x9637 0x46c 0x412 0x412 0x412 0x5fbf 0x9606 0x46f 0x414 0x414 0x414 0x6185 0x95d4 0x475 0x419 0x419 0x419 0x634b 0x95a6 0x473 0x418 0x418 0x418 0x6511 0x957c 0x47b 0x420 0x420 0x420 0x66d7 0x9552 0x488 0x42b 0x42b 0x42b 0x689d 0x9528 0x48a 0x42d 0x42d 0x42d 0x6a62 0x9505 0x48b 0x42e 0x42e 0x42e 0x6c28 0x94e2 0x491 0x434 0x434 0x434 0x6dee 0x94bc 0x4a5 0x446 0x446 0x446 0x6fb4 0x9498 0x49b 0x43c 0x43c 0x43c 0x717a 0x9478 0x49c 0x43e 0x43e 0x43e 0x7340 0x945e 0x4a5 0x446 0x446 0x446 0x7506 0x9443 0x4c5 0x463 0x463 0x463 0x76cc 0x9427 0x4c9 0x467 0x467 0x467 0x7892 0x9405 0x4b8 0x457 0x457 0x457 0x7a58 0x93f1 0x4be 0x45d 0x45d 0x45d 0x7c1d 0x93d9 0x4c2 0x460 0x460 0x460 0x7de3 0x93c0 0x4c1 0x460 0x460 0x460 0x7fa9 0x93a7 0x4c9 0x467 0x467 0x467 0x816f 0x9386 0x4b1 0x451 0x451 0x451 0x8335 0x935d 0x48c 0x42f 0x42f 0x42f 0x84fb 0x9339 0x48b 0x42e 0x42e 0x42e 0x86c1 0x9307 0x487 0x42b 0x42b 0x42b 0x8887 0x92da 0x47c 0x420 0x420 0x420 0x8a4d 0x92ba 0x483 0x426 0x426 0x426 0x8c13 0x929a 0x49d 0x43f 0x43f 0x43f 0x8dd9 0x9268 0x492 0x434 0x434 0x434 0x8f9e 0x9236 0x498 0x43a 0x43a 0x43a 0x9164 0x91f2 0x4a8 0x449 0x449 0x449 0x932a 0x91b3 0x49c 0x43e 0x43e 0x43e 0x94f0 0x917c 0x4b4 0x453 0x453 0x453 0x96b6 0x9139 0x4c3 0x461 0x461 0x461 0x987c 0x90de 0x4ba 0x459 0x459 0x459 0x9a42 0x909d 0x4ba 0x459 0x459 0x459 0x9c08 0x9082 0x4df 0x47b 0x47b 0x47b 0x9dce 0x9073 0x506 0x49f 0x49f 0x49f 0x9f94 0x905e 0x518 0x4b0 0x4b0 0x4b0 0xa15a 0x9047 0x530 0x4c6 0x4c6 0x4c6 0xa31f 0x9025 0x56b 0x4fc 0x4fc 0x4fc 0xa4e5 0x8fd8 0x5c0 0x54b 0x54b 0x54b 0xa6ab 0x8ee2 0x5db 0x563 0x563 0x563 0xa871 0x8d1e 0x624 0x5a6 0x5a6 0x5a6 0xaa37 0x8ac6 0x70f 0x67f 0x67f 0x67f 0xabfd 0x8787 0x9e3 0x919 0x919 0x919 0xadc3 0x8238 0x190b 0x170a 0x170a 0x170a 0xaf89 0x7bef 0x313b 0x2d4a 0x2d4a 0x2d4a>;
			battery1_profile_t3_num = <0x64>;
			battery1_profile_t3_col = <0x06>;
			battery1_profile_t3 = <0x00 0xabfd 0x944 0x887 0x887 0x887 0x1c6 0xab7e 0x91d 0x863 0x863 0x863 0x38c 0xab06 0x827 0x780 0x780 0x780 0x552 0xaa95 0x813 0x76d 0x76d 0x76d 0x718 0xaa2b 0x80b 0x766 0x766 0x766 0x8de 0xa9ba 0x805 0x761 0x761 0x761 0xaa3 0xa949 0x7fa 0x757 0x757 0x757 0xc69 0xa8d1 0x7db 0x73a 0x73a 0x73a 0xe2f 0xa859 0x7c0 0x722 0x722 0x722 0xff5 0xa7e5 0x7b8 0x71a 0x71a 0x71a 0x11bb 0xa768 0x7aa 0x70d 0x70d 0x70d 0x1381 0xa6ef 0x7aa 0x70d 0x70d 0x70d 0x1547 0xa673 0x791 0x6f6 0x6f6 0x6f6 0x170d 0xa5ee 0x77e 0x6e4 0x6e4 0x6e4 0x18d3 0xa56d 0x76c 0x6d4 0x6d4 0x6d4 0x1a99 0xa4fa 0x77a 0x6e0 0x6e0 0x6e0 0x1c5f 0xa479 0x761 0x6ca 0x6ca 0x6ca 0x1e24 0xa3f8 0x74a 0x6b4 0x6b4 0x6b4 0x1fea 0xa380 0x74a 0x6b5 0x6b5 0x6b5 0x21b0 0xa307 0x757 0x6c0 0x6c0 0x6c0 0x2376 0xa28f 0x753 0x6bd 0x6bd 0x6bd 0x253c 0xa21d 0x751 0x6bb 0x6bb 0x6bb 0x2702 0xa1a4 0x750 0x6ba 0x6ba 0x6ba 0x28c8 0xa12f 0x74f 0x6ba 0x6ba 0x6ba 0x2a8e 0xa0c0 0x76e 0x6d6 0x6d6 0x6d6 0x2c54 0xa048 0x757 0x6c1 0x6c1 0x6c1 0x2e1a 0x9fdc 0x756 0x6c0 0x6c0 0x6c0 0x2fdf 0x9f6a 0x76c 0x6d4 0x6d4 0x6d4 0x31a5 0x9efd 0x76e 0x6d6 0x6d6 0x6d6 0x336b 0x9e92 0x787 0x6ed 0x6ed 0x6ed 0x3531 0x9e23 0x778 0x6df 0x6df 0x6df 0x36f7 0x9db9 0x774 0x6db 0x6db 0x6db 0x38bd 0x9d4e 0x783 0x6e9 0x6e9 0x6e9 0x3a83 0x9ce8 0x79d 0x701 0x701 0x701 0x3c49 0x9c7b 0x79b 0x6ff 0x6ff 0x6ff 0x3e0f 0x9c16 0x789 0x6ef 0x6ef 0x6ef 0x3fd5 0x9bb8 0x795 0x6f9 0x6f9 0x6f9 0x419b 0x9b4d 0x789 0x6ef 0x6ef 0x6ef 0x4360 0x9ae1 0x784 0x6ea 0x6ea 0x6ea 0x4526 0x9a6d 0x757 0x6c0 0x6c0 0x6c0 0x46ec 0x99f8 0x71a 0x689 0x689 0x689 0x48b2 0x9982 0x6f7 0x668 0x668 0x668 0x4a78 0x9910 0x6d8 0x64c 0x64c 0x64c 0x4c3e 0x98a5 0x6d0 0x644 0x644 0x644 0x4e04 0x983c 0x684 0x5ff 0x5ff 0x5ff 0x4fca 0x97e0 0x665 0x5e2 0x5e2 0x5e2 0x5190 0x978f 0x666 0x5e3 0x5e3 0x5e3 0x5356 0x9742 0x661 0x5df 0x5df 0x5df 0x551c 0x9701 0x668 0x5e4 0x5e4 0x5e4 0x56e1 0x96c1 0x640 0x5c0 0x5c0 0x5c0 0x58a7 0x9688 0x668 0x5e5 0x5e5 0x5e5 0x5a6d 0x9650 0x66b 0x5e8 0x5e8 0x5e8 0x5c33 0x9617 0x675 0x5f1 0x5f1 0x5f1 0x5df9 0x95e5 0x66e 0x5eb 0x5eb 0x5eb 0x5fbf 0x95b2 0x668 0x5e5 0x5e5 0x5e5 0x6185 0x957e 0x673 0x5ef 0x5ef 0x5ef 0x634b 0x9558 0x68f 0x608 0x608 0x608 0x6511 0x952e 0x69d 0x616 0x616 0x616 0x66d7 0x9500 0x685 0x5ff 0x5ff 0x5ff 0x689d 0x94dc 0x694 0x60d 0x60d 0x60d 0x6a62 0x94b9 0x6a6 0x61e 0x61e 0x61e 0x6c28 0x9495 0x6c4 0x63a 0x63a 0x63a 0x6dee 0x9472 0x6b5 0x62c 0x62c 0x62c 0x6fb4 0x944f 0x6a0 0x619 0x619 0x619 0x717a 0x942c 0x6ad 0x624 0x624 0x624 0x7340 0x9415 0x6b6 0x62d 0x62d 0x62d 0x7506 0x93fb 0x6d6 0x64a 0x64a 0x64a 0x76cc 0x93e3 0x6d0 0x645 0x645 0x645 0x7892 0x93cb 0x6d1 0x645 0x645 0x645 0x7a58 0x93b6 0x6cc 0x641 0x641 0x641 0x7c1d 0x93a6 0x6ef 0x661 0x661 0x661 0x7de3 0x9391 0x6f1 0x663 0x663 0x663 0x7fa9 0x937c 0x6e1 0x654 0x654 0x654 0x816f 0x9366 0x6ef 0x661 0x661 0x661 0x8335 0x9345 0x70d 0x67d 0x67d 0x67d 0x84fb 0x9317 0x6ff 0x670 0x670 0x670 0x86c1 0x92ed 0x6ff 0x670 0x670 0x670 0x8887 0x92ce 0x718 0x687 0x687 0x687 0x8a4d 0x9298 0x739 0x6a5 0x6a5 0x6a5 0x8c13 0x926a 0x75b 0x6c4 0x6c4 0x6c4 0x8dd9 0x922b 0x776 0x6dd 0x6dd 0x6dd 0x8f9e 0x91e3 0x76d 0x6d5 0x6d5 0x6d5 0x9164 0x91a4 0x7a3 0x707 0x707 0x707 0x932a 0x9164 0x7cb 0x72b 0x72b 0x72b 0x94f0 0x9119 0x81a 0x774 0x774 0x774 0x96b6 0x90b9 0x84b 0x7a1 0x7a1 0x7a1 0x987c 0x9077 0x872 0x7c5 0x7c5 0x7c5 0x9a42 0x904f 0x8f6 0x83e 0x83e 0x83e 0x9c08 0x902f 0x9a1 0x8dc 0x8dc 0x8dc 0x9dce 0x900e 0xaaf 0x9d4 0x9d4 0x9d4 0x9f94 0x8fe1 0xc01 0xb0b 0xb0b 0xb0b 0xa15a 0x8f98 0xe4d 0xd28 0xd28 0xd28 0xa31f 0x8f08 0x12ca 0x1149 0x1149 0x1149 0xa4e5 0x8dce 0x1c8b 0x1a43 0x1a43 0x1a43 0xa6ab 0x8b6e 0x2cf8 0x295f 0x295f 0x295f 0xa871 0x8251 0x29ea 0x268f 0x268f 0x268f 0xaa37 0x7ac5 0x20ff 0x1e5b 0x1e5b 0x1e5b 0xabfd 0x7ac5 0x20ff 0x1e5b 0x1e5b 0x1e5b 0xadc3 0x7ac5 0x20ff 0x1e5b 0x1e5b 0x1e5b 0xaf89 0x7ac5 0x20ff 0x1e5b 0x1e5b 0x1e5b>;
			battery1_profile_t4_num = <0x64>;
			battery1_profile_t4_col = <0x06>;
			battery1_profile_t4 = <0x00 0xac34 0xd91 0xd4b 0xd4b 0xd4b 0x1c6 0xab9c 0xd8e 0xd49 0xd49 0xd49 0x38c 0xab20 0xd7b 0xd36 0xd36 0xd36 0x552 0xaaad 0xd5d 0xd19 0xd19 0xd19 0x718 0xaa38 0xd42 0xcfe 0xcfe 0xcfe 0x8de 0xa9cb 0xd57 0xd13 0xd13 0xd13 0xaa3 0xa957 0xd6e 0xd29 0xd29 0xd29 0xc69 0xa8e0 0xd53 0xd0f 0xd0f 0xd0f 0xe2f 0xa86c 0xd6e 0xd2a 0xd2a 0xd2a 0xff5 0xa7ef 0xd61 0xd1d 0xd1d 0xd1d 0x11bb 0xa777 0xd61 0xd1c 0xd1c 0xd1c 0x1381 0xa6fc 0xd59 0xd15 0xd15 0xd15 0x1547 0xa67d 0xd3e 0xcfa 0xcfa 0xcfa 0x170d 0xa608 0xd34 0xcf0 0xcf0 0xcf0 0x18d3 0xa58b 0xd34 0xcf0 0xcf0 0xcf0 0x1a99 0xa50b 0xd01 0xcbe 0xcbe 0xcbe 0x1c5f 0xa48e 0xcd7 0xc95 0xc95 0xc95 0x1e24 0xa416 0xcca 0xc89 0xc89 0xc89 0x1fea 0xa39a 0xcaf 0xc6e 0xc6e 0xc6e 0x21b0 0xa323 0xcb2 0xc71 0xc71 0xc71 0x2376 0xa2ae 0xcab 0xc6a 0xc6a 0xc6a 0x253c 0xa235 0xc98 0xc57 0xc57 0xc57 0x2702 0xa1c3 0xca6 0xc65 0xc65 0xc65 0x28c8 0xa14c 0xc89 0xc49 0xc49 0xc49 0x2a8e 0xa0d5 0xc8d 0xc4d 0xc4d 0xc4d 0x2c54 0xa062 0xc8b 0xc4a 0xc4a 0xc4a 0x2e1a 0x9fee 0xc7b 0xc3b 0xc3b 0xc3b 0x2fdf 0x9f82 0xc86 0xc46 0xc46 0xc46 0x31a5 0x9f11 0xc95 0xc55 0xc55 0xc55 0x336b 0x9ea1 0xc9a 0xc5a 0xc5a 0xc5a 0x3531 0x9e35 0xcb7 0xc76 0xc76 0xc76 0x36f7 0x9dbf 0xcb1 0xc71 0xc71 0xc71 0x38bd 0x9d4d 0xcad 0xc6d 0xc6d 0xc6d 0x3a83 0x9cd9 0xca5 0xc64 0xc64 0xc64 0x3c49 0x9c6a 0xca4 0xc63 0xc63 0xc63 0x3e0f 0x9bf5 0xc8c 0xc4b 0xc4b 0xc4b 0x3fd5 0x9b83 0xc78 0xc38 0xc38 0xc38 0x419b 0x9b12 0xc67 0xc28 0xc28 0xc28 0x4360 0x9aa1 0xc52 0xc13 0xc13 0xc13 0x4526 0x9a30 0xc42 0xc03 0xc03 0xc03 0x46ec 0x99bb 0xc64 0xc24 0xc24 0xc24 0x48b2 0x994c 0xc6e 0xc2e 0xc2e 0xc2e 0x4a78 0x98e7 0xc4e 0xc0f 0xc0f 0xc0f 0x4c3e 0x9884 0xc3a 0xbfc 0xbfc 0xbfc 0x4e04 0x982f 0xc29 0xbeb 0xbeb 0xbeb 0x4fca 0x97d8 0xc1c 0xbde 0xbde 0xbde 0x5190 0x978c 0xc16 0xbd8 0xbd8 0xbd8 0x5356 0x9742 0xc15 0xbd7 0xbd7 0xbd7 0x551c 0x9702 0xc26 0xbe8 0xbe8 0xbe8 0x56e1 0x96bd 0xc1f 0xbe1 0xbe1 0xbe1 0x58a7 0x9683 0xc1c 0xbde 0xbde 0xbde 0x5a6d 0x9645 0xc2d 0xbee 0xbee 0xbee 0x5c33 0x9612 0xc40 0xc01 0xc01 0xc01 0x5df9 0x95dc 0xc51 0xc12 0xc12 0xc12 0x5fbf 0x95aa 0xc62 0xc23 0xc23 0xc23 0x6185 0x9579 0xc6a 0xc2a 0xc2a 0xc2a 0x634b 0x954d 0xc8f 0xc4f 0xc4f 0xc4f 0x6511 0x9521 0xc97 0xc56 0xc56 0xc56 0x66d7 0x94f7 0xcb7 0xc76 0xc76 0xc76 0x689d 0x94ce 0xcbe 0xc7d 0xc7d 0xc7d 0x6a62 0x94ab 0xcdd 0xc9b 0xc9b 0xc9b 0x6c28 0x9488 0xcf5 0xcb3 0xcb3 0xcb3 0x6dee 0x9464 0xd04 0xcc2 0xcc2 0xcc2 0x6fb4 0x9446 0xd29 0xce6 0xce6 0xce6 0x717a 0x9429 0xd42 0xcfe 0xcfe 0xcfe 0x7340 0x940e 0xd57 0xd12 0xd12 0xd12 0x7506 0x93fc 0xd84 0xd3f 0xd3f 0xd3f 0x76cc 0x93df 0xda0 0xd5a 0xd5a 0xd5a 0x7892 0x93d1 0xdd5 0xd8e 0xd8e 0xd8e 0x7a58 0x93bf 0xe01 0xdb9 0xdb9 0xdb9 0x7c1d 0x93ae 0xe3a 0xdf1 0xdf1 0xdf1 0x7de3 0x939b 0xe73 0xe29 0xe29 0xe29 0x7fa9 0x9385 0xeb8 0xe6d 0xe6d 0xe6d 0x816f 0x9369 0xee0 0xe93 0xe93 0xe93 0x8335 0x934c 0xf22 0xed5 0xed5 0xed5 0x84fb 0x9328 0xf66 0xf17 0xf17 0xf17 0x86c1 0x9305 0xfc7 0xf76 0xf76 0xf76 0x8887 0x92d8 0x1025 0xfd2 0xfd2 0xfd2 0x8a4d 0x92a2 0x108a 0x1036 0x1036 0x1036 0x8c13 0x9269 0x1103 0x10ac 0x10ac 0x10ac 0x8dd9 0x922f 0x1193 0x1139 0x1139 0x1139 0x8f9e 0x91e8 0x1239 0x11dc 0x11dc 0x11dc 0x9164 0x919f 0x12f6 0x1295 0x1295 0x1295 0x932a 0x9155 0x13d2 0x136c 0x136c 0x136c 0x94f0 0x910a 0x14ef 0x1484 0x1484 0x1484 0x96b6 0x90b7 0x1627 0x15b5 0x15b5 0x15b5 0x987c 0x906e 0x1793 0x171b 0x171b 0x171b 0x9a42 0x9037 0x198f 0x190c 0x190c 0x190c 0x9c08 0x900b 0x1c43 0x1bb3 0x1bb3 0x1bb3 0x9dce 0x8fd2 0x1fe5 0x1f42 0x1f42 0x1f42 0x9f94 0x8f82 0x2566 0x24a7 0x24a7 0x24a7 0xa15a 0x8f09 0x2e82 0x2d93 0x2d93 0x2d93 0xa31f 0x8e3b 0x398f 0x3868 0x3868 0x3868 0xa4e5 0x8c67 0x40f4 0x3fa8 0x3fa8 0x3fa8 0xa6ab 0x859c 0x41a1 0x4051 0x4051 0x4051 0xa871 0x7c02 0x2be8 0x2b07 0x2b07 0x2b07 0xaa37 0x7c02 0x2be8 0x2b07 0x2b07 0x2b07 0xabfd 0x7c02 0x2be8 0x2b07 0x2b07 0x2b07 0xadc3 0x7c02 0x2be8 0x2b07 0x2b07 0x2b07 0xaf89 0x7c02 0x2be8 0x2b07 0x2b07 0x2b07>;
			g_PMIC_MIN_VOL_row = <0x04>;
			g_PMIC_MIN_VOL_col = <0x0a>;
			g_PMIC_MIN_VOL = <0x82dc 0x82dc 0x82dc 0x82dc 0x82dc 0x82dc 0x82dc 0x82dc 0x82dc 0x82dc 0x82dc 0x82dc 0x7dc8 0x7dc8 0x7dc8 0x7dc8 0x7918 0x7918 0x7918 0x7918 0x7918 0x7918 0x7918 0x7918 0x7918 0x7918 0x7918 0x7918 0x7918 0x7918 0x7918 0x7918 0x7918 0x7918 0x7918 0x7918 0x7918 0x7918 0x7918 0x79e0>;
			g_PON_SYS_IBOOT_row = <0x04>;
			g_PON_SYS_IBOOT_col = <0x0a>;
			g_PON_SYS_IBOOT = <0x1388 0x1388 0x1388 0x1388 0x1388 0x1388 0x1388 0x1388 0x1388 0x1388 0x1388 0x1388 0x1388 0x1388 0x1388 0x1388 0x1388 0x1388 0x1388 0x1388 0x1388 0x1388 0x1388 0x1388 0x1388 0x1388 0x1388 0x1388 0x1388 0x1388 0x1388 0x1388 0x1388 0x1388 0x1388 0x1388 0x1388 0x1388 0x1388 0x1388>;
			g_QMAX_SYS_VOL_row = <0x04>;
			g_QMAX_SYS_VOL_col = <0x0a>;
			g_QMAX_SYS_VOL = <0x82dc 0x8340 0x82dc 0x82dc 0x82dc 0x8340 0x82dc 0x82dc 0x82dc 0x82dc 0x82dc 0x82dc 0x814c 0x814c 0x8084 0x8084 0x80e8 0x80e8 0x8020 0x8020 0x8020 0x8020 0x8020 0x8020 0x8020 0x8020 0x8020 0x8020 0x8020 0x8020 0x8020 0x8020 0x8020 0x8020 0x8020 0x8020 0x8020 0x8020 0x8020 0x8020>;
			g_FG_PSEUDO100_row = <0x04>;
			g_FG_PSEUDO100_col = <0x0a>;
			g_FG_PSEUDO100 = <0x64 0x64 0x64 0x64 0x63 0x63 0x63 0x63 0x61 0x61 0x61 0x61 0x5f 0x5f 0x5f 0x5f 0x5d 0x5d 0x5d 0x5d 0x64 0x64 0x64 0x64 0x64 0x64 0x64 0x64 0x64 0x64 0x64 0x64 0x64 0x64 0x64 0x64 0x64 0x64 0x64 0x64>;
			g_FG_charge_PSEUDO100_row = <0x04>;
			g_FG_charge_PSEUDO100_col = <0x0a>;
			g_FG_charge_PSEUDO100 = <0x62 0x62 0x62 0x62 0x61 0x61 0x61 0x61 0x61 0x61 0x61 0x61 0x5e 0x5e 0x5e 0x5e 0x5e 0x5e 0x5e 0x5e 0x64 0x64 0x64 0x64 0x64 0x64 0x64 0x64 0x64 0x64 0x64 0x64 0x64 0x64 0x64 0x64 0x64 0x64 0x64 0x64>;
		};
	};

	fragment@68 {
		target = <0xffffffff>;

		__overlay__ {
			status = "okay";
			clock-frequency = <0x61a80>;

			sc8547-charger@6F {
				status = "okay";
				compatible = "sc,sc8547-master";
				reg = <0x6f>;
				qcom,irq_gpio = <0xffffffff 0x0a 0x00>;
				interrupt-parent = <0xffffffff>;
				interrupts = <0x0a 0x00>;
				pinctrl-names = "switch1_act_switch2_act\0switch1_sleep_switch2_sleep\0charging_inter_active\0charging_inter_sleep";
				pinctrl-0 = <0x2e>;
				pinctrl-1 = <0x2f>;
				pinctrl-2 = <0x30>;
				pinctrl-3 = <0x31>;
				qcom,charging_switch1-gpio = <0xffffffff 0x18 0x00>;
				qcom,voocphy_current_default = <0x1e>;
				qcom,svooc_cool_down_current_limit = <0x64 0x14 0x14 0x14 0x1e 0x28 0x32 0x3c 0x46 0x50 0x5a 0x64>;
				qcom,vooc_cool_down_current_limit = <0x3c 0x14 0x14 0x14 0x1e 0x28 0x32 0x3c>;
				qcom,vooc_little_cold_full_voltage = <0x114e>;
				qcom,vooc_cool_full_voltage = <0x114e>;
				qcom,vooc_1time_full_voltage = <0x1180>;
				qcom,vooc_ntime_full_voltage = <0x1180>;
				qcom,low_curr_full_t1 = <0x78>;
				qcom,low_curr_full_t2 = <0x15e>;
				qcom,low_curr_full_t3 = <0x1ae>;
				qcom,range1_low_curr_full = <0x44c 0x1180 0x3e8 0x117b 0x384 0x1176 0x320 0x116c 0x2bc 0x1162>;
				qcom,range2_low_curr_full = <0x4b0 0x1180 0x44c 0x117b 0x3e8 0x1176 0x384 0x116c 0x320 0x1162>;
				qcom,vooc_multistep_initial_batt_temp = <0x3e8>;
				qcom,vooc_little_cool_temp = <0xa0>;
				qcom,vooc_cool_temp = <0x78>;
				qcom,vooc_little_cold_temp = <0x32>;
				qcom,vooc_normal_low_temp = <0xfa>;
				qcom,vooc_strategy_normal_current = <0x64>;
				qcom,vooc_normal_to_little_cool_current = <0x64>;
				qcom,vooc_batt_over_high_temp = <0x1b8>;
				qcom,vooc_batt_over_low_temp = <0x00>;
				qcom,vooc_strategy1_batt_high_temp0 = <0x181>;
				qcom,vooc_strategy1_batt_high_temp1 = <0x18b>;
				qcom,vooc_strategy1_batt_high_temp2 = <0x1a4>;
				qcom,vooc_strategy1_batt_low_temp2 = <0x19a>;
				qcom,vooc_strategy1_batt_low_temp1 = <0x181>;
				qcom,vooc_strategy1_batt_low_temp0 = <0x177>;
				qcom,vooc_strategy1_high_current0 = <0x1e>;
				qcom,vooc_strategy1_high_current1 = <0x1e>;
				qcom,vooc_strategy1_high_current2 = <0x14>;
				qcom,vooc_strategy1_low_current2 = <0x14>;
				qcom,vooc_strategy1_low_current1 = <0x1e>;
				qcom,vooc_strategy1_low_current0 = <0x1e>;
				qcom,voocphy_ibat_over_current = <0x2cec>;
				qcom,voocphy_cp_max_ibus = <0xdac>;
				qcom,voocphy_freq_mincore = <0xef420>;
				qcom,voocphy_freq_midcore = <0x13d620>;
				qcom,voocphy_freq_maxcore = <0x13d620>;
				qcom,voocphy_current_change_timeout = <0x64>;
				svooc_batt_sys_curve = <0x00 0x00 0x01 0x01 0x01 0x01 0x00 0x00 0x00 0x00 0x00 0x00 0x00 0x01 0x00 0x00 0x01 0x00 0x01 0x00 0x00 0x01 0x01 0x01 0x00 0x00 0x01 0x00 0x00 0x00 0x00 0x01 0x00 0x01 0x00 0x01 0x01 0x01 0x00 0x00 0x01 0x00>;
				vooc_batt_sys_curve = <0x00 0x00 0x01 0x01 0x01 0x01 0x00 0x00 0x00 0x00 0x00 0x00 0x00 0x01 0x00 0x00 0x01 0x00 0x01 0x00 0x00 0x01 0x01 0x01 0x00 0x00 0x01 0x00 0x00 0x00 0x00 0x01 0x00 0x01 0x00 0x01 0x01 0x01 0x00 0x00 0x01 0x00>;

				svooc_charge_strategy {

					strategy_soc_0_to_50 {
						strategy_temp_little_cold = <0x1054 0x0e 0x00 0x00 0x00 0x114e 0x0a 0x01 0x00 0x00>;
						strategy_temp_cool = <0x1054 0x14 0x00 0x00 0x00 0x1144 0x0e 0x00 0x00 0x00 0x114e 0x0a 0x01 0x00 0x00>;
						strategy_temp_little_cool = <0x1162 0x19 0x00 0x00 0x00 0x1162 0x14 0x00 0x00 0x00 0x1176 0x0f 0x00 0x00 0x00 0x1180 0x0a 0x01 0x00 0x00>;
						strategy_temp_normal_low = <0x1068 0x1e 0x00 0x348 0x00 0x1162 0x19 0x00 0x618 0x00 0x1162 0x17 0x00 0x00 0x00 0x1162 0x14 0x00 0x00 0x00 0x1176 0x0f 0x00 0x00 0x00 0x1180 0x0a 0x01 0x00 0x00>;
						strategy_temp_normal_high = <0x1068 0x1e 0x00 0x348 0x00 0x1162 0x19 0x00 0x618 0x00 0x1162 0x17 0x00 0x00 0x00 0x1162 0x14 0x00 0x00 0x00 0x1176 0x0f 0x00 0x00 0x00 0x1180 0x0a 0x01 0x00 0x00>;
					};

					strategy_soc_50_to_75 {
						strategy_temp_little_cold = <0x1054 0x0e 0x00 0x00 0x00 0x114e 0x0a 0x01 0x00 0x00>;
						strategy_temp_cool = <0x1054 0x14 0x00 0x00 0x00 0x1144 0x0e 0x00 0x00 0x00 0x114e 0x0a 0x01 0x00 0x00>;
						strategy_temp_little_cool = <0x1162 0x19 0x00 0x00 0x00 0x1162 0x14 0x00 0x00 0x00 0x1176 0x0f 0x00 0x00 0x00 0x1180 0x0a 0x01 0x00 0x00>;
						strategy_temp_normal_low = <0x1162 0x19 0x00 0x618 0x00 0x1162 0x17 0x00 0x00 0x00 0x1162 0x14 0x00 0x00 0x00 0x1176 0x0f 0x00 0x00 0x00 0x1180 0x0a 0x01 0x00 0x00>;
						strategy_temp_normal_high = <0x1162 0x19 0x00 0x618 0x00 0x1162 0x17 0x00 0x00 0x00 0x1162 0x14 0x00 0x00 0x00 0x1176 0x0f 0x00 0x00 0x00 0x1180 0x0a 0x01 0x00 0x00>;
					};

					strategy_soc_75_to_85 {
						strategy_temp_little_cold = <0x114e 0x0a 0x01 0x00 0x00>;
						strategy_temp_cool = <0x114e 0x0a 0x01 0x00 0x00>;
						strategy_temp_little_cool = <0x1180 0x0a 0x01 0x00 0x00>;
						strategy_temp_normal_low = <0x1176 0x0f 0x00 0x00 0x00 0x1180 0x0a 0x01 0x00 0x00>;
						strategy_temp_normal_high = <0x1176 0x0f 0x00 0x00 0x00 0x1180 0x0a 0x01 0x00 0x00>;
					};

					strategy_soc_85_to_90 {
						strategy_temp_little_cold = <0x114e 0x0a 0x01 0x00 0x00>;
						strategy_temp_cool = <0x114e 0x0a 0x01 0x00 0x00>;
						strategy_temp_little_cool = <0x1180 0x0a 0x01 0x00 0x00>;
						strategy_temp_normal_low = <0x1180 0x0a 0x01 0x00 0x00>;
						strategy_temp_normal_high = <0x1180 0x0a 0x01 0x00 0x00>;
					};
				};

				vooc_charge_strategy {

					strategy_soc_0_to_50 {
						strategy_temp_little_cold = <0x114e 0x14 0x01 0x00 0x00>;
						strategy_temp_cool = <0x1144 0x1e 0x00 0x00 0x00 0x114e 0x14 0x01 0x00 0x00>;
						strategy_temp_little_cool = <0x117b 0x1e 0x00 0x00 0x00 0x1180 0x14 0x01 0x00 0x00>;
						strategy_temp_normal_low = <0x117b 0x1e 0x00 0x00 0x00 0x1180 0x14 0x01 0x00 0x00>;
						strategy_temp_normal_high = <0x117b 0x1e 0x00 0x00 0x00 0x1180 0x14 0x01 0x00 0x00>;
					};

					strategy_soc_50_to_75 {
						strategy_temp_little_cold = <0x114e 0x14 0x01 0x00 0x00>;
						strategy_temp_cool = <0x1144 0x1e 0x00 0x00 0x00 0x114e 0x14 0x01 0x00 0x00>;
						strategy_temp_little_cool = <0x117b 0x1e 0x00 0x00 0x00 0x1180 0x14 0x01 0x00 0x00>;
						strategy_temp_normal_low = <0x117b 0x1e 0x00 0x00 0x00 0x1180 0x14 0x01 0x00 0x00>;
						strategy_temp_normal_high = <0x117b 0x1e 0x00 0x00 0x00 0x1180 0x14 0x01 0x00 0x00>;
					};

					strategy_soc_75_to_85 {
						strategy_temp_little_cold = <0x114e 0x14 0x01 0x00 0x00>;
						strategy_temp_cool = <0x114e 0x14 0x01 0x00 0x00>;
						strategy_temp_little_cool = <0x1180 0x14 0x01 0x00 0x00>;
						strategy_temp_normal_low = <0x117b 0x1e 0x00 0x00 0x00 0x1180 0x14 0x01 0x00 0x00>;
						strategy_temp_normal_high = <0x117b 0x1e 0x00 0x00 0x00 0x1180 0x14 0x01 0x00 0x00>;
					};

					strategy_soc_85_to_90 {
						strategy_temp_little_cold = <0x114e 0x14 0x01 0x00 0x00>;
						strategy_temp_cool = <0x114e 0x14 0x01 0x00 0x00>;
						strategy_temp_little_cool = <0x1180 0x14 0x01 0x00 0x00>;
						strategy_temp_normal_low = <0x1180 0x14 0x01 0x00 0x00>;
						strategy_temp_normal_high = <0x1180 0x14 0x01 0x00 0x00>;
					};
				};
			};

			tfa98xx-vib {
				status = "disabled";
				compatible = "tfa98xx,vib";
			};
		};
	};

	fragment@69 {
		target = <0xffffffff>;

		__overlay__ {

			charging_inter_active {
				phandle = <0x30>;

				pins_cmd_dat {
					pinmux = <0xa00>;
					input-enable;
					slew-rate = <0x00>;
					bias-disable;
				};
			};

			charging_inter_sleep {
				phandle = <0x31>;

				pins_cmd_dat {
					pinmux = <0xa00>;
					input-enable;
					slew-rate = <0x00>;
					bias-disable;
				};
			};

			charging_switch1_active {
				phandle = <0x2e>;

				pins_cmd_dat {
					pinmux = <0x1800>;
					slew-rate = <0x01>;
					output-high;
				};
			};

			charging_switch1_sleep {
				phandle = <0x2f>;

				pins_cmd_dat {
					pinmux = <0x1800>;
					slew-rate = <0x01>;
					output-low;
				};
			};
		};
	};

	fragment@70 {
		target = <0xffffffff>;

		__overlay__ {
			pinctrl-names = "uart0_rx_gpio\0uart0_tx_gpio";
			pinctrl-0 = <0x32>;
			pinctrl-1 = <0x33>;
			status = "okay";
		};
	};

	fragment@71 {
		target = <0xffffffff>;

		__overlay__ {
			status = "disabled";
		};
	};

	fragment@72 {
		target = <0xffffffff>;

		__overlay__ {

			uart0_rx_gpio {
				phandle = <0x32>;

				pins_cmd_dat {
					pinmux = <0xb300>;
					input-enable;
					slew-rate = <0x00>;
					bias-disable;
				};
			};

			uart0_tx_gpio {
				phandle = <0x33>;

				pins_cmd_dat {
					pinmux = <0xb200>;
					input-enable;
					slew-rate = <0x00>;
					bias-disable;
				};
			};
		};
	};

	fragment@73 {
		target = <0xffffffff>;

		__overlay__ {
			regulator-always-on;
		};
	};

	fragment@74 {
		target = <0xffffffff>;

		__overlay__ {
			status = "disabled";
		};
	};

	fragment@75 {
		target = <0xffffffff>;

		__overlay__ {
			status = "disabled";
		};
	};

	fragment@76 {
		target = <0xffffffff>;

		__overlay__ {
			status = "disabled";
		};
	};

	fragment@77 {
		target = <0xffffffff>;

		__overlay__ {

			usbphy_tuning {
				compatible = "mediatek,phy_tuning";
				u2_vrt_ref = <0x05>;
				u2_term_ref = <0x07>;
				u2_enhance = <0x03>;
				host_u2_vrt_ref = <0x05>;
				host_u2_term_ref = <0x07>;
				host_u2_enhance = <0x03>;
				phandle = <0x90>;
			};
		};
	};

	fragment@78 {
		target = <0xffffffff>;

		__overlay__ {
			boost_period = <0x1e>;
		};
	};

	fragment@79 {
		target = <0xffffffff>;

		__overlay__ {
			status = "disabled";
		};
	};

	fragment@80 {
		target = <0xffffffff>;

		__overlay__ {
			clock-frequency = <0x61a80>;
			pinctrl-names = "default\0ts_int_active\0ts_reset_active\0ts_int_suspend\0ts_reset_suspend\0ts_i2c_mode";
			pinctrl-0 = <0x34>;
			pinctrl-1 = <0x35>;
			pinctrl-2 = <0x36>;
			pinctrl-3 = <0x37>;
			pinctrl-4 = <0x38>;
			pinctrl-5 = <0x39>;

			gt9886@5d {
				compatible = "goodix,gt9886";
				reg = <0x5d>;
				status = "ok";
				interrupt-parent = <0xffffffff>;
				interrupts = <0x0e 0x02 0x0e 0x00>;
				vtouch-supply = <0xffffffff>;
				goodix,irq-gpio = <0xffffffff 0x0e 0x00>;
				goodix,reset-gpio = <0xffffffff 0x0f 0x00>;
				goodix,irq-flags = <0x02>;
				goodix,panel-max-id = <0x0a>;
				goodix,panel-max-x = <0x438>;
				goodix,panel-max-y = <0x8e8>;
				goodix,panel-max-w = <0x100>;
				goodix,panel-max-p = <0x100>;
				goodix,input-max-x = <0x438>;
				goodix,input-max-y = <0x8e8>;
				goodix,panel-key-map = <0x9e 0xac 0xd9>;
				goodix,power-on-delay-us = <0x2710>;
				goodix,power-off-delay-us = <0x1388>;
				goodix,firmware-version = "6877v01";
				goodix,config-version = "6877v01";
				goodix,pen-enable;
				goodix,key-of-pen = <0x14b 0x14c>;
				tpd-filter-enable = <0x00>;
				tpd-filter-pixel-density = <0xa1>;
				tpd-filter-custom-prameters = <0x00 0x00 0x00 0x00 0x00 0x00 0x00 0x00 0x00 0x00 0x00 0x00>;
				tpd-filter-custom-speed = <0x00 0x00 0x00>;
			};
		};
	};

	fragment@81 {
		target = <0xffffffff>;

		__overlay__ {
			status = "okay";
			#address-cells = <0x01>;
			#size-cells = <0x00>;
			pinctrl-names = "default\0gt9896s_int_active\0gt9896s_reset_active\0gt9896s_int_suspend\0gt9896s_reset_suspend\0gt9896s_spi_mode";
			pinctrl-0 = <0x3a>;
			pinctrl-1 = <0x3b>;
			pinctrl-2 = <0x3c>;
			pinctrl-3 = <0x3d>;
			pinctrl-4 = <0x3e>;
			pinctrl-5 = <0x3f>;

			gt9896s@0 {
				compatible = "goodix,gt9896s";
				reg = <0x00>;
				spi-max-frequency = <0xf4240>;
				goodix,avdd-name = "vtouch";
				vtouch-supply = <0xffffffff>;
				goodix,irq-gpio = <0xffffffff 0x0e 0x00>;
				goodix,reset-gpio = <0xffffffff 0x0f 0x00>;
				goodix,irq-flags = <0x02>;
				goodix,panel-max-id = <0x0a>;
				goodix,panel-max-x = <0x438>;
				goodix,panel-max-y = <0x8fc>;
				goodix,panel-max-w = <0x100>;
				goodix,panel-max-p = <0x100>;
				goodix,input-max-x = <0x438>;
				goodix,input-max-y = <0x8fc>;
				goodix,panel-key-map = <0x9e 0xac 0xd9>;
				goodix,power-on-delay-us = <0x2710>;
				goodix,power-off-delay-us = <0x1388>;
				goodix,firmware-version = "6877v01";
				goodix,config-version = "6877v01";
				goodix,pen-enable;
				tpd-filter-enable = <0x00>;
				tpd-filter-pixel-density = <0xa1>;
				tpd-filter-custom-prameters = <0x00 0x00 0x00 0x00 0x00 0x00 0x00 0x00 0x00 0x00 0x00 0x00>;
				tpd-filter-custom-speed = <0x00 0x00 0x00>;
			};
		};
	};

	fragment@82 {
		target = <0xffffffff>;

		__overlay__ {

			eintdefault {
				phandle = <0x34>;
			};

			pins_default {
				phandle = <0x3a>;
			};

			int_active {
				phandle = <0x35>;

				pins_cmd_dat {
					pinmux = <0xe00>;
					input-enable;
				};
			};

			reset_active {
				phandle = <0x36>;

				pins_cmd_dat {
					pinmux = <0xf00>;
					output-high;
				};
			};

			int_suspend {
				phandle = <0x37>;

				pins_cmd_dat {
					pinmux = <0xe00>;
					output-low;
				};
			};

			reset_suspend {
				phandle = <0x38>;

				pins_cmd_dat {
					pinmux = <0xf00>;
					output-low;
				};
			};

			i2cmode_default {
				phandle = <0x39>;

				pins_cmd_dat {
					pinmux = <0x4001 0x4101>;
				};
			};

			int_high {
				phandle = <0x91>;

				pins_cmd_dat {
					pinmux = <0xe00>;
					output-high;
				};
			};

			int1_active {
				phandle = <0x3b>;

				pins_cmd_dat {
					pinmux = <0xe00>;
					input-enable;
				};
			};

			reset1_active {
				phandle = <0x3c>;

				pins_cmd_dat {
					pinmux = <0xf00>;
					output-high;
				};
			};

			int1_suspend {
				phandle = <0x3d>;

				pins_cmd_dat {
					pinmux = <0xe00>;
					output-low;
				};
			};

			reset1_suspend {
				phandle = <0x3e>;

				pins_cmd_dat {
					pinmux = <0xf00>;
					output-low;
				};
			};

			spimode_default {
				phandle = <0x3f>;

				pins_cmd_dat {
					pinmux = <0xc02 0xd02 0x4002 0x4102>;
					drive-strength = <0x02>;
				};
			};
		};
	};

	fragment@83 {
		target = <0xffffffff>;

		__overlay__ {

			cam0@0 {
				phandle = <0x41>;

				pins_cmd_dat {
					pinmux = <0x9d00>;
					slew-rate = <0x01>;
					output-low;
				};
			};

			cam0@1 {
				phandle = <0x42>;

				pins_cmd_dat {
					pinmux = <0x9d00>;
					slew-rate = <0x01>;
					output-high;
				};
			};

			cam1@0 {
				phandle = <0x43>;

				pins_cmd_dat {
					pinmux = <0x9b00>;
					slew-rate = <0x01>;
					output-low;
				};
			};

			cam1@1 {
				phandle = <0x44>;

				pins_cmd_dat {
					pinmux = <0x9b00>;
					slew-rate = <0x01>;
					output-high;
				};
			};

			cam2@0 {
				phandle = <0x45>;

				pins_cmd_dat {
					pinmux = <0x9f00>;
					slew-rate = <0x01>;
					output-low;
				};
			};

			cam2@1 {
				phandle = <0x46>;

				pins_cmd_dat {
					pinmux = <0x9f00>;
					slew-rate = <0x01>;
					output-high;
				};
			};

			cam3@0 {
				phandle = <0x47>;

				pins_cmd_dat {
					pinmux = <0xa100>;
					slew-rate = <0x01>;
					output-low;
				};
			};

			cam3@1 {
				phandle = <0x48>;

				pins_cmd_dat {
					pinmux = <0xa100>;
					slew-rate = <0x01>;
					output-high;
				};
			};

			cam0@vcam0 {
				phandle = <0x49>;

				pins_cmd_dat {
					pinmux = <0x9a00>;
					slew-rate = <0x01>;
					output-low;
				};
			};

			cam0@vcam1 {
				phandle = <0x4a>;

				pins_cmd_dat {
					pinmux = <0x9a00>;
					slew-rate = <0x01>;
					output-high;
				};
			};

			camera_pins_cam0_mclk_off {
				phandle = <0x4b>;

				pins_cmd_dat {
					pinmux = <0x9600>;
					drive-strength = <0x01>;
				};
			};

			camera_pins_cam0_mclk_2ma {
				phandle = <0x4c>;

				pins_cmd_dat {
					pinmux = <0x9601>;
					drive-strength = <0x00>;
				};
			};

			camera_pins_cam0_mclk_4ma {
				phandle = <0x4d>;

				pins_cmd_dat {
					pinmux = <0x9601>;
					drive-strength = <0x01>;
				};
			};

			camera_pins_cam0_mclk_6ma {
				phandle = <0x4e>;

				pins_cmd_dat {
					pinmux = <0x9601>;
					drive-strength = <0x02>;
				};
			};

			camera_pins_cam0_mclk_8ma {
				phandle = <0x4f>;

				pins_cmd_dat {
					pinmux = <0x9601>;
					drive-strength = <0x03>;
				};
			};

			camera_pins_cam1_mclk_off {
				phandle = <0x50>;

				pins_cmd_dat {
					pinmux = <0x9900>;
					drive-strength = <0x01>;
				};
			};

			camera_pins_cam1_mclk_2ma {
				phandle = <0x51>;

				pins_cmd_dat {
					pinmux = <0x9901>;
					drive-strength = <0x00>;
				};
			};

			camera_pins_cam1_mclk_4ma {
				phandle = <0x52>;

				pins_cmd_dat {
					pinmux = <0x9901>;
					drive-strength = <0x01>;
				};
			};

			camera_pins_cam1_mclk_6ma {
				phandle = <0x53>;

				pins_cmd_dat {
					pinmux = <0x9901>;
					drive-strength = <0x02>;
				};
			};

			camera_pins_cam1_mclk_8ma {
				phandle = <0x54>;

				pins_cmd_dat {
					pinmux = <0x9901>;
					drive-strength = <0x03>;
				};
			};

			camera_pins_cam2_mclk_off {
				phandle = <0x55>;

				pins_cmd_dat {
					pinmux = <0x9500>;
					drive-strength = <0x01>;
				};
			};

			camera_pins_cam2_mclk_2ma {
				phandle = <0x56>;

				pins_cmd_dat {
					pinmux = <0x9501>;
					drive-strength = <0x00>;
				};
			};

			camera_pins_cam2_mclk_4ma {
				phandle = <0x57>;

				pins_cmd_dat {
					pinmux = <0x9501>;
					drive-strength = <0x01>;
				};
			};

			camera_pins_cam2_mclk_6ma {
				phandle = <0x58>;

				pins_cmd_dat {
					pinmux = <0x9501>;
					drive-strength = <0x02>;
				};
			};

			camera_pins_cam2_mclk_8ma {
				phandle = <0x59>;

				pins_cmd_dat {
					pinmux = <0x9501>;
					drive-strength = <0x03>;
				};
			};

			camera_pins_cam3_mclk_off {
				phandle = <0x5a>;

				pins_cmd_dat {
					pinmux = <0x9700>;
					drive-strength = <0x01>;
				};
			};

			camera_pins_cam3_mclk_2ma {
				phandle = <0x5b>;

				pins_cmd_dat {
					pinmux = <0x9701>;
					drive-strength = <0x00>;
				};
			};

			camera_pins_cam3_mclk_4ma {
				phandle = <0x5c>;

				pins_cmd_dat {
					pinmux = <0x9701>;
					drive-strength = <0x01>;
				};
			};

			camera_pins_cam3_mclk_6ma {
				phandle = <0x5d>;

				pins_cmd_dat {
					pinmux = <0x9701>;
					drive-strength = <0x02>;
				};
			};

			camera_pins_cam3_mclk_8ma {
				phandle = <0x5e>;

				pins_cmd_dat {
					pinmux = <0x9701>;
					drive-strength = <0x03>;
				};
			};

			camdefault {
				phandle = <0x40>;
			};
		};
	};

	fragment@84 {
		target = <0xffffffff>;

		__overlay__ {
			pinctrl-names = "default\0cam0_rst0\0cam0_rst1\0cam1_rst0\0cam1_rst1\0cam2_rst0\0cam2_rst1\0cam3_rst0\0cam3_rst1\0cam0_ldo_vcama1_0\0cam0_ldo_vcama1_1\0cam0_mclk_off\0cam0_mclk_2mA\0cam0_mclk_4mA\0cam0_mclk_6mA\0cam0_mclk_8mA\0cam1_mclk_off\0cam1_mclk_2mA\0cam1_mclk_4mA\0cam1_mclk_6mA\0cam1_mclk_8mA\0cam2_mclk_off\0cam2_mclk_2mA\0cam2_mclk_4mA\0cam2_mclk_6mA\0cam2_mclk_8mA\0cam3_mclk_off\0cam3_mclk_2mA\0cam3_mclk_4mA\0cam3_mclk_6mA\0cam3_mclk_8mA";
			pinctrl-0 = <0x40>;
			pinctrl-1 = <0x41>;
			pinctrl-2 = <0x42>;
			pinctrl-3 = <0x43>;
			pinctrl-4 = <0x44>;
			pinctrl-5 = <0x45>;
			pinctrl-6 = <0x46>;
			pinctrl-7 = <0x47>;
			pinctrl-8 = <0x48>;
			pinctrl-9 = <0x49>;
			pinctrl-10 = <0x4a>;
			pinctrl-11 = <0x4b>;
			pinctrl-12 = <0x4c>;
			pinctrl-13 = <0x4d>;
			pinctrl-14 = <0x4e>;
			pinctrl-15 = <0x4f>;
			pinctrl-16 = <0x50>;
			pinctrl-17 = <0x51>;
			pinctrl-18 = <0x52>;
			pinctrl-19 = <0x53>;
			pinctrl-20 = <0x54>;
			pinctrl-21 = <0x55>;
			pinctrl-22 = <0x56>;
			pinctrl-23 = <0x57>;
			pinctrl-24 = <0x58>;
			pinctrl-25 = <0x59>;
			pinctrl-26 = <0x5a>;
			pinctrl-27 = <0x5b>;
			pinctrl-28 = <0x5c>;
			pinctrl-29 = <0x5d>;
			pinctrl-30 = <0x5e>;
			cam0_vcamio-supply = <0xffffffff>;
			cam1_vcamio-supply = <0xffffffff>;
			cam2_vcamio-supply = <0xffffffff>;
			cam3_vcamio-supply = <0xffffffff>;
			cam0_enable_sensor = "imx581_mipi_raw";
			cam1_enable_sensor = "imx471_mipi_raw";
			cam2_enable_sensor = "gc02m1b_mipi_mono";
			cam3_enable_sensor = "gc02m1_mipi_raw";
			status = "okay";
		};
	};

	fragment@85 {
		target = <0xffffffff>;

		__overlay__ {

			camera_eeprom0@50 {
				compatible = "mediatek,camera_eeprom";
				reg = <0x50>;
				status = "okay";
				phandle = <0x92>;
			};
		};
	};

	fragment@86 {
		target = <0xffffffff>;

		__overlay__ {

			camera_eeprom3@52 {
				compatible = "mediatek,camera_eeprom";
				reg = <0x52>;
				status = "okay";
				phandle = <0x93>;
			};

			camera_eeprom1@54 {
				compatible = "mediatek,camera_eeprom";
				reg = <0x54>;
				status = "okay";
				phandle = <0x94>;
			};
		};
	};

	fragment@87 {
		target = <0xffffffff>;

		__overlay__ {

			fan53870@35 {
				compatible = "fan53870";
				reg = <0x35>;
				ldo1_min_vol = "\0\f5";
				ldo1_max_vol = <0x16f300>;
				ldo1_step_vol = <0x1f40>;
				en-gpios = <0xffffffff 0x6d 0x01>;
			};

			wl2868c@2f {
				compatible = "wl2868c-i2c";
				vs2-supply = <0xffffffff>;
				reg = <0x2f>;
				id_reg = <0x00>;
				id_val = <0x82>;
				vin1_vol = "\0\f5";
				vin2_vol = <0x16f300>;
				en-gpios = <0xffffffff 0x6d 0x01>;
			};
		};
	};

	__symbols__ {
		irtx_gpio_led_default = "/fragment@2/__overlay__/irtx_gpio_led_def@gpio139";
		irtx_gpio_led_set = "/fragment@2/__overlay__/irtx_gpio_led_set@gpio139";
		ctp_pins_default_t = "/fragment@7/__overlay__/eintdefault";
		ctp_ts_int_active_t = "/fragment@7/__overlay__/int_active";
		ctp_ts_reset_active_t = "/fragment@7/__overlay__/reset_active";
		ctp_ts_int_suspend_t = "/fragment@7/__overlay__/int_suspend";
		ctp_ts_reset_suspend_t = "/fragment@7/__overlay__/reset_suspend";
		mtkfb_pins_lcm_led_en1 = "/fragment@8/__overlay__/lcm_led_en1_gpio";
		mtkfb_pins_lcm_led_en0 = "/fragment@8/__overlay__/lcm_led_en0_gpio";
		mtkfb_pins_lcd_bias_enp1 = "/fragment@8/__overlay__/lcd_bias_enp1_gpio";
		mtkfb_pins_lcd_bias_enp0 = "/fragment@8/__overlay__/lcd_bias_enp0_gpio";
		mtkfb_pins_lcd_bias_enn1 = "/fragment@8/__overlay__/lcd_bias_enn1_gpio";
		mtkfb_pins_lcd_bias_enn0 = "/fragment@8/__overlay__/lcd_bias_enn0_gpio";
		mtkfb_pins_lcm_rst_out1_gpio = "/fragment@8/__overlay__/lcm_rst_out1_gpio";
		mtkfb_pins_lcm_rst_out0_gpio = "/fragment@8/__overlay__/lcm_rst_out0_gpio";
		mtkfb_pins_lcm_dsi_te = "/fragment@8/__overlay__/lcm_dsi_te";
		panel_in3 = "/fragment@11/__overlay__/panel3@0/port/endpoint";
		dsi_out = "/fragment@11/__overlay__/ports/port/endpoint";
		led0 = "/fragment@13/__overlay__/led@0";
		led1 = "/fragment@13/__overlay__/led@1";
		led2 = "/fragment@13/__overlay__/led@2";
		led3 = "/fragment@13/__overlay__/led@3";
		led4 = "/fragment@13/__overlay__/led@4";
		led5 = "/fragment@13/__overlay__/led@5";
		led6 = "/fragment@13/__overlay__/led@6";
		vibrator0 = "/fragment@13/__overlay__/vibrator@0";
		sensor_fb = "/fragment@13/__overlay__/sensor_fb";
		gsensor_1 = "/fragment@13/__overlay__/gsensor_1";
		gsensor_2 = "/fragment@13/__overlay__/gsensor_2";
		sensor_3 = "/fragment@13/__overlay__/gsensor_3";
		msensor_1 = "/fragment@13/__overlay__/msensor_1";
		msensor_2 = "/fragment@13/__overlay__/msensor_2";
		sar_1 = "/fragment@13/__overlay__/sar_1";
		proximity_1 = "/fragment@13/__overlay__/proximity_1";
		light_1 = "/fragment@13/__overlay__/light_1";
		proximity_2 = "/fragment@13/__overlay__/proximity_2";
		light_2 = "/fragment@13/__overlay__/light_2";
		rear_cct_1 = "/fragment@13/__overlay__/rear_cct_1";
		rear_cct_2 = "/fragment@13/__overlay__/rear_cct_2";
		pick_up = "/fragment@13/__overlay__/pick_up";
		lux_aod = "/fragment@13/__overlay__/lux_aod";
		alsps_arch = "/fragment@13/__overlay__/alsps_arch";
		cali_arch = "/fragment@13/__overlay__/cali_arch";
		oplus_boardid = "/fragment@13/__overlay__/oplus_boardid";
		oplus_project = "/fragment@13/__overlay__/oplus_project";
		oplus_devinfo = "/fragment@13/__overlay__/oplus_devinfo";
		kpd_volume_down = "/fragment@13/__overlay__/kpd_volume_down";
		volume_up_gpio_eint = "/fragment@15/__overlay__/volume_up@0";
		volume_down_gpio_eint = "/fragment@15/__overlay__/volume_down@0";
		hw_pins_default = "/fragment@15/__overlay__/default@hw_sub_id";
		aboard_pin_gpio0_sleep = "/fragment@15/__overlay__/sleep@id0";
		aboard_pin_gpio0_active = "/fragment@15/__overlay__/active@id0";
		aboard_pin_gpio0_idle = "/fragment@15/__overlay__/idle@id0";
		gps_pins_default = "/fragment@16/__overlay__/gps_default";
		gps_l1_lna_pins_ol = "/fragment@16/__overlay__/gps_l1_lna@0";
		gps_l1_lna_pins_dsp_ctrl = "/fragment@16/__overlay__/gps_l1_lna@1";
		gps_l1_lna_pins_oh = "/fragment@16/__overlay__/gps_l1_lna@2";
		gps_l5_lna_pins_ol = "/fragment@16/__overlay__/gps_l5_lna@0";
		gps_l5_lna_pins_dsp_ctrl = "/fragment@16/__overlay__/gps_l5_lna@1";
		gps_l5_lna_pins_oh = "/fragment@16/__overlay__/gps_l5_lna@2";
		ps_enable = "/fragment@21/__overlay__/ps_enable";
		ps_disable = "/fragment@21/__overlay__/ps_disable";
		sel_up = "/fragment@21/__overlay__/sel_up";
		sel_down = "/fragment@21/__overlay__/sel_down";
		gpio_id0_default = "/fragment@23/__overlay__/gpio_id0_default";
		oplus_fp = "/fragment@24/__overlay__/fingerprint@0";
		jiiov_fp_reset_output_low = "/fragment@26/__overlay__/jiiov_fp_reset_output_low";
		jiiov_fp_gpio_clk = "/fragment@26/__overlay__/jiiov_fp_gpio_clk";
		jiiov_fp_gpio_mosi = "/fragment@26/__overlay__/jiiov_fp_gpio_mosi";
		jiiov_fp_gpio_miso = "/fragment@26/__overlay__/jiiov_fp_gpio_miso";
		jiiov_fp_gpio_cs = "/fragment@26/__overlay__/jiiov_fp_gpio_cs";
		jiiov_fp_irq_active = "/fragment@26/__overlay__/jiiov_fp_irq_active";
		tfa98xx = "/fragment@28/__overlay__/tfa98xx@34";
		gate_ic = "/fragment@28/__overlay__/gate_ic@11";
		fsa_hs_det = "/fragment@29/__overlay__/fsa_hs_det";
		fsa4480 = "/fragment@30/__overlay__/fsa4480@42";
		camera_main_mtk = "/fragment@36/__overlay__/camera_main@1a";
		camera_main_af_mtk = "/fragment@36/__overlay__/camera_main_af@0c";
		camera_sub_mtk = "/fragment@38/__overlay__/camera_sub@1a";
		camera_sub_two_mtk = "/fragment@38/__overlay__/camera_sub_two@10";
		subpmic_mtk = "/fragment@39/__overlay__/subpmic@34";
		usb_type_c_mtk = "/fragment@39/__overlay__/usb_type_c@4e";
		subpmic_pmic_mtk = "/fragment@39/__overlay__/subpmic_pmic@1a";
		subpmic_ldo_mtk = "/fragment@39/__overlay__/subpmic_ldo@64";
		i2c_lcd_bias_mtk = "/fragment@40/__overlay__/i2c_lcd_bias@11";
		nfc_mtk = "/fragment@42/__overlay__/nfc@28";
		camera_main_two_mtk = "/fragment@43/__overlay__/camera_main_two@11";
		charger_pins_default = "/fragment@66/__overlay__/eint0default";
		charger_pins_eint_output0 = "/fragment@66/__overlay__/charger_gpio_as_output_low";
		charger_pins_eint_output1 = "/fragment@66/__overlay__/charger_gpio_as_output_high";
		dischg_enable = "/fragment@66/__overlay__/dischg_enable";
		dischg_disable = "/fragment@66/__overlay__/dischg_disable";
		ccdetect_active = "/fragment@66/__overlay__/ccdetect_active";
		ccdetect_sleep = "/fragment@66/__overlay__/ccdetect_sleep";
		charging_inter_active = "/fragment@69/__overlay__/charging_inter_active";
		charging_inter_sleep = "/fragment@69/__overlay__/charging_inter_sleep";
		charging_switch1_active = "/fragment@69/__overlay__/charging_switch1_active";
		charging_switch1_sleep = "/fragment@69/__overlay__/charging_switch1_sleep";
		uart0_rx_gpio_input = "/fragment@72/__overlay__/uart0_rx_gpio";
		uart0_tx_gpio_input = "/fragment@72/__overlay__/uart0_tx_gpio";
		usbphy_tuning = "/fragment@77/__overlay__/usbphy_tuning";
		ctp_pins_default = "/fragment@82/__overlay__/eintdefault";
		ctp_gt9896s_pins_default = "/fragment@82/__overlay__/pins_default";
		ctp_ts_int_active = "/fragment@82/__overlay__/int_active";
		ctp_ts_reset_active = "/fragment@82/__overlay__/reset_active";
		ctp_ts_int_suspend = "/fragment@82/__overlay__/int_suspend";
		ctp_ts_reset_suspend = "/fragment@82/__overlay__/reset_suspend";
		ctp_ts_i2c_mode = "/fragment@82/__overlay__/i2cmode_default";
		ctp_ts_int_as_gpio = "/fragment@82/__overlay__/int_high";
		ctp_gt9896s_int_active = "/fragment@82/__overlay__/int1_active";
		ctp_gt9896s_reset_active = "/fragment@82/__overlay__/reset1_active";
		ctp_gt9896s_int_suspend = "/fragment@82/__overlay__/int1_suspend";
		ctp_gt9896s_reset_suspend = "/fragment@82/__overlay__/reset1_suspend";
		ctp_gt9896s_spi_mode = "/fragment@82/__overlay__/spimode_default";
		camera_pins_cam0_rst_0 = "/fragment@83/__overlay__/cam0@0";
		camera_pins_cam0_rst_1 = "/fragment@83/__overlay__/cam0@1";
		camera_pins_cam1_rst_0 = "/fragment@83/__overlay__/cam1@0";
		camera_pins_cam1_rst_1 = "/fragment@83/__overlay__/cam1@1";
		camera_pins_cam2_rst_0 = "/fragment@83/__overlay__/cam2@0";
		camera_pins_cam2_rst_1 = "/fragment@83/__overlay__/cam2@1";
		camera_pins_cam3_rst_0 = "/fragment@83/__overlay__/cam3@0";
		camera_pins_cam3_rst_1 = "/fragment@83/__overlay__/cam3@1";
		camera_pins_cam0_vcama1_0 = "/fragment@83/__overlay__/cam0@vcam0";
		camera_pins_cam0_vcama1_1 = "/fragment@83/__overlay__/cam0@vcam1";
		camera_pins_cam0_mclk_off = "/fragment@83/__overlay__/camera_pins_cam0_mclk_off";
		camera_pins_cam0_mclk_2ma = "/fragment@83/__overlay__/camera_pins_cam0_mclk_2ma";
		camera_pins_cam0_mclk_4ma = "/fragment@83/__overlay__/camera_pins_cam0_mclk_4ma";
		camera_pins_cam0_mclk_6ma = "/fragment@83/__overlay__/camera_pins_cam0_mclk_6ma";
		camera_pins_cam0_mclk_8ma = "/fragment@83/__overlay__/camera_pins_cam0_mclk_8ma";
		camera_pins_cam1_mclk_off = "/fragment@83/__overlay__/camera_pins_cam1_mclk_off";
		camera_pins_cam1_mclk_2ma = "/fragment@83/__overlay__/camera_pins_cam1_mclk_2ma";
		camera_pins_cam1_mclk_4ma = "/fragment@83/__overlay__/camera_pins_cam1_mclk_4ma";
		camera_pins_cam1_mclk_6ma = "/fragment@83/__overlay__/camera_pins_cam1_mclk_6ma";
		camera_pins_cam1_mclk_8ma = "/fragment@83/__overlay__/camera_pins_cam1_mclk_8ma";
		camera_pins_cam2_mclk_off = "/fragment@83/__overlay__/camera_pins_cam2_mclk_off";
		camera_pins_cam2_mclk_2ma = "/fragment@83/__overlay__/camera_pins_cam2_mclk_2ma";
		camera_pins_cam2_mclk_4ma = "/fragment@83/__overlay__/camera_pins_cam2_mclk_4ma";
		camera_pins_cam2_mclk_6ma = "/fragment@83/__overlay__/camera_pins_cam2_mclk_6ma";
		camera_pins_cam2_mclk_8ma = "/fragment@83/__overlay__/camera_pins_cam2_mclk_8ma";
		camera_pins_cam3_mclk_off = "/fragment@83/__overlay__/camera_pins_cam3_mclk_off";
		camera_pins_cam3_mclk_2ma = "/fragment@83/__overlay__/camera_pins_cam3_mclk_2ma";
		camera_pins_cam3_mclk_4ma = "/fragment@83/__overlay__/camera_pins_cam3_mclk_4ma";
		camera_pins_cam3_mclk_6ma = "/fragment@83/__overlay__/camera_pins_cam3_mclk_6ma";
		camera_pins_cam3_mclk_8ma = "/fragment@83/__overlay__/camera_pins_cam3_mclk_8ma";
		camera_pins_default = "/fragment@83/__overlay__/camdefault";
		mtk_camera_eeprom0 = "/fragment@85/__overlay__/camera_eeprom0@50";
		mtk_camera_eeprom3 = "/fragment@86/__overlay__/camera_eeprom3@52";
		mtk_camera_eeprom1 = "/fragment@86/__overlay__/camera_eeprom1@54";
	};

	__fixups__ {
		chosen = "/fragment@0:target:0";
		irtx_pwm = "/fragment@1:target:0";
		pio = "/fragment@2:target:0\0/fragment@3/__overlay__:mt6360,intr_gpio:0\0/fragment@5/__overlay__:mt6360pd,intr_gpio:0\0/fragment@6/__overlay__/Focaltech20181@38:interrupt-parent:0\0/fragment@6/__overlay__/Focaltech20181@38:irq-gpio:0\0/fragment@6/__overlay__/Focaltech20181@38:reset-gpio:0\0/fragment@7:target:0\0/fragment@8:target:0\0/fragment@11/__overlay__/panel3@0:pm-enable-gpios:0\0/fragment@11/__overlay__/panel3@0:reset-gpios:0\0/fragment@11/__overlay__/panel3@0:bias-gpios:0\0/fragment@13/__overlay__/oplus_devinfo/main-sub:aboard-gpio0:0\0/fragment@13/__overlay__/kpd_volume_down:interrupt-parent:0\0/fragment@14/__overlay__:keypad,volume-up:0\0/fragment@14/__overlay__:keypad,volume-down:0\0/fragment@15:target:0\0/fragment@16:target:0\0/fragment@21:target:0\0/fragment@22/__overlay__:oplus,fp_gpio_0:0\0/fragment@23:target:0\0/fragment@25/__overlay__:anc,gpio_irq:0\0/fragment@25/__overlay__:anc,gpio_rst:0\0/fragment@26:target:0\0/fragment@28/__overlay__/tfa98xx@34:reset-gpio:0\0/fragment@28/__overlay__/gate_ic@11:gate-power-gpios:0\0/fragment@29:target:0\0/fragment@30/__overlay__/fsa4480@42:fsa4480,hs-det-gpio:0\0/fragment@30/__overlay__/fsa4480@42:fsa4480,reset-gpio:0\0/fragment@46/__overlay__:GPIO_FDD_BAND_SUPPORT_DETECT_1ST_PIN:0\0/fragment@46/__overlay__:GPIO_FDD_BAND_SUPPORT_DETECT_2ND_PIN:0\0/fragment@46/__overlay__:GPIO_FDD_BAND_SUPPORT_DETECT_3RD_PIN:0\0/fragment@46/__overlay__:GPIO_FDD_BAND_SUPPORT_DETECT_4TH_PIN:0\0/fragment@46/__overlay__:GPIO_RF_PWREN_RST_PIN:0\0/fragment@46/__overlay__:GPIO_SIM2_SIO:0\0/fragment@46/__overlay__:GPIO_SIM2_SCLK:0\0/fragment@46/__overlay__:GPIO_SIM2_SRST:0\0/fragment@46/__overlay__:GPIO_SIM1_SRST:0\0/fragment@46/__overlay__:GPIO_SIM1_SCLK:0\0/fragment@46/__overlay__:GPIO_SIM1_SIO:0\0/fragment@46/__overlay__:GPIO_SIM1_HOT_PLUG:0\0/fragment@46/__overlay__:GPIO_SIM2_HOT_PLUG:0\0/fragment@48/__overlay__:interrupt-parent:0\0/fragment@49/__overlay__:interrupt-parent:0\0/fragment@50/__overlay__:interrupt-parent:0\0/fragment@51/__overlay__:interrupt-parent:0\0/fragment@52/__overlay__:interrupt-parent:0\0/fragment@52/__overlay__:deb-gpios:0\0/fragment@53/__overlay__:interrupt-parent:0\0/fragment@54/__overlay__:interrupt-parent:0\0/fragment@62/__overlay__:mt6360,intr_gpio:0\0/fragment@63/__overlay__:mt6360pd,intr_gpio:0\0/fragment@65/__overlay__:qcom,chargerid_switch-gpio:0\0/fragment@65/__overlay__:qcom,dischg-gpio:0\0/fragment@65/__overlay__:qcom,ccdetect-gpio:0\0/fragment@66:target:0\0/fragment@68/__overlay__/sc8547-charger@6F:qcom,irq_gpio:0\0/fragment@68/__overlay__/sc8547-charger@6F:interrupt-parent:0\0/fragment@68/__overlay__/sc8547-charger@6F:qcom,charging_switch1-gpio:0\0/fragment@69:target:0\0/fragment@72:target:0\0/fragment@80/__overlay__/gt9886@5d:interrupt-parent:0\0/fragment@80/__overlay__/gt9886@5d:goodix,irq-gpio:0\0/fragment@80/__overlay__/gt9886@5d:goodix,reset-gpio:0\0/fragment@81/__overlay__/gt9896s@0:goodix,irq-gpio:0\0/fragment@81/__overlay__/gt9896s@0:goodix,reset-gpio:0\0/fragment@82:target:0\0/fragment@83:target:0\0/fragment@87/__overlay__/fan53870@35:en-gpios:0\0/fragment@87/__overlay__/wl2868c@2f:en-gpios:0";
		mt6360_pmu = "/fragment@3:target:0\0/fragment@62:target:0";
		mt6360_pmic = "/fragment@4:target:0";
		mt6360_typec = "/fragment@5:target:0\0/fragment@63:target:0";
		i2c0 = "/fragment@6:target:0\0/fragment@34:target:0\0/fragment@80:target:0";
		mt_pmic_vtp_ldo_reg = "/fragment@6/__overlay__/Focaltech20181@38:vdd_2v8-supply:0\0/fragment@58:target:0\0/fragment@60/__overlay__:vtouch-supply:0\0/fragment@80/__overlay__/gt9886@5d:vtouch-supply:0\0/fragment@81/__overlay__/gt9896s@0:vtouch-supply:0";
		mtkfb = "/fragment@9:target:0";
		dispsys_config = "/fragment@10:target:0";
		dsi0 = "/fragment@11:target:0";
		mt_pmic_vmc_ldo_reg = "/fragment@11/__overlay__/panel3@0:ldo3-supply:0";
		disp_leds = "/fragment@12:target:0";
		odm = "/fragment@13:target:0\0/fragment@77:target:0";
		keypad = "/fragment@14:target:0\0/fragment@61:target:0";
		gps = "/fragment@17:target:0";
		accdet = "/fragment@18:target:0";
		ps5169 = "/fragment@19:target:0\0/fragment@75:target:0";
		fusb340 = "/fragment@20:target:0\0/fragment@76:target:0";
		oplus_fp_common = "/fragment@22:target:0";
		spi5 = "/fragment@24:target:0";
		mt_pmic_vmch_ldo_reg = "/fragment@24/__overlay__/fingerprint@0:dvdd-supply:0\0/fragment@25/__overlay__:ldo-supply:0";
		jiiov_fp = "/fragment@25:target:0";
		swtp = "/fragment@27:target:0\0/fragment@52:target:0";
		i2c6 = "/fragment@28:target:0\0/fragment@30:target:0\0/fragment@40:target:0";
		auxadc = "/fragment@31:target:0\0/fragment@32/__overlay__:io-channels:0\0/fragment@65/__overlay__:io-channels:0\0/fragment@65/__overlay__:io-channels:8\0/fragment@65/__overlay__:io-channels:16\0/fragment@65/__overlay__:io-channels:24\0/fragment@65/__overlay__:io-channels:32";
		md_auxadc = "/fragment@32:target:0";
		pmic_clock_buffer_ctrl = "/fragment@33:target:0";
		i2c1 = "/fragment@35:target:0";
		i2c2 = "/fragment@36:target:0\0/fragment@85:target:0";
		i2c3 = "/fragment@37:target:0";
		i2c4 = "/fragment@38:target:0\0/fragment@86:target:0";
		i2c5 = "/fragment@39:target:0";
		i2c7 = "/fragment@41:target:0\0/fragment@68:target:0";
		i2c8 = "/fragment@42:target:0\0/fragment@87:target:0";
		i2c9 = "/fragment@43:target:0";
		i2c10 = "/fragment@44:target:0";
		i2c11 = "/fragment@45:target:0";
		gpio_usage_mapping = "/fragment@46:target:0";
		gpio = "/fragment@47:target:0";
		mrdump_ext_rst = "/fragment@48:target:0";
		subpmic_pmu_eint = "/fragment@49:target:0";
		irq_nfc = "/fragment@50:target:0";
		touch_panel = "/fragment@51:target:0";
		dsi_te = "/fragment@53:target:0";
		rt5133_eint = "/fragment@54:target:0";
		md1_sim1_hot_plug_eint = "/fragment@55:target:0";
		md1_sim2_hot_plug_eint = "/fragment@56:target:0";
		mt_pmic_vcamio_ldo_reg = "/fragment@57:target:0\0/fragment@59/__overlay__:vcamio-supply:0\0/fragment@84/__overlay__:cam0_vcamio-supply:0\0/fragment@84/__overlay__:cam1_vcamio-supply:0\0/fragment@84/__overlay__:cam2_vcamio-supply:0\0/fragment@84/__overlay__:cam3_vcamio-supply:0";
		kd_camera_hw1 = "/fragment@59:target:0\0/fragment@84:target:0";
		touch = "/fragment@60:target:0";
		lk_charger = "/fragment@64:target:0";
		charger = "/fragment@65:target:0";
		bat_gm30 = "/fragment@67:target:0";
		apuart0 = "/fragment@70:target:0";
		apuart1 = "/fragment@71:target:0";
		mt_pmic_vio28_ldo_reg = "/fragment@73:target:0";
		typec_mux_switch = "/fragment@74:target:0";
		usb_boost_manager = "/fragment@78:target:0";
		rt5133 = "/fragment@79:target:0";
		spi4 = "/fragment@81:target:0";
		mt_pmic_vs2_buck_reg = "/fragment@87/__overlay__/wl2868c@2f:vs2-supply:0";
	};

	__local_fixups__ {

		fragment@1 {

			__overlay__ {
				pinctrl-0 = <0x00>;
				pinctrl-1 = <0x00>;
			};
		};

		fragment@9 {

			__overlay__ {
				pinctrl-0 = <0x00>;
				pinctrl-1 = <0x00>;
				pinctrl-2 = <0x00>;
				pinctrl-3 = <0x00>;
				pinctrl-4 = <0x00>;
				pinctrl-5 = <0x00>;
				pinctrl-6 = <0x00>;
				pinctrl-7 = <0x00>;
				pinctrl-8 = <0x00>;
			};
		};

		fragment@10 {

			__overlay__ {
				pinctrl-0 = <0x00>;
				pinctrl-1 = <0x00>;
				pinctrl-2 = <0x00>;
			};
		};

		fragment@11 {

			__overlay__ {

				panel3@0 {

					port {

						endpoint {
							remote-endpoint = <0x00>;
						};
					};
				};

				ports {

					port {

						endpoint {
							remote-endpoint = <0x00>;
						};
					};
				};
			};
		};

		fragment@13 {

			__overlay__ {

				oplus_devinfo {
					pinctrl-0 = <0x00>;
					pinctrl-1 = <0x00>;
					pinctrl-2 = <0x00>;
					pinctrl-3 = <0x00>;
				};
			};
		};

		fragment@14 {

			__overlay__ {
				pinctrl-0 = <0x00>;
				pinctrl-1 = <0x00>;
			};
		};

		fragment@17 {

			__overlay__ {
				pinctrl-0 = <0x00>;
				pinctrl-1 = <0x00>;
				pinctrl-2 = <0x00>;
				pinctrl-3 = <0x00>;
				pinctrl-4 = <0x00>;
				pinctrl-5 = <0x00>;
				pinctrl-6 = <0x00>;
			};
		};

		fragment@19 {

			__overlay__ {
				pinctrl-0 = <0x00>;
				pinctrl-1 = <0x00>;
			};
		};

		fragment@20 {

			__overlay__ {
				pinctrl-0 = <0x00>;
				pinctrl-1 = <0x00>;
			};
		};

		fragment@22 {

			__overlay__ {
				pinctrl-0 = <0x00>;
			};
		};

		fragment@25 {

			__overlay__ {
				pinctrl-0 = <0x00>;
				pinctrl-1 = <0x00 0x04 0x08 0x0c 0x10>;
				pinctrl-2 = <0x00>;
			};
		};

		fragment@30 {

			__overlay__ {

				fsa4480@42 {
					pinctrl-0 = <0x00>;
				};
			};
		};

		fragment@65 {

			__overlay__ {
				pinctrl-0 = <0x00>;
				pinctrl-1 = <0x00>;
				pinctrl-2 = <0x00>;
				pinctrl-3 = <0x00>;
				pinctrl-4 = <0x00>;
				pinctrl-5 = <0x00>;
				pinctrl-6 = <0x00>;
			};
		};

		fragment@68 {

			__overlay__ {

				sc8547-charger@6F {
					pinctrl-0 = <0x00>;
					pinctrl-1 = <0x00>;
					pinctrl-2 = <0x00>;
					pinctrl-3 = <0x00>;
				};
			};
		};

		fragment@70 {

			__overlay__ {
				pinctrl-0 = <0x00>;
				pinctrl-1 = <0x00>;
			};
		};

		fragment@80 {

			__overlay__ {
				pinctrl-0 = <0x00>;
				pinctrl-1 = <0x00>;
				pinctrl-2 = <0x00>;
				pinctrl-3 = <0x00>;
				pinctrl-4 = <0x00>;
				pinctrl-5 = <0x00>;
			};
		};

		fragment@81 {

			__overlay__ {
				pinctrl-0 = <0x00>;
				pinctrl-1 = <0x00>;
				pinctrl-2 = <0x00>;
				pinctrl-3 = <0x00>;
				pinctrl-4 = <0x00>;
				pinctrl-5 = <0x00>;
			};
		};

		fragment@84 {

			__overlay__ {
				pinctrl-0 = <0x00>;
				pinctrl-1 = <0x00>;
				pinctrl-2 = <0x00>;
				pinctrl-3 = <0x00>;
				pinctrl-4 = <0x00>;
				pinctrl-5 = <0x00>;
				pinctrl-6 = <0x00>;
				pinctrl-7 = <0x00>;
				pinctrl-8 = <0x00>;
				pinctrl-9 = <0x00>;
				pinctrl-10 = <0x00>;
				pinctrl-11 = <0x00>;
				pinctrl-12 = <0x00>;
				pinctrl-13 = <0x00>;
				pinctrl-14 = <0x00>;
				pinctrl-15 = <0x00>;
				pinctrl-16 = <0x00>;
				pinctrl-17 = <0x00>;
				pinctrl-18 = <0x00>;
				pinctrl-19 = <0x00>;
				pinctrl-20 = <0x00>;
				pinctrl-21 = <0x00>;
				pinctrl-22 = <0x00>;
				pinctrl-23 = <0x00>;
				pinctrl-24 = <0x00>;
				pinctrl-25 = <0x00>;
				pinctrl-26 = <0x00>;
				pinctrl-27 = <0x00>;
				pinctrl-28 = <0x00>;
				pinctrl-29 = <0x00>;
				pinctrl-30 = <0x00>;
			};
		};
	};
};
