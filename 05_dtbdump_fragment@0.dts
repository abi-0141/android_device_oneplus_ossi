/dts-v1/;

/ {

	fragment@0 {
		target = <0xffffffff>;

		__overlay__ {
			atag,videolfb-fb_base_l = "~`P";
			atag,videolfb-fb_base_h = <0x00>;
			atag,videolfb-islcmfound = <0x01>;
			atag,videolfb-islcm_inited = <0x00>;
			atag,videolfb-fps = <0x1770>;
			atag,videolfb-vramSize = <0x1be0000>;
			atag,videolfb-lcmname = "td4330_fhdp_dsi_cmd_auo_rt4831_drv";
		};
	};

	fragment@1 {
		target = <0xffffffff>;

		__overlay__ {
			pinctrl-names = "irtx_gpio_led_default\0irtx_gpio_led_set";
			pinctrl-0 = <0x01>;
			pinctrl-1 = <0x02>;
			status = "okay";
		};
	};

	fragment@2 {
		target = <0xffffffff>;

		__overlay__ {

			irtx_gpio_led_def@gpio139 {
				phandle = <0x01>;

				pins_cmd_dat {
					pinmux = <0x8b00>;
					slew-rate = <0x01>;
					bias-disable;
					output-low;
					input-schmitt-enable = <0x00>;
				};
			};

			irtx_gpio_led_set@gpio139 {
				phandle = <0x02>;

				pins_cmd_dat {
					pinmux = <0x8b02>;
					slew-rate = <0x01>;
					output-high;
				};
			};
		};
	};

	fragment@3 {
		target = <0xffffffff>;

		__overlay__ {
			mt6360,intr_gpio_num = <0x04>;
			mt6360,intr_gpio = <0xffffffff 0x04 0x00>;
		};
	};

	fragment@4 {
		target = <0xffffffff>;

		__overlay__ {
			pwr_off_seq = <0x4000002>;
		};
	};

	fragment@5 {
		target = <0xffffffff>;

		__overlay__ {
			mt6360pd,intr_gpio_num = <0x05>;
			mt6360pd,intr_gpio = <0xffffffff 0x05 0x00>;
		};
	};

	fragment@6 {
		target = <0xffffffff>;

		__overlay__ {
			status = "okay";

			Focaltech20181@38 {
				compatible = "focaltech,fts";
				reg = <0x38>;
				chip-name = "FT3518";
				interrupt-parent = <0xffffffff>;
				interrupts = <0x0e 0x2002>;
				vdd_2v8-supply = <0xffffffff>;
				vdd_2v8_volt = <0x2dc6c0>;
				irq-gpio = <0xffffffff 0x0e 0x2002>;
				reset-gpio = <0xffffffff 0x0f 0x01>;
				vid_len = <0x02>;
				tp_type = <0x08>;
				platform_support_project = <0x4ed5 0x4ed6 0x4f83>;
				platform_support_project_dir = <0x4ed5 0x4ed5 0x4ed5>;
				platform_support_project_commandline = "default_commandline\0default_commandline\0default_commandline";
				touchpanel,max-num-support = <0x0a>;
				touchpanel,tx-rx-num = <0x10 0x22>;
				touchpanel,panel-coords = <0x10e0 0x2580>;
				touchpanel,display-coords = <0x438 0x960>;
				touchpanel,touchmajor-limit = <0x00 0xd8>;
				touchpanel,report-rate = <0x78 0xb4>;
				touchpanel,smooth-level = <0xff 0x02 0x0f 0x19 0x2d 0x3c>;
				touchpanel,smooth-level-charging = <0xff 0x0f 0x14 0x19 0x2d 0x3c>;
				touchpanel,sensitive-level = <0xff 0x14 0x10 0x0d 0x0a 0x05>;
				touchpanel,single-optimized-time = <0x08>;
				black_gesture_support;
				fw_edge_limit_support;
				pressure_report_support;
				charger_pump_support;
				game_switch_support;
				smart_gesture_support;
				fw_update_app_support;
				fingerprint_underscreen_support;
				headset_pump_support;
				health_monitor_v2_support;
				high_resolution_support;
				lcd_tp_refresh_support;
				touchpanel,button-type = <0x04>;
				touchpanel.button-TRx = <0x00 0x00>;
			};
		};
	};

	fragment@7 {
		target = <0xffffffff>;

		__overlay__ {

			eintdefault {
				phandle = <0x70>;
			};

			int_active {
				phandle = <0x71>;

				pins_cmd_dat {
					pinmux = <0xe00>;
					slew-rate = <0x00>;
					bias-pull-down = <0x00>;
				};
			};

			reset_active {
				phandle = <0x72>;

				pins_cmd_dat {
					pinmux = <0xf00>;
					slew-rate = <0x01>;
					output-high;
				};
			};

			int_suspend {
				phandle = <0x73>;

				pins_cmd_dat {
					pinmux = <0xe00>;
					slew-rate = <0x01>;
					output-low;
				};
			};

			reset_suspend {
				phandle = <0x74>;

				pins_cmd_dat {
					pinmux = <0xf00>;
					slew-rate = <0x00>;
					output-low;
				};
			};
		};
	};

	fragment@8 {
		target = <0xffffffff>;

		__overlay__ {

			lcm_led_en1_gpio {
				phandle = <0x03>;

				pins_cmd_dat {
					pinmux = <0x6b00>;
					slew-rate = <0x01>;
					output-high;
				};
			};

			lcm_led_en0_gpio {
				phandle = <0x04>;

				pins_cmd_dat {
					pinmux = <0x6b00>;
					slew-rate = <0x01>;
					output-low;
				};
			};

			lcd_bias_enp1_gpio {
				phandle = <0x05>;

				pins_cmd_dat {
					pinmux = <0x6c00>;
					slew-rate = <0x01>;
					output-high;
				};
			};

			lcd_bias_enp0_gpio {
				phandle = <0x06>;

				pins_cmd_dat {
					pinmux = <0x6c00>;
					slew-rate = <0x01>;
					output-low;
				};
			};

			lcd_bias_enn1_gpio {
				phandle = <0x07>;

				pins_cmd_dat {
					pinmux = <0x6f00>;
					slew-rate = <0x01>;
					output-high;
				};
			};

			lcd_bias_enn0_gpio {
				phandle = <0x08>;

				pins_cmd_dat {
					pinmux = <0x6f00>;
					slew-rate = <0x01>;
					output-low;
				};
			};

			lcm_rst_out1_gpio {
				phandle = <0x09>;

				pins_cmd_dat {
					pinmux = <0x2800>;
					slew-rate = <0x01>;
					output-high;
				};
			};

			lcm_rst_out0_gpio {
				phandle = <0x0a>;

				pins_cmd_dat {
					pinmux = <0x2800>;
					slew-rate = <0x01>;
					output-low;
				};
			};

			lcm_dsi_te {
				phandle = <0x0b>;

				pins_cmd_dat {
					pinmux = <0x2701>;
				};
			};
		};
	};

	fragment@9 {
		target = <0xffffffff>;

		__overlay__ {
			pinctrl-names = "lcm_led_en1_gpio\0lcm_led_en0_gpio\0lcd_bias_enp1_gpio\0lcd_bias_enp0_gpio\0lcd_bias_enn1_gpio\0lcd_bias_enn0_gpio\0lcm_rst_out1_gpio\0lcm_rst_out0_gpio\0mode_te_te";
			pinctrl-0 = <0x03>;
			pinctrl-1 = <0x04>;
			pinctrl-2 = <0x05>;
			pinctrl-3 = <0x06>;
			pinctrl-4 = <0x07>;
			pinctrl-5 = <0x08>;
			pinctrl-6 = <0x09>;
			pinctrl-7 = <0x0a>;
			pinctrl-8 = <0x0b>;
			status = "okay";
		};
	};

	fragment@10 {
		target = <0xffffffff>;

		__overlay__ {
			pinctrl-names = "lcm_rst_out1_gpio\0lcm_rst_out0_gpio\0mode_te_te";
			pinctrl-0 = <0x09>;
			pinctrl-1 = <0x0a>;
			pinctrl-2 = <0x0b>;
			status = "okay";
			helper-value = <0x00 0x01 0x01 0x00 0x01 0x00 0x01 0x00 0x00 0x00 0x01 0x00 0x01 0x01 0x01 0x01 0x00 0x01 0x01 0x01 0x00 0x01 0x00 0x01 0x00 0x00 0x00 0x00 0x01 0x00 0x00 0x00 0x00 0x00 0x01 0x00 0x00 0x00 0x01 0x01>;
		};
	};

	fragment@11 {
		target = <0xffffffff>;

		__overlay__ {
			status = "okay";
			#address-cells = <0x01>;
			#size-cells = <0x00>;

			panel1@0 {
				compatible = "oplus20181_samsung_ams643ye01_1080p_dsi_cmd,lcm";
				reg = <0x00>;
				pm-enable-gpios = <0xffffffff 0x27 0x00>;
				reset-gpios = <0xffffffff 0x28 0x00>;
				bias-gpios = <0xffffffff 0x6e 0x00>;
				ldo3-supply = <0xffffffff>;
				pinctrl-names = "default";

				port {

					endpoint {
						remote-endpoint = <0x0c>;
						phandle = <0x0d>;
					};
				};
			};

			ports {

				port {

					endpoint {
						remote-endpoint = <0x0d>;
						phandle = <0x0c>;
					};
				};
			};
		};
	};

	fragment@12 {
		target = <0xffffffff>;

		__overlay__ {
			compatible = "mediatek,disp-leds";

			backlight {
				label = "lcd-backlight";
				max-brightness = <0xfff>;
				led-bits = <0x0c>;
				trans-bits = <0x0c>;
				default-state = "on";
			};
		};
	};

	fragment@13 {
		target = <0xffffffff>;

		__overlay__ {

			led@0 {
				compatible = "mediatek,red";
				led_mode = <0x00>;
				data = <0x01>;
				pwm_config = <0x00 0x00 0x00 0x00 0x00>;
				phandle = <0x75>;
			};

			led@1 {
				compatible = "mediatek,green";
				led_mode = <0x00>;
				data = <0x01>;
				pwm_config = <0x00 0x00 0x00 0x00 0x00>;
				phandle = <0x76>;
			};

			led@2 {
				compatible = "mediatek,blue";
				led_mode = <0x00>;
				data = <0x01>;
				pwm_config = <0x00 0x00 0x00 0x00 0x00>;
				phandle = <0x77>;
			};

			led@3 {
				compatible = "mediatek,jogball-backlight";
				led_mode = <0x00>;
				data = <0x01>;
				pwm_config = <0x00 0x00 0x00 0x00 0x00>;
				phandle = <0x78>;
			};

			led@4 {
				compatible = "mediatek,keyboard-backlight";
				led_mode = <0x00>;
				data = <0x01>;
				pwm_config = <0x00 0x00 0x00 0x00 0x00>;
				phandle = <0x79>;
			};

			led@5 {
				compatible = "mediatek,button-backlight";
				led_mode = <0x00>;
				data = <0x01>;
				pwm_config = <0x00 0x00 0x00 0x00 0x00>;
				phandle = <0x7a>;
			};

			led@6 {
				compatible = "mediatek,lcd-backlight";
				led_mode = <0x04>;
				data = <0x01>;
				pwm_config = <0x00 0x01 0x00 0x00 0x00>;
				phandle = <0x7b>;
			};

			vibrator@0 {
				compatible = "mediatek,vibrator";
				vib_timer = <0x19>;
				vib_limit = <0x09>;
				vib_vol = <0x09>;
				status = "disabled";
				phandle = <0x7c>;
			};

			sensor_fb {
				compatible = "oplus,sensor-feedback";
				phandle = <0x7d>;
			};

			gsensor_1 {
				status = "okay";
				sensor_name = <0x07>;
				i2c_num = <0x02>;
				i2c_addr = <0x00>;
				direction = <0x03>;
				eint_num = <0x01>;
				step_count_7_en = <0x01>;
				config_miso = <0x01>;
				correct_y_bias = <0x01>;
				phandle = <0x7e>;
			};

			gsensor_2 {
				status = "okay";
				sensor_name = <0x06>;
				device_name = "lsm6dso";
				i2c_num = <0x02>;
				i2c_addr = <0x00>;
				direction = <0x05>;
				eint_num = <0x14>;
				gyro_cali_version = <0x02>;
				acc_cali_range = <0xc8 0xc8 0xc8>;
				phandle = <0x7f>;
			};

			gsensor_3 {
				status = "okay";
				sensor_name = <0x04>;
				device_name = "lsm6dsm";
				i2c_num = <0x02>;
				i2c_addr = <0x00>;
				direction = <0x03>;
				eint_num = <0x01>;
				gyro_cali_version = <0x02>;
				acc_cali_range = <0x12c 0x12c 0x12c>;
				phandle = <0x80>;
			};

			msensor_1 {
				status = "okay";
				sensor_name = <0x00>;
				i2c_num = <0x00>;
				i2c_addr = <0x0c>;
				direction = <0x03>;
				eint_num = <0x00>;
				soft-mag-parameter = <0x29df 0x00 0x6a 0x01 0x11 0x01 0x103 0x00 0x23f2 0x00 0x2d 0x01 0x121 0x00 0x39 0x01 0x288b 0x00>;
				phandle = <0x81>;
			};

			msensor_2 {
				status = "okay";
				sensor_name = <0x02>;
				i2c_num = <0x00>;
				i2c_addr = <0x30>;
				direction = <0x03>;
				eint_num = <0x00>;
				soft-mag-parameter = <0x2870 0x00 0x3a 0x01 0x4e 0x01 0x3a 0x01 0x242e 0x00 0x41 0x00 0x4e 0x00 0x41 0x01 0x28c0 0x00>;
				phandle = <0x82>;
			};

			sar_1 {
				status = "okay";
				sensor_name = <0x00>;
				i2c_num = <0x00>;
				i2c_addr = <0x28>;
				direction = <0x04>;
				eint_num = <0x0d>;
				channel_num = <0x03>;
				channel_0_min = <0x18af>;
				channel_0_max = <0x2506>;
				channel_1_min = <0x2452>;
				channel_1_max = <0x367a>;
				channel_2_min = <0x2a9>;
				channel_2_max = <0x3fe>;
				channel_3_min = <0x00>;
				channel_3_max = <0x11170>;
				reg_table_num = <0x03>;
				phandle = <0x83>;
			};

			proximity_1 {
				status = "okay";
				sensor_name = <0x06>;
				i2c_num = <0x00>;
				i2c_addr = <0x48>;
				direction = <0x04>;
				eint_num = <0x02>;
				low_step = <0x12c>;
				high_step = <0x190>;
				low_limit = <0x190>;
				high_limit = <0x258>;
				dirty_low_step = <0x12c>;
				dirty_high_step = <0x190>;
				ps_dirty_limit = <0x708>;
				ps_ir_limit = <0x7d0>;
				ps_adjust_min = <0x00>;
				ps_adjust_max = <0x73a>;
				sampling_count = <0x05>;
				step_max = <0x190>;
				step_min = <0x64>;
				step_div = <0x7d0>;
				anti_shake_delta = <0x46>;
				dynamic_cali_max = <0x7d0>;
				raw2offset_radio = <0x3e8>;
				offset_max = <0xea60>;
				offset_range_min = <0x00>;
				offset_range_max = <0xffff>;
				force_cali_limit = <0x7d0>;
				cali_jitter_limit = <0x14>;
				cal_offset_margin = <0xbb8>;
				sensor-reg = <0x03 0x28>;
				phandle = <0x84>;
			};

			light_1 {
				status = "okay";
				sensor_name = <0x06>;
				i2c_num = <0x00>;
				i2c_addr = <0x48>;
				direction = <0x04>;
				eint_num = <0x02>;
				als_buffer_length = <0x08>;
				als_ratio = <0x6e>;
				als_type = <0x02>;
				device_name = "stk32600";
				use_als_c2 = <0x01>;
				phandle = <0x85>;
			};

			proximity_2 {
				status = "okay";
				sensor_name = <0x05>;
				i2c_num = <0x00>;
				i2c_addr = <0x39>;
				direction = <0x04>;
				eint_num = <0x02>;
				low_step = <0x12c>;
				high_step = <0x190>;
				low_limit = <0x190>;
				high_limit = <0x258>;
				dirty_low_step = <0xb4>;
				dirty_high_step = <0xfa>;
				ps_dirty_limit = <0x3ff>;
				ps_ir_limit = <0x1f4>;
				ps_adjust_min = <0x00>;
				ps_adjust_max = <0x258>;
				sampling_count = <0x05>;
				step_max = <0x190>;
				step_min = <0x6e>;
				step_div = <0x5dc>;
				anti_shake_delta = <0x50>;
				dynamic_cali_max = <0x400>;
				raw2offset_radio = <0x5140>;
				offset_max = <0xfa>;
				offset_range_min = <0xff>;
				offset_range_max = <0xff>;
				force_cali_limit = <0x7d0>;
				cali_jitter_limit = <0x1e>;
				cal_offset_margin = <0x78>;
				phandle = <0x86>;
			};

			light_2 {
				status = "okay";
				sensor_name = <0x05>;
				i2c_num = <0x00>;
				i2c_addr = <0x39>;
				direction = <0x04>;
				eint_num = <0x02>;
				als_ratio = <0x6e>;
				als_buffer_length = <0x0a>;
				als_type = <0x02>;
				device_name = "tcs3701";
				phandle = <0x87>;
			};

			rear_cct_1 {
				status = "okay";
				sensor_name = <0x00>;
				i2c_num = <0x01>;
				i2c_addr = <0x48>;
				direction = <0x00>;
				eint_num = <0x0a>;
				available_sensor = <0x07>;
				gold_rear_cct_3k = <0x2b4b 0x36ec 0x6a4 0x1e8 0x40 0xa498>;
				gold_rear_cct_6k = <0x2128 0x330c 0xf58 0x174 0x40 0xa7d4>;
				device_name = "stk37600";
				cct_coef_Lir = <0x207e9a8 0x00 0x116c730 0x00 0xdaa4a8 0x00 0xcfe2c0 0x01 0x285050 0x01 0xbc5ea8 0x01 0x1cc1928 0x00 0x1ae7f08 0x00 0x44a6380 0x00 0x1c6588 0x01 0x1817f8 0x01 0x1d2108 0x01>;
				cct_coef_Hir = <0xb72d98 0x01 0xdb2e46 0x01 0x1339108 0x01 0x169bed6 0x00 0x176babe 0x00 0xfa6a4a 0x00 0xfaf6e 0x00 0x798ea2 0x00 0x330b68e 0x00 0x193ca 0x01 0x7c9b6 0x01 0x9e106 0x01>;
				phandle = <0x88>;
			};

			rear_cct_2 {
				status = "okay";
				sensor_name = <0x02>;
				i2c_num = <0x01>;
				i2c_addr = <0x39>;
				direction = <0x00>;
				eint_num = <0x0a>;
				available_sensor = <0x07>;
				gold_rear_cct_3k = <0x113a 0x87f 0x43e 0x1bea 0xa51 0x3e9>;
				gold_rear_cct_6k = <0xb5c 0x927 0x62d 0x196a 0x94e 0x3e9>;
				device_name = "tcs3408";
				phandle = <0x89>;
			};

			pick_up {
				status = "okay";
				use-proximity = <0x01>;
				phandle = <0x8a>;
			};

			lux_aod {
				status = "okay";
				use-proximity = <0x01>;
				phandle = <0x8b>;
			};

			alsps_arch {
				status = "okay";
				new-arch-supported = <0x01>;
				phandle = <0x8c>;
			};

			cali_arch {
				status = "okay";
				new-arch-supported = <0x01>;
				phandle = <0x8d>;
			};

			oplus_boardid {
				compatible = "oplus,oplus_boardid";
				oplus_boardid,dtsino = "20181";
				oplus_boardid,pcbmask = "0x0400";
				phandle = <0x8e>;
			};

			oplus_project {
				compatible = "oplus,oplus_project";
				phandle = <0x8f>;
			};

			oplus_devinfo {
				compatible = "oplus-devinfo";
				io-channels = <0xffffffff 0x08>;
				io-channel-names = "vph_pwr_voltage_sub";
				phandle = <0x90>;

				main-sub {
					compatible = "hw-match, main-sub";
					use_pmic_adc;
					is_mtk_use_adc;
					adc_ranges = <0x00 0x50 0x51 0xb4 0xb5 0x12c 0x12d 0x1a4 0x1a5 0x226 0x227 0x28a 0x28b 0x2f8 0x2f9 0x352 0x353 0x3b6 0x3b7 0x41a 0x41b 0x47e 0x47f 0x514>;
					aboard-patterns = <0x00 0x00 0x01>;
					match-projects = <0x4ed5 0x4ed6 0x4f83>;
				};
			};

			kpd_volume_down {
				compatible = "mediatek, VOLUME_DOWN-eint";
				interrupt-parent = <0xffffffff>;
				interrupts = <0x39 0x02 0x39 0x00>;
				debounce = <0x7d00>;
				status = "okay";
				phandle = <0x91>;
			};
		};
	};

	fragment@14 {
		target = <0xffffffff>;

		__overlay__ {
			keypad,volume-up = <0xffffffff 0x78 0x00>;
			keypad,volume-down = <0xffffffff 0x72 0x00>;
			pinctrl-names = "volume_up_as_int\0volume_down_as_int";
			pinctrl-0 = <0x0e>;
			pinctrl-1 = <0x0f>;
			status = "okay";
		};
	};

	fragment@15 {
		target = <0xffffffff>;

		__overlay__ {

			volume_up@0 {
				phandle = <0x0e>;

				pins_cmd_dat {
					pinmux = <0x7800>;
					slew-rate = <0x00>;
					input-enable;
				};
			};

			volume_down@0 {
				phandle = <0x0f>;

				pins_cmd_dat {
					pinmux = <0x7200>;
					slew-rate = <0x00>;
					input-enable;
				};
			};
		};
	};

	fragment@16 {
		target = <0xffffffff>;

		__overlay__ {

			gps_default {
				phandle = <0x10>;
			};

			gps_l1_lna@0 {
				phandle = <0x11>;

				pins_cmd_dat {
					pinmux = <0xbc00>;
					output-low;
				};
			};

			gps_l1_lna@1 {
				phandle = <0x12>;

				pins_cmd_dat {
					pinmux = <0xbc04>;
				};
			};

			gps_l1_lna@2 {
				phandle = <0x13>;

				pins_cmd_dat {
					pinmux = <0xbc00>;
					output-high;
				};
			};

			gps_l5_lna@0 {
				phandle = <0x14>;

				pins_cmd_dat {
					pinmux = <0xbd00>;
					output-low;
				};
			};

			gps_l5_lna@1 {
				phandle = <0x15>;

				pins_cmd_dat {
					pinmux = <0xbd04>;
				};
			};

			gps_l5_lna@2 {
				phandle = <0x16>;

				pins_cmd_dat {
					pinmux = <0xbd00>;
					output-high;
				};
			};
		};
	};

	fragment@17 {
		target = <0xffffffff>;

		__overlay__ {
			pinctrl-names = "default\0gps_l1_lna_disable\0gps_l1_lna_dsp_ctrl\0gps_l1_lna_enable\0gps_l5_lna_disable\0gps_l5_lna_dsp_ctrl\0gps_l5_lna_enable";
			pinctrl-0 = <0x10>;
			pinctrl-1 = <0x11>;
			pinctrl-2 = <0x12>;
			pinctrl-3 = <0x13>;
			pinctrl-4 = <0x14>;
			pinctrl-5 = <0x15>;
			pinctrl-6 = <0x16>;
			status = "okay";
		};
	};

	fragment@18 {
		target = <0xffffffff>;

		__overlay__ {
			accdet-mic-vol = <0x08>;
			headset-mode-setting = <0x500 0x500 0x01 0x1f0 0x800 0x800 0x20 0x44 0x04 0x01 0x05 0x03 0x03 0x05 0x0e>;
			accdet-plugout-debounce = <0x01>;
			accdet-mic-mode = <0x02>;
			headset-three-key-threshold = <0x00 0x52 0xaa 0x132>;
			headset-three-key-threshold-CDD = <0x00 0x79 0xc0 0x258>;
			headset-four-key-threshold = <0x00 0x3a 0x79 0xc0 0x190>;
			eint_use_ext_res = <0x00>;
			status = "okay";
		};
	};

	fragment@19 {
		target = <0xffffffff>;

		__overlay__ {
			pinctrl-names = "enable\0disable";
			pinctrl-0 = <0x17>;
			pinctrl-1 = <0x18>;
			status = "okay";
		};
	};

	fragment@20 {
		target = <0xffffffff>;

		__overlay__ {
			pinctrl-names = "sel_up\0sel_down";
			pinctrl-0 = <0x19>;
			pinctrl-1 = <0x1a>;
			status = "okay";
		};
	};

	fragment@21 {
		target = <0xffffffff>;

		__overlay__ {

			ps_enable {
				phandle = <0x17>;

				pins_cmd_dat {
					pinmux = <0x7900>;
					output-high;
				};
			};

			ps_disable {
				phandle = <0x18>;

				pins_cmd_dat {
					pinmux = <0x7900>;
					output-low;
				};
			};

			sel_up {
				phandle = <0x19>;

				pins_cmd_dat {
					pinmux = <0x600>;
					output-low;
				};
			};

			sel_down {
				phandle = <0x1a>;

				pins_cmd_dat {
					pinmux = <0x600>;
					output-high;
				};
			};
		};
	};

	fragment@22 {
		target = <0xffffffff>;

		__overlay__ {

			tfa98xx@34 {
				compatible = "nxp,tfa98xx";
				reg = <0x34>;
				status = "okay";
				phandle = <0x92>;
			};
		};
	};

	fragment@23 {
		target = <0xffffffff>;

		__overlay__ {

			fsa_hs_det {
				phandle = <0x1b>;

				pins_cmd_dat {
					pinmux = <0xa900>;
					slew-rate = <0x01>;
					output-high;
				};
			};
		};
	};

	fragment@24 {
		target = <0xffffffff>;

		__overlay__ {

			fsa4480@42 {
				compatible = "qcom,fsa4480-i2c";
				reg = <0x42>;
				pinctrl-names = "default";
				pinctrl-0 = <0x1b>;
				fsa4480,hs-det-gpio = <0xffffffff 0xa9 0x00>;
				fsa4480,dynamic-sense-to-gnd = <0x01>;
				phandle = <0x93>;
			};
		};
	};

	fragment@25 {
		target = <0xffffffff>;

		__overlay__ {

			tfa98xx_haptic@34 {
				compatible = "tfa,tfa_haptic";
				reg = <0x34>;
				reset-gpio = <0xffffffff 0x20 0x00>;
				i2s-id = <0x01>;
				status = "okay";
				phandle = <0x94>;
			};
		};
	};

	fragment@26 {
		target = <0xffffffff>;

		__overlay__ {
			oplus,fp_gpio_num = <0x01>;
			oplus,fp_gpio = <0x23>;
			oplus,fp_gpio_0 = <0xffffffff 0x23 0x00>;
			pinctrl-names = "default";
			pinctrl-0 = <0x1c>;

			goodix_optical {
				oplus,fp-id = <0x00>;
				vendor-chip = <0x0b>;
				eng-menu = "-1,-1";
				chip-name = "G_OPTICAL_G3S";
			};

			goodix_optical_bak {
				oplus,fp-id = <0x01>;
				vendor-chip = <0x0b>;
				eng-menu = "-1,-1";
				chip-name = "G_OPTICAL_G3S";
			};
		};
	};

	fragment@27 {
		target = <0xffffffff>;

		__overlay__ {

			gpio_id0_default {
				phandle = <0x1c>;

				pins_cmd_dat {
					pinmux = <0x2300>;
					slew-rate = <0x00>;
					bias-pull-up = <0x00>;
					input-enable;
				};
			};
		};
	};

	fragment@28 {
		target = <0xffffffff>;

		__overlay__ {
			goodix,gpio_irq = <0xffffffff 0x16 0x00>;
			goodix,gpio_reset = <0xffffffff 0x15 0x00>;
			goodix,gpio_cs = <0xffffffff 0x63 0x00>;
			pinctrl-names = "default\0gf_spi_drive_6mA\0gf_cs_func";
			pinctrl-0 = <0x1d 0x1e>;
			pinctrl-1 = <0x1f 0x20 0x21 0x22>;
			pinctrl-2 = <0x23>;
			status = "okay";
		};
	};

	fragment@29 {
		target = <0xffffffff>;

		__overlay__ {
			#address-cells = <0x01>;
			#size-cells = <0x00>;
			status = "okay";

			fingerprint@0 {
				compatible = "oplus,oplus_fp";
				reg = <0x00>;
				spi-max-frequency = <0x2faf080>;
				spi-id = <0x05>;
				spi-irq = <0x16>;
				spi-reg = <0xa822f8>;
				dvdd-supply = <0xffffffff>;
				dvdd-config = <0x325aa0 0x325aa0 0x249f0>;
				power-num = <0x01>;
				status = "okay";
				phandle = <0x95>;

				power_source_1 {
					power-mode = <0x01>;
					power-name = "dvdd";
					power-config = "dvdd-config";
					delay-time = <0x00>;
				};
			};
		};
	};

	fragment@30 {
		target = <0xffffffff>;

		__overlay__ {

			gpio_goodix_reset_default {
				phandle = <0x1e>;

				pins_cmd_dat {
					pinmux = <0x1500>;
					slew-rate = <0x01>;
					output-low;
				};
			};

			gpio_goodix_irq_default {
				phandle = <0x1d>;

				pins_cmd_dat {
					pinmux = <0x1600>;
					slew-rate = <0x00>;
					bias-pull-down;
				};
			};

			gpio_goodix_clk_6mA {
				phandle = <0x1f>;

				pins_cmd_dat {
					pinmux = <0x6201>;
					drive-strength = <0x02>;
				};
			};

			gpio_goodix_mosi_6mA {
				phandle = <0x20>;

				pins_cmd_dat {
					pinmux = <0x6501>;
					drive-strength = <0x02>;
				};
			};

			gpio_goodix_miso_6mA {
				phandle = <0x21>;

				pins_cmd_dat {
					pinmux = <0x6401>;
					drive-strength = <0x03>;
				};
			};

			gpio_goodix_cs_6mA {
				phandle = <0x22>;

				pins_cmd_dat {
					pinmux = <0x6301>;
					drive-strength = <0x02>;
				};
			};

			gpio_goodix_cs_func {
				phandle = <0x23>;

				pins_cmd_dat {
					pinmux = <0x6301>;
					drive-strength = <0x02>;
				};
			};
		};
	};

	fragment@31 {
		target = <0xffffffff>;

		__overlay__ {
			compatible = "mediatek, swtp-eint";
			debounce = <0x7d000>;
		};
	};

	fragment@32 {
		target = <0xffffffff>;

		__overlay__ {

			adc_channel@ {
				compatible = "mediatek,adc_channel";
				mediatek,temperature0 = <0x00>;
				mediatek,temperature1 = <0x01>;
				mediatek,adc_fdd_rf_params_dynamic_custom_ch = <0x02>;
				status = "okay";
			};
		};
	};

	fragment@33 {
		target = <0xffffffff>;

		__overlay__ {
			io-channels = <0xffffffff 0x02>;
		};
	};

	fragment@34 {
		target = <0xffffffff>;

		__overlay__ {
			mediatek,clkbuf-quantity = <0x07>;
			mediatek,clkbuf-config = <0x02 0x01 0x01 0x02 0x00 0x00 0x01>;
			mediatek,clkbuf-output-impedance = <0x03 0x04 0x03 0x04 0x00 0x00 0x03>;
			mediatek,clkbuf-controls-for-desense = <0x00 0x04 0x00 0x04 0x00 0x00 0x00>;
			status = "okay";
		};
	};

	fragment@35 {
		target = <0xffffffff>;

		__overlay__ {
			#address-cells = <0x01>;
			#size-cells = <0x00>;
			clock-frequency = <0x61a80>;
			mediatek,use-open-drain;
		};
	};

	fragment@36 {
		target = <0xffffffff>;

		__overlay__ {
			#address-cells = <0x01>;
			#size-cells = <0x00>;
			clock-frequency = <0x61a80>;
			mediatek,use-open-drain;
		};
	};

	fragment@37 {
		target = <0xffffffff>;

		__overlay__ {
			#address-cells = <0x01>;
			#size-cells = <0x00>;
			clock-frequency = <0x61a80>;
			mediatek,use-open-drain;

			camera_main@1a {
				compatible = "mediatek,camera_main";
				reg = <0x1a>;
				status = "okay";
				phandle = <0x96>;
			};

			camera_main_af@72 {
				compatible = "mediatek,camera_main_af";
				reg = <0x72>;
				status = "okay";
				phandle = <0x97>;
			};
		};
	};

	fragment@38 {
		target = <0xffffffff>;

		__overlay__ {
			#address-cells = <0x01>;
			#size-cells = <0x00>;
			clock-frequency = <0x61a80>;
			mediatek,use-open-drain;
		};
	};

	fragment@39 {
		target = <0xffffffff>;

		__overlay__ {
			#address-cells = <0x01>;
			#size-cells = <0x00>;
			clock-frequency = <0x61a80>;
			mediatek,use-open-drain;

			camera_main_two@11 {
				compatible = "mediatek,camera_main_two";
				reg = <0x11>;
				status = "okay";
				phandle = <0x98>;
			};

			camera_sub@1a {
				compatible = "mediatek,camera_sub";
				reg = <0x1a>;
				status = "okay";
				phandle = <0x99>;
			};

			camera_sub_two@10 {
				compatible = "mediatek,camera_sub_two";
				reg = <0x10>;
				status = "okay";
				phandle = <0x9a>;
			};
		};
	};

	fragment@40 {
		target = <0xffffffff>;

		__overlay__ {
			#address-cells = <0x01>;
			#size-cells = <0x00>;
			clock-frequency = <0x33e140>;
			mediatek,use-push-pull;

			subpmic@34 {
				compatible = "mediatek,subpmic";
				reg = <0x34>;
				status = "okay";
				phandle = <0x9b>;
			};

			usb_type_c@4e {
				compatible = "mediatek,usb_type_c";
				reg = <0x4e>;
				status = "okay";
				phandle = <0x9c>;
			};

			subpmic_pmic@1a {
				compatible = "mediatek,subpmic_pmic";
				reg = <0x1a>;
				status = "okay";
				phandle = <0x9d>;
			};

			subpmic_ldo@64 {
				compatible = "mediatek,subpmic_ldo";
				reg = <0x64>;
				status = "okay";
				phandle = <0x9e>;
			};
		};
	};

	fragment@41 {
		target = <0xffffffff>;

		__overlay__ {
			#address-cells = <0x01>;
			#size-cells = <0x00>;
			clock-frequency = <0x61a80>;
			mediatek,use-open-drain;

			i2c_lcd_bias@11 {
				compatible = "mediatek,i2c_lcd_bias";
				reg = <0x11>;
				status = "okay";
				phandle = <0x9f>;
			};
		};
	};

	fragment@42 {
		target = <0xffffffff>;

		__overlay__ {
			#address-cells = <0x01>;
			#size-cells = <0x00>;
			clock-frequency = <0x186a0>;
			mediatek,use-open-drain;
		};
	};

	fragment@43 {
		target = <0xffffffff>;

		__overlay__ {
			#address-cells = <0x01>;
			#size-cells = <0x00>;
			clock-frequency = <0x61a80>;
			mediatek,use-open-drain;

			nfc@28 {
				compatible = "mediatek,nfc";
				reg = <0x28>;
				status = "okay";
				phandle = <0xa0>;
			};
		};
	};

	fragment@44 {
		target = <0xffffffff>;

		__overlay__ {
			#address-cells = <0x01>;
			#size-cells = <0x00>;
			clock-frequency = <0x61a80>;
			mediatek,use-open-drain;
		};
	};

	fragment@45 {
		target = <0xffffffff>;

		__overlay__ {
			#address-cells = <0x01>;
			#size-cells = <0x00>;
			clock-frequency = <0x61a80>;
			mediatek,use-open-drain;
		};
	};

	fragment@46 {
		target = <0xffffffff>;

		__overlay__ {
			#address-cells = <0x01>;
			#size-cells = <0x00>;
			clock-frequency = <0x61a80>;
			mediatek,use-open-drain;
		};
	};

	fragment@47 {
		target = <0xffffffff>;

		__overlay__ {
			GPIO_FDD_BAND_SUPPORT_DETECT_1ST_PIN = <0xffffffff 0x47 0x00>;
			GPIO_FDD_BAND_SUPPORT_DETECT_2ND_PIN = <0xffffffff 0x48 0x00>;
			GPIO_FDD_BAND_SUPPORT_DETECT_3RD_PIN = <0xffffffff 0x49 0x00>;
			GPIO_FDD_BAND_SUPPORT_DETECT_4TH_PIN = <0xffffffff 0x4a 0x00>;
			GPIO_RF_PWREN_RST_PIN = <0xffffffff 0x4b 0x00>;
			GPIO_SIM2_SIO = <0xffffffff 0xaa 0x00>;
			GPIO_SIM2_SCLK = <0xffffffff 0xab 0x00>;
			GPIO_SIM2_SRST = <0xffffffff 0xac 0x00>;
			GPIO_SIM1_SRST = <0xffffffff 0xad 0x00>;
			GPIO_SIM1_SCLK = <0xffffffff 0xae 0x00>;
			GPIO_SIM1_SIO = <0xffffffff 0xaf 0x00>;
			GPIO_SIM1_HOT_PLUG = <0xffffffff 0xb0 0x00>;
			GPIO_SIM2_HOT_PLUG = <0xffffffff 0xb1 0x00>;
		};
	};

	fragment@48 {
		target = <0xffffffff>;

		__overlay__ {
			gpio_init_default = <0x00 0x00 0x00 0x00 0x01 0x01 0x01 0x01 0x00 0x00 0x00 0x01 0x00 0x01 0x02 0x00 0x00 0x00 0x01 0x01 0x01 0x03 0x00 0x00 0x00 0x01 0x01 0x01 0x04 0x00 0x00 0x00 0x01 0x01 0x01 0x05 0x00 0x00 0x00 0x01 0x01 0x01 0x06 0x00 0x00 0x00 0x00 0x00 0x00 0x07 0x00 0x00 0x00 0x01 0x01 0x00 0x08 0x00 0x00 0x00 0x01 0x01 0x00 0x09 0x00 0x00 0x00 0x01 0x01 0x00 0x0a 0x00 0x00 0x00 0x01 0x01 0x00 0x0b 0x00 0x00 0x00 0x01 0x00 0x00 0x0c 0x02 0x00 0x00 0x01 0x01 0x00 0x0d 0x02 0x00 0x00 0x01 0x01 0x00 0x0e 0x00 0x00 0x00 0x01 0x01 0x01 0x0f 0x00 0x01 0x00 0x01 0x00 0x01 0x10 0x07 0x00 0x00 0x01 0x01 0x00 0x11 0x07 0x00 0x00 0x01 0x01 0x00 0x12 0x00 0x00 0x00 0x01 0x00 0x00 0x13 0x00 0x00 0x00 0x01 0x01 0x00 0x14 0x07 0x00 0x00 0x00 0x00 0x00 0x15 0x00 0x01 0x00 0x00 0x00 0x00 0x16 0x00 0x00 0x00 0x01 0x01 0x00 0x17 0x07 0x00 0x00 0x01 0x01 0x00 0x18 0x00 0x01 0x00 0x01 0x00 0x00 0x19 0x00 0x01 0x00 0x01 0x00 0x00 0x1a 0x01 0x00 0x00 0x01 0x01 0x00 0x1b 0x01 0x00 0x00 0x00 0x00 0x00 0x1c 0x01 0x00 0x00 0x01 0x01 0x00 0x1d 0x00 0x00 0x00 0x00 0x00 0x00 0x1e 0x00 0x00 0x00 0x00 0x00 0x00 0x1f 0x01 0x00 0x00 0x01 0x01 0x00 0x20 0x01 0x00 0x00 0x01 0x01 0x00 0x21 0x00 0x01 0x00 0x01 0x00 0x00 0x22 0x00 0x00 0x00 0x00 0x00 0x00 0x23 0x00 0x00 0x00 0x01 0x00 0x00 0x24 0x01 0x00 0x00 0x01 0x01 0x01 0x25 0x01 0x00 0x00 0x01 0x01 0x01 0x26 0x01 0x00 0x00 0x01 0x01 0x01 0x27 0x01 0x00 0x00 0x01 0x00 0x01 0x28 0x00 0x01 0x00 0x00 0x00 0x01 0x29 0x01 0x00 0x00 0x00 0x00 0x01 0x2a 0x01 0x00 0x00 0x00 0x00 0x01 0x2b 0x01 0x00 0x00 0x01 0x00 0x01 0x2c 0x01 0x00 0x00 0x01 0x00 0x01 0x2d 0x01 0x00 0x00 0x01 0x01 0x01 0x2e 0x01 0x00 0x00 0x00 0x00 0x00 0x2f 0x01 0x00 0x00 0x00 0x00 0x00 0x30 0x01 0x00 0x00 0x00 0x00 0x00 0x31 0x01 0x00 0x00 0x00 0x00 0x00 0x32 0x01 0x00 0x00 0x01 0x00 0x00 0x33 0x01 0x00 0x00 0x01 0x00 0x00 0x34 0x01 0x00 0x00 0x01 0x00 0x00 0x35 0x01 0x00 0x00 0x01 0x00 0x00 0x36 0x01 0x00 0x00 0x01 0x00 0x01 0x37 0x01 0x00 0x00 0x01 0x00 0x00 0x38 0x01 0x00 0x00 0x01 0x00 0x00 0x39 0x01 0x00 0x00 0x01 0x00 0x00 0x3a 0x01 0x00 0x00 0x01 0x00 0x00 0x3b 0x01 0x00 0x00 0x01 0x00 0x00 0x3c 0x01 0x00 0x00 0x00 0x00 0x01 0x3d 0x01 0x00 0x00 0x00 0x00 0x01 0x3e 0x01 0x00 0x00 0x00 0x00 0x01 0x3f 0x01 0x00 0x00 0x00 0x00 0x01 0x40 0x01 0x00 0x00 0x01 0x01 0x01 0x41 0x01 0x00 0x00 0x01 0x01 0x01 0x42 0x01 0x00 0x00 0x01 0x00 0x01 0x43 0x01 0x00 0x00 0x01 0x00 0x01 0x44 0x01 0x00 0x00 0x00 0x00 0x00 0x45 0x01 0x00 0x00 0x01 0x00 0x00 0x46 0x01 0x00 0x00 0x01 0x00 0x01 0x47 0x00 0x00 0x00 0x01 0x00 0x01 0x48 0x00 0x00 0x00 0x01 0x00 0x01 0x49 0x00 0x00 0x00 0x01 0x00 0x01 0x4a 0x00 0x00 0x00 0x01 0x00 0x01 0x4b 0x00 0x01 0x01 0x01 0x00 0x01 0x4c 0x01 0x00 0x00 0x00 0x00 0x01 0x4d 0x01 0x00 0x00 0x00 0x00 0x01 0x4e 0x01 0x00 0x00 0x00 0x00 0x01 0x4f 0x01 0x00 0x00 0x00 0x00 0x01 0x50 0x01 0x00 0x00 0x00 0x00 0x01 0x51 0x01 0x00 0x00 0x00 0x00 0x01 0x52 0x01 0x00 0x00 0x00 0x00 0x00 0x53 0x01 0x00 0x00 0x01 0x00 0x00 0x54 0x01 0x00 0x00 0x00 0x00 0x00 0x55 0x01 0x00 0x00 0x01 0x00 0x00 0x56 0x01 0x00 0x00 0x01 0x00 0x01 0x57 0x01 0x00 0x00 0x00 0x00 0x01 0x58 0x01 0x00 0x00 0x00 0x00 0x01 0x59 0x01 0x00 0x00 0x00 0x00 0x01 0x5a 0x01 0x00 0x00 0x00 0x00 0x01 0x5b 0x01 0x00 0x00 0x00 0x00 0x01 0x5c 0x01 0x00 0x00 0x00 0x00 0x01 0x5d 0x01 0x00 0x00 0x00 0x00 0x01 0x5e 0x01 0x00 0x00 0x00 0x00 0x01 0x5f 0x01 0x00 0x00 0x00 0x00 0x01 0x60 0x01 0x00 0x00 0x00 0x00 0x01 0x61 0x01 0x00 0x00 0x00 0x00 0x01 0x62 0x01 0x01 0x00 0x00 0x00 0x00 0x63 0x00 0x01 0x00 0x00 0x00 0x00 0x64 0x01 0x00 0x00 0x01 0x00 0x00 0x65 0x01 0x01 0x00 0x00 0x00 0x00 0x66 0x01 0x00 0x00 0x01 0x01 0x00 0x67 0x01 0x00 0x00 0x01 0x01 0x00 0x68 0x01 0x00 0x00 0x01 0x01 0x00 0x69 0x01 0x00 0x00 0x01 0x01 0x00 0x6a 0x01 0x00 0x00 0x01 0x01 0x00 0x6b 0x00 0x01 0x00 0x01 0x00 0x01 0x6c 0x00 0x01 0x00 0x01 0x00 0x01 0x6d 0x00 0x01 0x01 0x01 0x00 0x00 0x6e 0x00 0x01 0x01 0x01 0x00 0x00 0x6f 0x00 0x01 0x00 0x01 0x00 0x00 0x70 0x01 0x00 0x00 0x01 0x01 0x00 0x71 0x00 0x00 0x00 0x01 0x01 0x00 0x72 0x01 0x00 0x00 0x01 0x01 0x00 0x73 0x00 0x01 0x01 0x01 0x00 0x00 0x74 0x01 0x00 0x00 0x01 0x01 0x01 0x75 0x00 0x01 0x00 0x01 0x00 0x00 0x76 0x00 0x01 0x00 0x01 0x00 0x00 0x77 0x00 0x01 0x00 0x01 0x00 0x00 0x78 0x01 0x00 0x00 0x01 0x01 0x00 0x79 0x00 0x00 0x00 0x01 0x01 0x00 0x7a 0x07 0x00 0x00 0x01 0x01 0x01 0x7b 0x07 0x00 0x00 0x01 0x01 0x00 0x7c 0x07 0x00 0x00 0x01 0x01 0x00 0x7d 0x07 0x00 0x00 0x01 0x01 0x00 0x7e 0x02 0x00 0x00 0x01 0x00 0x00 0x7f 0x02 0x00 0x00 0x01 0x00 0x00 0x80 0x02 0x00 0x00 0x01 0x01 0x01 0x81 0x02 0x00 0x00 0x01 0x00 0x01 0x82 0x02 0x00 0x00 0x01 0x01 0x01 0x83 0x02 0x00 0x00 0x01 0x01 0x01 0x84 0x01 0x00 0x00 0x01 0x01 0x01 0x85 0x01 0x00 0x00 0x01 0x01 0x01 0x86 0x01 0x00 0x00 0x01 0x01 0x01 0x87 0x01 0x00 0x00 0x01 0x01 0x01 0x88 0x01 0x00 0x00 0x01 0x01 0x01 0x89 0x01 0x00 0x00 0x01 0x01 0x01 0x8a 0x04 0x00 0x00 0x01 0x01 0x00 0x8b 0x04 0x00 0x00 0x01 0x01 0x00 0x8c 0x00 0x01 0x00 0x01 0x00 0x01 0x8d 0x00 0x01 0x00 0x01 0x00 0x01 0x8e 0x00 0x01 0x00 0x01 0x00 0x00 0x8f 0x01 0x00 0x00 0x01 0x01 0x01 0x90 0x01 0x00 0x00 0x01 0x01 0x01 0x91 0x01 0x00 0x00 0x01 0x01 0x01 0x92 0x01 0x00 0x00 0x01 0x01 0x01 0x93 0x01 0x00 0x00 0x01 0x01 0x01 0x94 0x01 0x00 0x00 0x01 0x01 0x01 0x95 0x01 0x00 0x00 0x00 0x00 0x00 0x96 0x01 0x00 0x00 0x00 0x00 0x00 0x97 0x01 0x00 0x00 0x00 0x00 0x00 0x98 0x00 0x01 0x00 0x01 0x00 0x00 0x99 0x01 0x00 0x00 0x00 0x00 0x00 0x9a 0x00 0x01 0x00 0x01 0x00 0x00 0x9b 0x00 0x01 0x00 0x01 0x00 0x00 0x9c 0x00 0x00 0x00 0x01 0x01 0x00 0x9d 0x00 0x01 0x00 0x01 0x00 0x00 0x9e 0x00 0x00 0x00 0x01 0x01 0x00 0x9f 0x00 0x01 0x00 0x01 0x00 0x00 0xa0 0x00 0x00 0x00 0x01 0x01 0x00 0xa1 0x00 0x01 0x00 0x01 0x00 0x00 0xa2 0x00 0x00 0x00 0x01 0x01 0x00 0xa3 0x00 0x00 0x00 0x01 0x01 0x00 0xa4 0x01 0x00 0x00 0x01 0x01 0x00 0xa5 0x01 0x00 0x00 0x00 0x00 0x00 0xa6 0x01 0x00 0x00 0x01 0x01 0x00 0xa7 0x00 0x01 0x00 0x01 0x00 0x00 0xa8 0x01 0x00 0x00 0x01 0x01 0x00 0xa9 0x01 0x00 0x00 0x01 0x01 0x00 0xaa 0x01 0x00 0x00 0x01 0x01 0x01 0xab 0x01 0x00 0x00 0x00 0x00 0x01 0xac 0x01 0x00 0x00 0x00 0x00 0x01 0xad 0x01 0x00 0x00 0x00 0x00 0x01 0xae 0x01 0x00 0x00 0x00 0x00 0x01 0xaf 0x01 0x00 0x00 0x01 0x01 0x01 0xb0 0x01 0x00 0x00 0x01 0x01 0x01 0xb1 0x01 0x00 0x00 0x01 0x01 0x01 0xb2 0x01 0x00 0x00 0x01 0x00 0x00 0xb3 0x01 0x00 0x00 0x01 0x00 0x00 0xb4 0x00 0x00 0x00 0x00 0x00 0x01 0xb5 0x00 0x00 0x00 0x00 0x00 0x01 0xb6 0x01 0x00 0x00 0x01 0x01 0x00 0xb7 0x01 0x00 0x00 0x01 0x01 0x00 0xb8 0x01 0x00 0x00 0x01 0x01 0x00 0xb9 0x01 0x00 0x00 0x01 0x01 0x00 0xba 0x03 0x00 0x00 0x01 0x01 0x01 0xbb 0x03 0x00 0x00 0x01 0x01 0x01 0xbc 0x00 0x01 0x00 0x01 0x01 0x00 0xbd 0x00 0x01 0x00 0x01 0x01 0x00 0xbe 0x01 0x00 0x00 0x01 0x01 0x00 0xbf 0x05 0x00 0x00 0x00 0x00 0x00 0xc0 0x05 0x00 0x00 0x00 0x00 0x00 0xc1 0x00 0x00 0x00 0x01 0x01 0x00 0xc2 0x00 0x00 0x00 0x01 0x01 0x00 0xc3 0x00 0x00 0x00 0x01 0x01 0x00 0xc4 0x00 0x00 0x00 0x01 0x00 0x00 0xc5 0x00 0x00 0x00 0x01 0x00 0x00 0xc6 0x00 0x00 0x00 0x01 0x00 0x00 0xc7 0x00 0x00 0x00 0x01 0x00 0x00 0xc8 0x00 0x00 0x00 0x01 0x00 0x00 0xc9 0x00 0x00 0x00 0x01 0x00 0x00 0xca 0x00 0x00 0x00 0x01 0x00 0x00 0xcb 0x00 0x00 0x00 0x01 0x00 0x00 0xcc 0x00 0x00 0x00 0x01 0x00 0x00 0xcd 0x00 0x00 0x00 0x01 0x00 0x00 0xce 0x00 0x00 0x00 0x01 0x00 0x00 0xcf 0x00 0x00 0x00 0x01 0x00 0x00 0xd0 0x00 0x00 0x00 0x01 0x00 0x00>;
		};
	};

	fragment@49 {
		target = <0xffffffff>;

		__overlay__ {
			interrupt-parent = <0xffffffff>;
			interrupts = <0x00 0x08>;
			status = "okay";
		};
	};

	fragment@50 {
		target = <0xffffffff>;

		__overlay__ {
			interrupt-parent = <0xffffffff>;
			interrupts = <0x04 0x02>;
			status = "okay";
		};
	};

	fragment@51 {
		target = <0xffffffff>;

		__overlay__ {
			interrupt-parent = <0xffffffff>;
			interrupts = <0x08 0x04>;
			status = "okay";
		};
	};

	fragment@52 {
		target = <0xffffffff>;

		__overlay__ {
			interrupt-parent = <0xffffffff>;
			interrupts = <0x0e 0x08>;
			status = "okay";
		};
	};

	fragment@53 {
		target = <0xffffffff>;

		__overlay__ {
			interrupt-parent = <0xffffffff>;
			interrupts = <0x13 0x04>;
			deb-gpios = <0xffffffff 0x13 0x00>;
			debounce = <0x7d000>;
			status = "okay";
		};
	};

	fragment@54 {
		target = <0xffffffff>;

		__overlay__ {
			interrupt-parent = <0xffffffff>;
			interrupts = <0x25 0x01>;
			status = "okay";
		};
	};

	fragment@55 {
		target = <0xffffffff>;

		__overlay__ {
			interrupt-parent = <0xffffffff>;
			interrupts = <0xa2 0x08>;
			status = "okay";
		};
	};

	fragment@56 {
		target = <0xffffffff>;

		__overlay__ {
			compatible = "mediatek,md1_sim1_hot_plug_eint-eint";
			interrupts = <0x00 0x08>;
			debounce = <0x00 0x2710>;
			dedicated = <0x00 0x00>;
			src_pin = <0x00 0x01>;
			sockettype = <0x00 0x00>;
			status = "okay";
		};
	};

	fragment@57 {
		target = <0xffffffff>;

		__overlay__ {
			compatible = "mediatek,md1_sim2_hot_plug_eint-eint";
			interrupts = <0x01 0x08>;
			debounce = <0x01 0x2710>;
			dedicated = <0x01 0x00>;
			src_pin = <0x01 0x02>;
			sockettype = <0x01 0x00>;
			status = "okay";
		};
	};

	fragment@58 {
		target = <0xffffffff>;

		__overlay__ {
			regulator-name = "vcamio";
			regulator-default-on = <0x01>;
			status = "okay";
		};
	};

	fragment@59 {
		target = <0xffffffff>;

		__overlay__ {
			regulator-name = "vtp";
			regulator-default-on = <0x01>;
			status = "okay";
		};
	};

	fragment@60 {
		target = <0xffffffff>;

		__overlay__ {
			vcamio-supply = <0xffffffff>;
			status = "okay";
		};
	};

	fragment@61 {
		target = <0xffffffff>;

		__overlay__ {
			vtouch-supply = <0xffffffff>;
			status = "okay";
		};
	};

	fragment@62 {
		target = <0xffffffff>;

		__overlay__ {
			mediatek,kpd-key-debounce = <0x400>;
			mediatek,kpd-sw-pwrkey = <0x74>;
			mediatek,kpd-hw-pwrkey = <0x08>;
			mediatek,kpd-sw-rstkey = <0x73>;
			mediatek,kpd-hw-rstkey = <0x11>;
			mediatek,kpd-use-extend-type = <0x00>;
			mediatek,kpd-hw-map-num = <0x48>;
			mediatek,kpd-hw-init-map = <0x00 0x72 0x00 0x00 0x00 0x00 0x00 0x00 0x00 0x00 0x00 0x00 0x00 0x00 0x00 0x00 0x00 0x00 0x00 0x00 0x00 0x00 0x00 0x00 0x00 0x00 0x00 0x00 0x00 0x00 0x00 0x00 0x00 0x00 0x00 0x00 0x00 0x00 0x00 0x00 0x00 0x00 0x00 0x00 0x00 0x00 0x00 0x00 0x00 0x00 0x00 0x00 0x00 0x00 0x00 0x00 0x00 0x00 0x00 0x00 0x00 0x00 0x00 0x00 0x00 0x00 0x00 0x00 0x00 0x00 0x00 0x00>;
			mediatek,kpd-pwrkey-eint-gpio = <0x00>;
			mediatek,kpd-pwkey-gpio-din = <0x00>;
			mediatek,kpd-hw-dl-key0 = <0x11>;
			mediatek,kpd-hw-dl-key2 = <0x08>;
			mediatek,kpd-hw-recovery-key = <0x11>;
			status = "okay";
		};
	};

	fragment@63 {
		target = <0xffffffff>;

		__overlay__ {
			status = "okay";
			scl-gpio-id = <0x93>;
			sda-gpio-id = <0x94>;

			tfa98xx-vib {
				status = "okay";
				compatible = "tfa98xx,vib";
				reset-gpio = <0x20>;
				interval_time = <0x36b0>;
			};
		};
	};

	fragment@64 {
		target = <0xffffffff>;

		__overlay__ {
		};
	};

	fragment@65 {
		target = <0xffffffff>;

		__overlay__ {
			mt6360,intr_gpio_num = <0x04>;
			mt6360,intr_gpio = <0xffffffff 0x04 0x00>;
			disable_lpsd = <0x01>;

			chg {
				support_hvdcp;
			};
		};
	};

	fragment@66 {
		target = <0xffffffff>;

		__overlay__ {
			mt6360pd,intr_gpio_num = <0x05>;
			mt6360pd,intr_gpio = <0xffffffff 0x05 0x00>;
			mt-tcpc,role_def = <0x01>;
			mt-tcpc,vconn_supply = <0x01>;

			pd-data {
				pd,source-pdo-size = <0x01>;
				pd,source-pdo-data = <0x19096>;
				pd,sink-pdo-size = <0x02>;
				pd,sink-pdo-data = <0x190c8 0x1912c>;
				pd,id-vdo-size = <0x03>;
				pd,id-vdo-data = <0xd10029cf 0x00 0x63600000>;
				bat,nr = <0x01>;

				bat-info0 {
					bat,vid = <0x29cf>;
					bat,pid = <0x6360>;
					bat,mfrs = "bat1";
					bat,design_cap = <0x10>;
				};
			};

			dpm_caps {
				attemp_discover_svid;
			};
		};
	};

	fragment@67 {
		target = <0xffffffff>;

		__overlay__ {
			charger_by_buckboost;
			support_tuv_authentication;
		};
	};

	fragment@68 {
		target = <0xffffffff>;

		__overlay__ {
			io-channels = <0xffffffff 0x04 0xffffffff 0x05 0xffffffff 0x06>;
			io-channel-names = "auxadc4-usb_temp_v_l\0auxadc5-usb_temp_v_r\0auxadc3-chargeric_temp";
			pinctrl-names = "default\0charger_gpio_as_output_low\0charger_gpio_as_output_high\0ship_sleep\0ship_active\0dischg_enable\0dischg_disable\0chgvin_enable\0chgvin_disable\0pmic_chgfunc_enable\0pmic_chgfunc_disable\0ccdetect_active\0ccdetect_sleep";
			pinctrl-0 = <0x24>;
			pinctrl-1 = <0x25>;
			pinctrl-2 = <0x26>;
			pinctrl-3 = <0x27>;
			pinctrl-4 = <0x28>;
			pinctrl-5 = <0x29>;
			pinctrl-6 = <0x2a>;
			pinctrl-7 = <0x2b>;
			pinctrl-8 = <0x2c>;
			pinctrl-9 = <0x2d>;
			pinctrl-10 = <0x2e>;
			pinctrl-11 = <0x2f>;
			pinctrl-12 = <0x30>;
			qcom,hv_flashled_support;
			qcom,chargerid_support;
			qcom,smart_charging_screenoff;
			qcom,usbtemp_batttemp_gap = <0x12>;
			qcom,input_current_charger_ma = <0x7d0>;
			qcom,pd_input_current_charger_ma = <0x7d0>;
			qcom,qc_input_current_charger_ma = <0x7d0>;
			qcom,input_current_usb_ma = <0x1f4>;
			qcom,input_current_led_ma = <0x4b0>;
			qcom,input_current_led_ma_high = <0x4b0>;
			qcom,input_current_led_ma_warm = <0x5dc>;
			qcom,input_current_led_ma_normal = <0x7d0>;
			qcom,led_warm_bat_decidegc = <0x15e>;
			qcom,led_high_bat_decidegc = <0x172>;
			qcom,input_current_camera_ma = <0x4b0>;
			qcom,input_current_cdp_ma = <0x5dc>;
			qcom,input_current_vooc_led_ma_high = <0x4b0>;
			qcom,input_current_vooc_led_ma_warm = <0x708>;
			qcom,input_current_vooc_led_ma_normal = <0xe10>;
			qcom,input_current_vooc_ma_normal = <0xe10>;
			qcom,vooc_temp_bat_normal_decidegc = <0x15e>;
			qcom,input_current_vooc_ma_warm = <0xc80>;
			qcom,vooc_temp_bat_warm_decidegc = <0x172>;
			qcom,input_current_vooc_ma_high = <0x898>;
			qcom,vooc_temp_bat_hot_decidegc = <0x1b8>;
			qcom,charger_current_vooc_ma_normal = <0x708>;
			qcom,chg_ctrl_by_calling;
			qcom,input_current_calling_ma = <0x5dc>;
			qcom,overtemp_bat_decidegc = <0x15e>;
			qcom,iterm_disabled = <0x00>;
			sw_full_count = <0x19>;
			qcom,iterm_ma = <0x73>;
			qcom,recharge-mv = <0x64>;
			qcom,batt_capacity_mah = <0x10cc>;
			qcom,removed_bat_decidegc = <0xbe>;
			qcom,cold_bat_decidegc = <0x14>;
			qcom,temp_cold_vfloat_mv = <0xf8c>;
			qcom,temp_cold_fastchg_current_ma = <0x12c>;
			qcom,little_cold_bat_decidegc = <0x00>;
			qcom,temp_little_cold_vfloat_mv = <0x1153>;
			qcom,temp_little_cold_fastchg_current_ma_high = <0x44c>;
			qcom,temp_little_cold_fastchg_current_ma_low = <0x44c>;
			qcom,temp_little_cold_fastchg_current_ma = <0x44c>;
			qcom,pd_temp_little_cold_fastchg_current_ma_high = <0x79e>;
			qcom,pd_temp_little_cold_fastchg_current_ma_low = <0x546>;
			qcom,qc_temp_little_cold_fastchg_current_ma_high = <0x79e>;
			qcom,qc_temp_little_cold_fastchg_current_ma_low = <0x546>;
			qcom,cool_bat_decidegc = <0x32>;
			qcom,temp_cool_vfloat_mv = <0x1153>;
			qcom,temp_cool_fastchg_current_ma_high = <0x44c>;
			qcom,temp_cool_fastchg_current_ma_low = <0x44c>;
			qcom,pd_temp_cool_fastchg_current_ma_high = <0x7d0>;
			qcom,pd_temp_cool_fastchg_current_ma_low = <0x7d0>;
			qcom,qc_temp_cool_fastchg_current_ma_high = <0x7d0>;
			qcom,qc_temp_cool_fastchg_current_ma_low = <0x7d0>;
			qcom,little_cool_bat_decidegc = <0x78>;
			qcom,temp_little_cool_vfloat_mv = <0x1153>;
			qcom,temp_little_cool_fastchg_current_ma = <0x44c>;
			qcom,pd_temp_little_cool_fastchg_current_ma = <0x7d0>;
			qcom,qc_temp_little_cool_fastchg_current_ma = <0x7d0>;
			qcom,normal_bat_decidegc = <0xa0>;
			qcom,temp_normal_vfloat_mv = <0x1153>;
			qcom,temp_normal_fastchg_current_ma = <0x44c>;
			qcom,pd_temp_normal_fastchg_current_ma = <0x7d0>;
			qcom,qc_temp_normal_fastchg_current_ma = <0x7d0>;
			qcom,warm_bat_decidegc = <0x1c2>;
			qcom,temp_warm_vfloat_mv = <0x1022>;
			qcom,temp_warm_fastchg_current_ma = <0x226>;
			qcom,pd_temp_warm_fastchg_current_ma = <0x226>;
			qcom,qc_temp_warm_fastchg_current_ma = <0x226>;
			qcom,temp_warm_fastchg_current_ma_led_on = <0xfa>;
			qcom,hot_bat_decidegc = <0x212>;
			qcom,non_standard_vfloat_mv = <0xf8c>;
			qcom,non_standard_fastchg_current_ma = <0x200>;
			qcom,short_c_bat_cv_mv = <0x10ea>;
			qcom,short_c_bat_vfloat_mv = <0xed8>;
			qcom,short_c_bat_fastchg_current_ma = <0x200>;
			qcom,cold_vfloat_sw_limit = <0xf5a>;
			qcom,little_cold_vfloat_sw_limit = <0x1121>;
			qcom,cool_vfloat_sw_limit = <0x1121>;
			qcom,little_cool_vfloat_sw_limit = <0x1121>;
			qcom,normal_vfloat_sw_limit = <0x1121>;
			qcom,warm_vfloat_sw_limit = <0xff0>;
			qcom,non_standard_vfloat_sw_limit = <0xf5a>;
			qcom,short_c_bat_vfloat_sw_limit = <0xea6>;
			qcom,max_chg_time_sec = <0xef10>;
			qcom,charger_hv_thr = <0x26ac>;
			qcom,charger_recv_thr = <0x251c>;
			qcom,charger_lv_thr = <0xd48>;
			qcom,vbatt_full_thr = <0x1153>;
			qcom,vbatt_hv_thr = <0x11f8>;
			qcom,vfloat_step_mv = <0x08>;
			qcom,cold_vfloat_over_sw_limit = <0xf96>;
			qcom,little_cold_vfloat_over_sw_limit = <0x115d>;
			qcom,cool_vfloat_over_sw_limit = <0x115d>;
			qcom,little_cool_vfloat_over_sw_limit = <0x115d>;
			qcom,normal_vfloat_over_sw_limit = <0x115d>;
			qcom,warm_vfloat_over_sw_limit = <0x102c>;
			qcom,non_standard_vfloat_over_sw_limit = <0xf96>;
			qcom,vbatt_power_off = <0xce4>;
			qcom,vbatt_soc_1 = <0xcee>;
			qcom,vooc_project = <0x03>;
			qcom,vbatt_num = <0x02>;
			qcom,new_ui_warning_support;
			qcom,ffc_support;
			qcom,dual_ffc;
			recharge_after_full;
			qcom,normal_vterm_hw_inc = <0x12>;
			qcom,non_normal_vterm_hw_inc = <0x12>;
			qcom,ff1_normal_fastchg_ma = <0x226>;
			qcom,ff1_warm_fastchg_ma = <0x226>;
			qcom,ffc2_normal_fastchg_ma = <0x15e>;
			qcom,ffc2_temp_warm_decidegc = <0x15e>;
			qcom,ffc2_warm_fastchg_ma = <0x15e>;
			qcom,ffc2_temp_high_decidegc = <0x190>;
			qcom,ffc2_temp_low_decidegc = <0x78>;
			qcom,ff1_exit_step_ma = <0x96>;
			qcom,ff1_warm_exit_step_ma = <0x96>;
			qcom,ffc2_exit_step_ma = <0x96>;
			qcom,ffc2_warm_exit_step_ma = <0x96>;
			qcom,ffc_normal_vfloat_sw_limit = <0x115d>;
			qcom,ffc_temp_normal_vfloat_mv = <0x1194>;
			qcom,ffc_normal_vfloat_over_sw_limit = <0x1194>;
			qcom,ffc_warm_vfloat_sw_limit = <0x115d>;
			qcom,ffc_temp_warm_vfloat_mv = <0x1194>;
			qcom,ffc_warm_vfloat_over_sw_limit = <0x1194>;
			qcom,ffc2_normal_vfloat_sw_limit = <0x1158>;
			qcom,ffc2_temp_normal_vfloat_mv = <0x1194>;
			qcom,ffc2_normal_vfloat_over_sw_limit = <0x1194>;
			qcom,ffc2_warm_vfloat_sw_limit = <0x1153>;
			qcom,ffc2_temp_warm_vfloat_mv = <0x1194>;
			qcom,ffc2_warm_vfloat_over_sw_limit = <0x1194>;
			qcom,default_iterm_ma = <0x73>;
			qcom,default_temp_normal_fastchg_current_ma = <0x44c>;
			qcom,default_normal_vfloat_sw_limit = <0x1121>;
			qcom,default_temp_normal_vfloat_mv = <0x1153>;
			qcom,default_normal_vfloat_over_sw_limit = <0x115d>;
			qcom,default_temp_little_cool_fastchg_current_ma = <0x44c>;
			qcom,default_little_cool_vfloat_sw_limit = <0x1121>;
			qcom,default_temp_little_cool_vfloat_mv = <0x1153>;
			qcom,default_little_cool_vfloat_over_sw_limit = <0x115d>;
			qcom,vooc_show_ui_soc_decimal;
			qcom,ui_soc_decimal_speedmin = <0x14>;
			qcom,check_batt_full_by_sw;
			qcom,external_gauge;
			qcom,chg_ctrl_by_lcd;
			qcom,chg_ctrl_by_vooc;
			qcom,chg_ctrl_by_camera;
			qcom,support_ntc_01c_precision;
			qcom,sw_vfloat_over_protect_enable;
			qcom,support_abnormal_adapter;
			qcom,vbatt_pdqc_to_5v_thr = <0x1004>;
			qcom,vbatt_pdqc_to_9v_thr = <0xfa0>;
			qcom,chargerid_switch-gpio = <0xffffffff 0x19 0x00>;
			qcom,ship-gpio = <0xffffffff 0x6c 0x00>;
			qcom,dischg-gpio = <0xffffffff 0xa7 0x00>;
			qcom,ccdetect-gpio = <0xffffffff 0x06 0x00>;
			qcom,chgvin = <0xffffffff 0x6f 0x00>;
			qcom,pmic_chgfunc = <0xffffffff 0x8e 0x00>;
		};
	};

	fragment@69 {
		target = <0xffffffff>;

		__overlay__ {

			eint0default {
				phandle = <0x24>;
			};

			charger_gpio_as_output_low {
				phandle = <0x25>;

				pins_cmd_dat {
					pinmux = <0x1900>;
					slew-rate = <0x01>;
					output-low;
				};
			};

			charger_gpio_as_output_high {
				phandle = <0x26>;

				pins_cmd_dat {
					pinmux = <0x1900>;
					slew-rate = <0x01>;
					output-high;
				};
			};

			ship_sleep {
				phandle = <0x27>;

				pins_cmd_dat {
					pinmux = <0x6c00>;
					slew-rate = <0x01>;
					output-low;
				};
			};

			ship_active {
				phandle = <0x28>;

				pins_cmd_dat {
					pinmux = <0x6c00>;
					slew-rate = <0x01>;
					output-high;
				};
			};

			dischg_enable {
				phandle = <0x29>;

				pins_cmd_dat {
					pinmux = <0xa700>;
					slew-rate = <0x01>;
					output-high;
				};
			};

			dischg_disable {
				phandle = <0x2a>;

				pins_cmd_dat {
					pinmux = <0xa700>;
					slew-rate = <0x01>;
					output-low;
				};
			};

			chgvin_enable {
				phandle = <0x2b>;

				pins_cmd_dat {
					pinmux = <0x6f00>;
					slew-rate = <0x01>;
					output-low;
				};
			};

			chgvin_disable {
				phandle = <0x2c>;

				pins_cmd_dat {
					pinmux = <0x6f00>;
					slew-rate = <0x01>;
					output-high;
				};
			};

			pmic_chgfunc_enable {
				phandle = <0x2d>;

				pins_cmd_dat {
					pinmux = <0x8e00>;
					slew-rate = <0x01>;
					output-low;
				};
			};

			pmic_chgfunc_disable {
				phandle = <0x2e>;

				pins_cmd_dat {
					pinmux = <0x8e00>;
					slew-rate = <0x01>;
					output-high;
				};
			};

			ccdetect_active {
				phandle = <0x2f>;

				pins_cmd_dat {
					pinmux = <0x600>;
					input-enable;
					slew-rate = <0x00>;
					bias-disable;
				};
			};

			ccdetect_sleep {
				phandle = <0x30>;

				pins_cmd_dat {
					pinmux = <0x600>;
					input-enable;
					slew-rate = <0x00>;
					bias-disable;
				};
			};
		};
	};

	fragment@70 {
		target = <0xffffffff>;

		__overlay__ {
			FUELGAGUE_APPLY = <0x00>;
			DISABLE_MTKBATTERY = <0x01>;
		};
	};

	fragment@71 {
		target = <0xffffffff>;

		__overlay__ {

			vooc_ap_data {
				compatible = "mediatek, VOOC_AP_DATA-eint";
				interrupts = <0x62 0x02 0x62 0x00>;
				phandle = <0xa1>;
			};

			vooc_ap_data_new_function {
				compatible = "mediatek, VOOC_EINT_NEW_FUNCTION";
				phandle = <0xa2>;
			};
		};
	};

	fragment@72 {
		target = <0xffffffff>;

		__overlay__ {
			status = "okay";
			clock-frequency = <0x186a0>;
			scl-gpio-id = <0x86>;
			sda-gpio-id = <0x87>;

			bq27541-battery@55 {
				status = "okay";
				compatible = "oplus,bq27541-battery";
				reg = <0x55>;
				qcom,modify-soc-smooth;
				qcom,modify-soc-calibration;
				qcom,batt_bq28z610;
				qcom,sha1_key_index = <0x01>;

				zy,afi_data {
					battery,name = "BLP863";
					qmax_min = <0x6a0>;
					qmax_max = <0x986>;
					static_df_checksum_3e = [79 c0];
					static_df_checksum_60 = [0a 06];
					afi_buf_num = <0x07>;
					afi_buf_0 = [11 d0 11 17 11 d0 11 17 11 d0 11 17 11 d0 11 17 01 0a 8c 0a 0c 1c 21 34 02 ff ce 02 ec 78 02 ff ce 05 c2 0a c2 0a 72 a3 0a 0c d1 02 0c 9f 0d 03 02 0c d1 0a 79 02 0a ab 09 e3 02 0a 15 07 d0 07 08 07 08 00 02 09 c4 07 d0 d2 f0 00 02 03 e8 05 11 ee 05 0e 74 00 0a 01 f4 0a 07 08 0e 74 00 0a 01 f4 0a 00 0a 05 ff f6 05 0a 0a ab 0b 23 0b 73 0b a5 0b d7 0c d1 00 0a 00 58 00 2c 11 5d 00 84 01 60 01 08 11 5d 07 bc 0f a4 0b b0 11 5d 09 cc 11 88 0d c0 11 5d 03 f4 07 bc 05 d8 09 c4 0d 48 0e d8 0f a0 00 01 01 2c 01 2c 01 2c 01 2c 00 4b 03 84 28 01 65 01 6b 03 00 00 46 50 50 00 30 00 96 00 af 08 48 06 68 1e 3c 5a];
					afi_buf_1 = [64 63 64 61 00 01 01 02 05 21 1c 00 a2 40 05 57 20 00 00 03 00 00 0a f0 0a 28 14 0a 14 10 e0 64 07 d0 00 03 0f 00 14 04 19 c8 00];
					afi_buf_2 = [aa 21 10 03 ef 05 aa 07 85 09 24 0b 80 0d 40 0f 3c 11 3e 13 39 15 1b 17 b6 19 0c 3b 3c 7d f8 b5 00 33 22 4f 24 2b 26 e9 28 c7 2a 26 2c a3 2e 03 30 7d 32 7e 34 78 36 99 38 ec 1a 5e 5c 24 08 70 08 77 33];
					afi_buf_3 = <0x11381138 0x12cff38 0xfe20fed5 0xfc18006a 0x320032>;
					afi_buf_4 = [79 c0];
					afi_buf_5 = [ff 21 10 03 ef 05 aa 07 85 09 24 0b 80 0d 40 0f 3c 11 3e 13 39 15 1b 17 b6 19 0c 1b c6 5d cb e0 00 33 22 4f 24 2b 26 e9 28 c7 2a 26 2c a3 2e 03 30 7d 32 7e 34 78 36 99 38 0a 1a db 5c 57 01 01 00 00 00 00 00 14 00 0f 00 46 00 3c 00 3c 01 3c ff f6 fe 0c 32];
					afi_buf_6 = <0xe4ad202f 0x260c24e2 0x2acb08b4 0xef60c57 0x12251043 0x1659149f 0x1add183a 0xfda0ff25 0xc1f7c3f1 0xc5cbc74c 0xc9cecbee 0xcd8ecfee 0xd131f3ad 0xf508f74b 0xf902fb21 0xfde5ff28 0x811483d0 0x85b48708 0x89878b05 0x8d87effa 0x31e4cd28 0xcbcdc945 0xc789c53e 0xc3f0c1b0 0xdfa1dd29 0xdb88d9a9 0xd739d533 0xd3b7b127 0x8ffb8d47 0xabfa8978 0x78cc7a42 0x5c7d5e70 0xa04ea279 0xa4497952 0x575715e7 0xd3fed1ea 0xcf12cdfb 0x8b0fc94c 0xe7f5c536 0x414263be 0x1f7a7d13 0x7bbf5927 0x57aa753f 0x536c7110 0x4f954d77 0x4b7049f2 0x47d74500 0x9cfebe66 0x1fa01d23 0x1b671940 0x1766152c 0x134111cf 0x6fcd6de9 0x6ba9698f 0x7190594 0x2356fe5a 0xe0e1e220 0xe426e6fe 0xc86c8aeb 0xacacedeb 0x9010b3f3 0x78f5b6d4 0xe138013a 0xf0ddecff 0x8c2162a3 0xa4a1ce07 0x8a054b28 0x9814e04 0x10511213 0x75023692 0x5e5f5b5b 0x7c5d5f5e 0x6167e383 0xa4ca86a5 0x28306abc 0xec2d2ead 0x54312b73 0xe916ba76 0x5869dcfb 0x933d3ede 0xb041a3a3 0x3c454647 0x4849a72a 0x54de26e 0x1951b773 0x7d55b757 0x7059bfba 0x145d5e5f 0x60616263 0x6465c386 0x21694baa 0xa46d6e6f 0x70717273 0x74757677 0x78797a7b 0x7c7d7e7f 0x807e0283 0xe4c5c687 0xc8898a8b 0x8c8d4f8d 0x909efc99 0xd474b685 0x98809a82 0x1c9d5dff 0xa02da2fc 0x429a6be 0xc88961ab 0xf32f8ebd 0x153d12f8 0x14b5b6b7 0xcb20ce4 0xa5f012c>;
				};
			};

			sy6610_fastcg@06 {
				status = "okay";
				compatible = "oplus,sy6610-fastcg";
				reg = <0x06>;
				qcom,support_vooc_by_normal_charger_path;
				qcom,vooc_fw_update_newmethod;
				qcom,vooc-fw-type = <0x03>;
				qcom,vooc_reply_mcu_bits = <0x07>;
				qcom,parse_fw_from_dt;
				vooc,firmware_data = <0x20050020 0xd5000000 0xcb020000 0xf5010000 0x00 0x00 0x00 0x00 0x00 0x00 0x00 0xe1000000 0x00 0x00 0xe3000000 0xcd030000 0xe7000000 0xe9000000 0xeb000000 0xed000000 0xef000000 0xf1000000 0xf3000000 0xf5000000 0xf1210000 0x5220000 0xfb000000 0xfd000000 0xff000000 0x1010000 0x3010000 0xf12a0000 0x7010000 0x3d1d0000 0xa9220000 0xb52c0000 0xf010000 0x11010000 0x13010000 0x15010000 0x17010000 0x19010000 0x1d010000 0x1d010000 0x1f010000 0x21010000 0x23010000 0x25010000 0x3488546 0xf084f8 0x480047 0x71230000 0x20050020 0x14488047 0x14480047 0xfee7fee7 0xfee7fee7 0xfee7fee7 0xfee7fee7 0xfee7fee7 0xfee7fee7 0xfee7fee7 0xfee7fee7 0xfee7fee7 0xfee7fee7 0xfee7fee7 0xfee7fee7 0xfee7fee7 0xfee7fee7 0xfee7fee7 0xfee7fee7 0xfee7fee7 0xfee7fee7 0xfee70000 0xe5030000 0xc1000000 0x30b50b46 0x1460020 0x20220124 0x9e00d46 0xd5409d42 0x5d31d46 0x9540491b 0x25469540 0x40191546 0x521e002d 0xf1dc30bd 0x70b50024 0x25460028 0x1da0124 0x40420029 0x1da0125 0x4942fff7 0xddffac42 0xd04042 0x2c00d0 0x494270bd 0xd2b201e0 0x270401c 0x491efbd2 0x70470022 0xf6e710b5 0x13460a46 0x4461946 0xfff7f0ff 0x204610bd 0x321001d 0x401e0378 0x12021a43 0x491ef9d5 0x10467047 0x3460322 0x870000a 0x491c521e 0xfad51846 0x70470000 0x64c0125 0x64e05e0 0xe36807cc 0x2b430c3c 0x98471034 0xb442f7d3 0xfff76eff 0xb8320000 0xd8320000 0x4207146 0x84202d1 0xeff30880 0x1e0eff3 0x9800000 0x4a1047 0x8d020000 0x200349 0x9680122 0x12031140 0x80b7047 0x140 0x10b501f0 0xdbfd0446 0x10202040 0x2817d0 0x42001f0 0x9dfd1048 0x680028 0x7d102f0 0xc7fd0020 0xd490870 0x1200b49 0x8600c48 0x780228 0x2d100f0 0x45fc01e0 0xf092ff 0x1208002 0x20400028 0x5d00a20 0x1f080fd 0x1200449 0x87010bd 0x9c000020 0x5e000020 0x87000020 0x3d000020 0xbffee7 0xf8b50446 0xd461646 0x33462a46 0x21465520 0x1f0c0fd 0x7463846 0xf8bdf8b5 0x5461446 0x20786178 0x9020843 0x6463246 0x29465520 0x1f0acfe 0x7463846 0xf8bd7047 0xbf72b6 0xbf0548 0x690121 0x9038843 0x2490861 0xbf62b6 0xbf7047 0x140 0x6484068 0x1210903 0x88430449 0x48600846 0x698914 0x8430149 0x8617047 0x140 0xbf72b6 0xbf0548 0x690121 0x9038843 0x2490861 0xbf62b6 0xbf7047 0x140 0x3480069 0x1210903 0x88430149 0x8617047 0x140 0xbf72b6 0xbf0548 0x690121 0xc9028843 0x2490861 0xbf62b6 0xbf7047 0x140 0xbf72b6 0xbf0848 0x40680121 0xc9028843 0x5494860 0x8460069 0xc9140843 0x2490861 0xbf62b6 0xbf7047 0x140 0x6484068 0x121c902 0x88430449 0x48600846 0x69c914 0x8430149 0x8617047 0x140 0xbf72b6 0xbf0548 0x690121 0xc9028843 0x2490861 0xbf62b6 0xbf7047 0x140 0x4480068 0x2804d0 0x2480068 0x401e0149 0x8607047 0xa8000020 0x70470000 0x10b53748 0x880028 0x5d03548 0x88401e 0x33490880 0x15e07d20 0xc0003149 0x8803148 0x880028 0x4d02f48 0x88401e 0x2d490880 0x2d480088 0x2804d0 0x2b480088 0x401e2a49 0x8802a48 0x680028 0x4d02848 0x68401e 0x26490860 0x26480068 0x2804d0 0x24480068 0x401e2349 0x8602348 0x680028 0x4d02148 0x68401e 0x1f490860 0x1f480078 0x2804d0 0x1d480078 0x401e1c49 0x8701c48 0x680028 0x4d01a48 0x68401e 0x18490860 0x18480068 0x2804d0 0x16480068 0x401e1549 0x8601548 0x78401c 0x13490870 0x8460078 0xc8280edd 0x200870 0x10480078 0x2805d0 0x2001f0 0xb9fb0120 0xd490870 0x1200b49 0x87010bd 0x60000020 0x62000020 0x64000020 0x68000020 0x6c000020 0x70000020 0x74000020 0x78000020 0x7c000020 0x5e000020 0x4b000020 0x3c000020 0x30b47446 0x641e2578 0x641cab42 0x4d3635d 0x5b00e318 0x30bc1847 0x1d46f8e7 0x2805db 0xc206d20e 0x1219140 0x14a1160 0x70470000 0xe100e0 0x10b50028 0x19db1a4a 0x3231b02 0xd2188308 0x9b00d258 0x8307dc0e 0xff23a340 0x9a438b07 0x1b0e8407 0xe40ea340 0x1a43114b 0x3242402 0x1b198408 0xa4001a51 0x18e00e4a 0x3071b0f 0x83b9b08 0x9b00d258 0x8307dc0e 0xff23a340 0x9a438b07 0x1b0e8407 0xe40ea340 0x1a43054b 0x407240f 0x83ca408 0xa4001a51 0x10bd0000 0xe100e0 0x1ced00e0 0x10b50028 0x19db1a4a 0x3231b02 0xd2188308 0x9b00d258 0x8307dc0e 0xff23a340 0x9a438b07 0x1b0e8407 0xe40ea340 0x1a43114b 0x3242402 0x1b198408 0xa4001a51 0x18e00e4a 0x3071b0f 0x83b9b08 0x9b00d258 0x8307dc0e 0xff23a340 0x9a438b07 0x1b0e8407 0xe40ea340 0x1a43054b 0x407240f 0x83ca408 0xa4001a51 0x10bd0000 0xe100e0 0x1ced00e0 0x2e008c8 0x121f08c1 0x2afad1 0x70477047 0x2001e0 0x1c1121f 0x2afbd1 0x70470000 0x30b54268 0xd4cd502 0x23461033 0xe268002d 0x9dad35c 0x4367521c 0xe2600322 0xa700121 0x6170891e 0x7e0056f 0xd554e268 0x521ce260 0x4220a70 0x11044160 0x2030bd 0xec000020 0x10b54268 0x12030ad5 0x84c2346 0xe2681033 0xd35c4367 0x521ce260 0x122d204 0x42604068 0xc00101d5 0x5200870 0x2010bd 0xec000020 0x70b54268 0x5245203 0x2a16da 0xe4bda68 0x42a0ad2 0x56f1e46 0x10369555 0xda68521c 0xda600122 0x92044260 0x7e0084a 0x556f9615 0x35435567 0xc700222 0x5a704068 0xc00100d5 0xc700020 0x70bd0000 0xec000020 0xc00040 0x70b54268 0xd4b0e4c 0x520308d5 0x56f6268 0x9e183572 0x521c6260 0x1229204 0x42605868 0x62689042 0x7d10220 0x8700020 0x60600549 0x18694018 0x18610020 0x70bd0000 0xec000020 0xc000020 0x2020202 0x4268d202 0x3d50021 0xc9434160 0x7e04268 0x520306d5 0x1229204 0x42600120 0x8700020 0x70470120 0x70470000 0xb54068 0xb46c001 0x6d501f0 0xb9fd0020 0x2491870 0x4870c860 0x22000bd 0xec000020 0xf8b50546 0xf46fff7 0xbfe0726 0x3ce00024 0xbf72b6 0xbffff7 0xc3fd09e0 0x4b208001 0x844204d3 0xfff7fcfd 0xfff7aafd 0xf8bd641c 0xfff728fd 0x28f1d0 0xbf0020 0x2f490968 0x122d202 0x1140c80a 0xbfb040 0x29780843 0x2870fff7 0x85fd00bf 0x62b600bf 0xbf00bf 0xbf00bf 0xbf00bf 0xbf00bf 0xbf00bf 0xbf00bf 0xbf00bf 0xbf00bf 0xbf00bf 0xbf00bf 0xbf761e 0x2ec0da 0x2f02d0 0xfff790fd 0x11e0fff7 0x9dfd00bf 0xbf00bf 0x72b600bf 0x15480069 0x121c902 0x8431349 0x86100bf 0x62b600bf 0xbf00f0 0x8bfe0024 0xbf72b6 0xbffff7 0x6bfd09e0 0x4b208001 0x844204d3 0xfff7a4fd 0xfff752fd 0xa6e7641c 0xfff7d0fc 0x28f1d0 0xfff73afd 0xbf62b6 0xbf00f0 0x6ffe00bf 0x98e70000 0x140 0xf8b50746 0xf056fe 0x72533e0 0xbf72b6 0xbf0120 0xa8403840 0x2809d0 0xbf3248 0x690121 0xc9028843 0x2f490861 0xbf01e0 0xfff766fd 0x2400bf 0x2b480069 0x1210903 0x88432949 0x86100bf 0xae04b20 0x80018442 0x5d3fff7 0x65fdfff7 0x13fd0120 0xf8bd641c 0xfff790fc 0x28f0d0 0xfff7fafc 0xbf62b6 0xbf6d1e 0x2dc9da 0xfff752fd 0xbf00bf 0xbf00bf 0xbf00bf 0xbf00bf 0xbf00bf 0xbf00bf 0xf01efe 0x2400bf 0x72b600bf 0xfff7fefc 0xae04b20 0x80018442 0x5d3fff7 0x37fdfff7 0xe5fc0120 0xd0e7641c 0xfff762fc 0x28f0d0 0xbf0120 0x7490968 0xc2021140 0xc80a00bf 0x646fff7 0xc3fc00bf 0x62b600bf 0xf0f8fd 0x3046b9e7 0x140 0x10b5fff7 0xa7fc00bf 0xbf00bf 0xbf00bf 0xbf00bf 0xbf00bf 0xbf00bf 0xbf00bf 0xbf00bf 0xbf00bf 0xbf00bf 0xbf00bf 0x72b600bf 0xfff7eefc 0xbf00bf 0xbf00bf 0xbf00bf 0xbf00bf 0xbf00bf 0xbf00bf 0xfff790fc 0xbf62b6 0xbf10bd 0x10b500bf 0x72b600bf 0xfff7d6fc 0xbf00bf 0xbf00bf 0xbf00bf 0xbf00bf 0xbf00bf 0xbffff7 0x79fc00bf 0x62b600bf 0x10bd0000 0x10b50024 0xfff7aafc 0xbf00bf 0xbf00bf 0xbf00bf 0xbf00bf 0xbf00bf 0xbf00bf 0xfff752fc 0x9e04b20 0x80018442 0x4d3fff7 0xbbfcfff7 0x69fc10bd 0x641c00bf 0x2000bf 0xbf72b6 0xbf1249 0x9680122 0x12031140 0x80b00bf 0x62b600bf 0x28e4d0 0xbf00bf 0xbf00bf 0xbf00bf 0xbf00bf 0xbf00bf 0xbf00bf 0xbf00bf 0xbf00bf 0xbf00bf 0xbf00bf 0xbffff7 0x59fc00bf 0xd3e70000 0x140 0x10b50020 0x11498969 0x3221202 0x91430202 0x3231b02 0x1a401143 0xc4a9161 0xbf0221 0x42001f0 0x45fb0020 0x8498969 0x3229202 0x91438202 0x3239b02 0x1a401143 0x34a9161 0xbf0221 0x52001f0 0x33fb10bd 0x140 0x10b5fe48 0x780828 0xbda01f0 0xdff8fc49 0xfa4a1278 0x8854f948 0x78401c 0xf7490870 0x10bdf648 0x780828 0x26d10920 0xf3490870 0x2f06af8 0xf2480078 0x1281ed1 0xf0484078 0x281ad1 0xee488078 0x12816d1 0xec48c078 0xc000eb49 0x9798900 0x843e949 0x49794900 0x843e749 0x89790843 0xe6490870 0xe6480078 0x286dd1 0xe5490870 0x6ae0e148 0x780128 0x1ed1df48 0x40780028 0x1ad1dd48 0x80780028 0x16d1db48 0xc078c000 0xd9490979 0x89000843 0xd7494979 0x49000843 0xd5498979 0x843d549 0x8700020 0xd4490870 0x220d449 0x87047e0 0xcf484078 0x1281ed1 0xcd488078 0x281ad1 0xcb48c078 0x12816d1 0xc9480079 0xc000c849 0x49798900 0x843c649 0x89794900 0x843c449 0xc9790843 0xc3490870 0xc3480078 0x2801d1 0xc2490870 0x8ce7be48 0x40780128 0x1ed1bc48 0x80780028 0x1ad1ba48 0xc0780028 0x16d1b848 0x79c000 0xb6494979 0x89000843 0xb4498979 0x49000843 0xb249c979 0x843b249 0x8700020 0xb1490870 0x220b149 0x87069e7 0x2f09af8 0xaf480078 0x2814d1 0xae49c870 0x8714871 0x8871c871 0x8724872 0xab480078 0x22809d1 0xa4480078 0x7000e 0xa8490870 0x120a549 0x487100e2 0xa4480078 0x1280ad1 0xa3480078 0x9c490978 0x843a149 0x8700120 0x9d494871 0xf1e19f48 0x780528 0x16d19a48 0x807a9949 0xc8700846 0xc07a0871 0x846007b 0x48710846 0x407b8871 0x846807b 0xc8710846 0xc07b0872 0x846007c 0x4872d6e1 0x91480078 0x42809d1 0x88480078 0x7000c 0x8e490880 0x1208949 0x4871c8e1 0x8a480078 0x3280bd1 0x81480078 0x28849 0x9880843 0x86490880 0x1208149 0x4871b8e1 0x82480078 0x2280bd1 0x79480078 0x18049 0x9880843 0x7e490880 0x1207949 0x4871a8e1 0x7a480078 0x12815d1 0x79480088 0x70490978 0x8437749 0x88000f0 0x2bfb0120 0x70494871 0x74480088 0x72490988 0x884290d1 0x1207249 0x8708ee1 0x71480078 0x284cd0 0x6f480078 0x401ec100 0x81a6e49 0x968085c 0x6449c870 0x6a480078 0x401ec100 0x81a6949 0x9684018 0x40785f49 0x8716548 0x78401e 0xc100081a 0x63490968 0x40188078 0x59494871 0x5f480078 0x401ec100 0x81a5e49 0x9684018 0xc0785449 0x88715a48 0x78401e 0xc100081a 0x58490968 0x40180079 0x4e49c871 0x54480078 0x401ec100 0x81a5349 0x9684018 0x40794949 0x8724f48 0x78401e 0xc100081a 0x4d490968 0x40188079 0x43494872 0x3de13e48 0x780928 0xcd10020 0x40490870 0x41490870 0x44490870 0xf010ff 0x1204449 0x87079e6 0x203a49 0x8703b49 0x8703e49 0x8703248 0x780300 0xfff766fb 0xe080b86 0xa0d3e622 0x22222222 0x22f0ee22 0x1f096ff 0x62e63848 0x780028 0x13d03748 0x780028 0x6d10120 0x2949c870 0x8710872 0x487202e0 0x1202649 0x88713048 0x78c043 0x2e490870 0xfce02e48 0x780028 0xed00120 0x1f49c870 0x8714871 0x8871c871 0x8724872 0x27480078 0x401e2649 0x870e9e0 0x25480068 0x25498842 0x1da0024 0x7e02249 0x968224a 0x881a0a21 0xfff754f9 0x4466006 0xc00f1049 0xc870a006 0xc00f0871 0xe006c00f 0x48712007 0xc00f8871 0x6007c00f 0xc871a007 0xc00f0872 0xe007c00f 0x4872c3e0 0x48000020 0x40000020 0x4a000020 0x88000020 0x87000020 0x49000020 0x10020 0x4c000020 0x4d000020 0x4f000020 0x52000020 0x54000020 0x56000020 0x50000020 0x2c000020 0x3f000020 0x5d000020 0x86000020 0x80000020 0x38000020 0x4c0d0000 0x210846 0x2f0f8f8 0x78490870 0x8460078 0x22803d1 0x1207649 0x8710ae0 0x73480078 0x12803d1 0x72490871 0x487102e0 0x1207049 0x48717fe0 0x6f480078 0x4006c00f 0x6c49c870 0x6c480078 0x8006c00f 0x8716a48 0x78c006 0xc00f4871 0x67480078 0x7c00f 0x88716548 0x784007 0xc00fc871 0x62480078 0x8007c00f 0x8726048 0x78c007 0xc00f4872 0x205e49 0x8705c48 0x786421 0x4843ff30 0x2d305b49 0x8800a20 0x5a490870 0x4ce05a48 0x780028 0x7d00020 0x58490870 0x56480078 0x401e5549 0x8705548 0x784e49 0xc8700120 0x487139e0 0x3205249 0x8700120 0x49490871 0x887131e0 0x18e0ffe7 0x4e480078 0x2803d0 0x4d480078 0x2800d1 0x26e04a48 0x78401e 0x48490870 0x6204949 0x87000f0 0x60fe4849 0x87000f0 0x4ff917e0 0x46480078 0x401c4649 0x8704448 0x78801c 0x44490870 0x44480078 0x3449c870 0x43480078 0x8714348 0x784871 0x42480078 0x887100bf 0xbf2e49 0x404a1278 0x885c01f0 0xc5fd3e48 0x78401c 0x3c490870 0x8460078 0x92849dd 0x42000f0 0x8ffa01f0 0xa7fd0020 0x36490870 0x36490870 0x36490870 0x27480078 0x2805d0 0x25480078 0x401e2449 0x87033e0 0x25480078 0x2805d0 0x23480078 0x401e2249 0x87029e0 0x23480078 0x280ad0 0x21480078 0x401e2049 0x8702048 0x78401e 0x1e490870 0x1ae02548 0x780228 0x2d00428 0x13d10ae0 0xa480078 0x12805d1 0xf480078 0x12801d1 0xf090fd 0x7e00120 0xe490870 0xf0edfd 0x1a490870 0xbf00bf 0xbff1e4 0x94000020 0x10020 0x81000020 0x80000020 0x8a000020 0x8c000020 0x88000020 0x3e000020 0x4c000020 0x4e000020 0x5a000020 0x4f000020 0x5c000020 0x30000020 0x50000020 0x51000020 0x32000020 0x33000020 0x34000020 0x35000020 0x49000020 0x48000020 0x4b000020 0x4a000020 0x5b000020 0x10b54c48 0x780828 0xbda00f0 0x8ffd4a49 0x484a1278 0x88544748 0x78401c 0x45490870 0x10bd4448 0x780828 0x40d10920 0x41490870 0x1f01afd 0x40480078 0x12818d1 0x3e484078 0x2814d1 0x3c488078 0x12810d1 0x3a48c078 0xc0003949 0x9798900 0x8433749 0x49794900 0x8433549 0x89790843 0x34490870 0x1ee03248 0x40780128 0x18d13048 0x80780028 0x14d12e48 0xc0780128 0x10d12c48 0x79c000 0x2a494979 0x89000843 0x28498979 0x49000843 0x2649c979 0x8432649 0x870bbe7 0x1f09cfd 0x24480078 0x2821d1 0x1202349 0x88700020 0xc8700871 0x48718871 0xc8710872 0x48721c48 0x780428 0x2d00628 0xcd107e0 0x1b480078 0x1949c870 0x120c871 0x487206e0 0x1201649 0xc87002e0 0x1f078fd 0xbf00bf 0x1249114a 0x1278885c 0x1f0bcfc 0xe480078 0x401c0d49 0x8700846 0x780928 0xbdd0420 0xf086f9 0x1f09efc 0x200749 0x8700349 0x8700849 0x87000bf 0x76e70000 0x48000020 0x40000020 0x4a000020 0x49000020 0x10020 0x3e000020 0x4b000020 0x28480078 0x40022849 0x9784900 0x8432749 0x8802448 0x784006 0xc00f2549 0x48712148 0x788006 0xc00fc872 0x1e480078 0xc006c00f 0x8721c48 0x780007 0xc00f0874 0x19480078 0x4007c00f 0x88731748 0x788007 0xc00f4873 0x14480078 0xc007c00f 0xc8711348 0x784006 0xc00fc870 0x10480078 0x8006c00f 0x8730e48 0x78c006 0xc00f0871 0xb480078 0x7c00f 0x88720948 0x784007 0xc00f4872 0x6480078 0x8007c00f 0xc8730448 0x78c007 0xc00f8871 0x70470000 0x5b000020 0x5c000020 0x54000020 0x10020 0x3480088 0x3490840 0x1490880 0x70470000 0x52000020 0xfefe0000 0x10b50446 0x1f08cfb 0x204601f0 0xaffb80b2 0x10bd7047 0x70470000 0xf8b50546 0x260de0 0x6a460221 0x2846fef7 0x61ff0028 0xd107e0 0xf0c4f8 0x200090 0x701cc6b2 0x32eefdb 0xbf6946 0x48780002 0x9780843 0x4b2062d 0x2d10248 0x201804b2 0x2046f8bd 0x55f5ffff 0xfeb51ea0 0x680290 0x200090 0x1fe002aa 0x2213e20 0xfef747ff 0x646002e 0xfd100f0 0xb7f801aa 0x4214020 0xfef730ff 0x746002f 0xd10fe0 0xf092f8 0x200190 0x3e000f0 0x8df80020 0x1900098 0x401cc0b2 0x900098 0x328dcdb 0xbf6846 0x40790402 0x68460079 0x4436846 0xc0790502 0x69468979 0xd43ac42 0x1da2846 0xfebd2046 0xfce70000 0x71000000 0x10b50120 0xfff78cff 0x6c2809db 0x220fff7 0x87ff6c28 0x4db0320 0xfff782ff 0x6c2805da 0x8480078 0x401c0749 0x87002e0 0x200549 0x8700448 0x780928 0x1dd0120 0x10bd0020 0xfce70000 0x85000020 0x10b50446 0x2c02d0 0x2001f0 0x6df9054a 0x3210420 0xf0b8fd 0x2c02d0 0x12001f0 0x63f910bd 0x25020000 0x10b50446 0x2c02d0 0x2001f0 0x59f9054a 0x3210a20 0xf0a4fd 0x2c02d0 0x12001f0 0x4ff910bd 0x25020000 0x8b508e0 0x6490091 0xe000bf 0x994a1e 0x920029 0xf9d10146 0x401e0029 0xf2d108bd 0xc9290000 0x8b50620 0x9000e0 0xbf0098 0x411e0091 0x28f9d1 0x8bd10b5 0x220fff7 0xdfff10bd 0x8b50548 0x9000e0 0xbf0098 0x411e0091 0x28f9d1 0x8bd0000 0x620d0000 0x8b52c20 0x9000e0 0xbf0098 0x411e0091 0x28f9d1 0x8bd0000 0x8b50548 0x9000e0 0xbf0098 0x411e0091 0x28f9d1 0x8bd0000 0x37020000 0x10b50246 0x144603e0 0xfff7ecff 0x601ec4b2 0x2cf9dc 0x10bd7047 0x8ab00020 0x9900026 0x270890 0x7900690 0x5900490 0x3900290 0xe1204001 0xfe490880 0xc3208000 0xfd490880 0xfd48fe49 0x860fe49 0x8600a20 0xfd490870 0xefe201f0 0xe7fdfc48 0x680028 0x3ed15820 0x1f0ecfb 0x546f948 0x780028 0x31d11f2d 0x5d100f0 0x3fb0120 0xf4490870 0x1ce0002d 0x2d101f0 0x7ffb17e0 0xc2d04da 0xe8480088 0xef498842 0x2dd3f20 0x1900de0 0x22d07db 0xb2d05dc 0x681c8100 0x4018c0b2 0x19003e0 0x12d01d1 0xf200190 0xe6480078 0x2808d1 0xe5480278 0xe5480078 0x19901f0 0xeffae149 0x8707d20 0x1dc49 0x860a7e2 0xd7480068 0x2870d1 0xc20fff7 0x91fe0746 0xdc488742 0xbddfff7 0x5dff0c20 0xfff788fe 0x746d848 0x874202dd 0x592001f0 0x5fb3c46 0xbfcf48 0x780028 0x73d1d348 0x84420ada 0x898401c 0xc0b20890 0x8980328 0x5dd5420 0x1f0f2fa 0x1e00020 0x890cc48 0x84420add 0x498401c 0xc0b20490 0x4980728 0x5dd5920 0x1f0e2fa 0x1e00020 0x490c548 0x780128 0x53d1c448 0x68c449 0x884202dd 0x5200790 0x25e0c048 0x68c049 0x491f8842 0x2dd0420 0x7901ce0 0xbb480068 0xbb491439 0x884202dd 0x3200790 0x13e0b748 0x68b749 0x1e398842 0x2dd0220 0x7900ae0 0xb2480068 0xb2492839 0x884202dd 0x1200790 0x1e00020 0x790af48 0x844203dd 0x200690 0x7ae0bfe0 0xab486438 0x844202dd 0x1200690 0x72e0a848 0xc8388442 0x2dd0220 0x6906be0 0xa5488442 0x2dd0320 0x69065e0 0xa2486438 0x844203dd 0x4200690 0x5ee09ae0 0x5200690 0x5ae09948 0x780228 0x52d19848 0x689849 0x884202dd 0x5200790 0x25e09448 0x689449 0x491f8842 0x2dd0420 0x7901ce0 0x8f480068 0x8f491439 0x884202dd 0x3200790 0x13e08b48 0x688b49 0x1e398842 0x2dd0220 0x7900ae0 0x86480068 0x86492839 0x884202dd 0x1200790 0x1e00020 0x7908348 0x64308442 0x2dd0020 0x69021e0 0x7f488442 0x2dd0120 0x6901be0 0x7c486438 0x844202dd 0x2200690 0x14e07a48 0x64308442 0x2dd0320 0x6900de0 0x4b20c000 0x844202dd 0x4200690 0x6e00520 0x69003e0 0x200790 0x5200690 0x6990798 0x40180528 0xadd0398 0x401cc0b2 0x3900398 0x52805dd 0x5a2001f0 0x1dfa01e0 0x200390 0x67480088 0x844211dd 0x65480088 0x65498842 0xcdd6548 0x780028 0x5d06348 0x78401e 0x61490870 0x2e05520 0x1f004fa 0x58480068 0x58492439 0x88420fdd 0x5c488442 0xcdd4948 0x78401e 0x47490870 0x8460078 0x2806d1 0x552001f0 0xeff902e0 0xa204249 0x8707d20 0xc0003e49 0x86071e1 0x51480068 0x286dd1 0xfff780fd 0x6464f48 0x864203dc 0x7d200001 0x86420eda 0xfff724fe 0xfff774fd 0x6464948 0x864203dc 0x7d200001 0x864202da 0x592001f0 0xc9f93b48 0x6603148 0x780028 0x4fd12948 0x880028 0x7d13148 0x783f28 0x1edd3f20 0x2e490870 0x1ae02348 0x88ff21 0x2d318842 0x7da2a48 0x783f28 0x10dd3f20 0x27490870 0xce01c48 0x88ff21 0xe1318842 0x6da2348 0x783228 0x2dd3220 0x20490870 0x2e480078 0x2819d1 0x22480068 0x22492839 0x884207dd 0x1a480078 0x3f280fdd 0x3f201849 0x8700be0 0x1b480068 0x25498842 0x6dd1448 0x783f28 0x2dd3f20 0x11490870 0x15480068 0x1f496431 0x884242dd 0xd480078 0x3f2839e0 0x92e089e0 0x62000020 0x64000020 0x204e0000 0x6c000020 0x78000020 0x8d000020 0x70000020 0x5d000020 0x1e1c0000 0x80000020 0x59000020 0x82000020 0x10270000 0x30f8ffff 0x4c1d0000 0x36000020 0x38000020 0x8a110000 0xb6030000 0x8a020000 0x8a000020 0xfc080000 0x8c000020 0x1c0c0000 0x68000020 0x88130000 0x83000020 0x68100000 0x1ddd3f20 0x63490870 0x19e06348 0x682121 0xc9018842 0x7dd5f48 0x783f28 0xfdd3f20 0x5c490870 0xbe05c48 0x685c49 0x884206dd 0x58480078 0x3f2802dd 0x3f205649 0x8705848 0x780028 0x9d15748 0x2785748 0x1785148 0x7801f0 0xdbf85249 0x8705448 0x780228 0x8d14d48 0x684d49 0xd2318842 0x2dd5a20 0x1f000f9 0x48480068 0x4d498842 0x2dd5a20 0x1f0f8f8 0x44480068 0x49490a39 0x88420add 0x998401c 0xc0b20990 0x9980528 0x5dd5a20 0x1f0e8f8 0x1e00020 0x990ff20 0xf5304149 0x8606be0 0x40480068 0x281fd1 0x620fff7 0x55fc0446 0x3d480078 0x2812d1 0x2c03dd 0xff20f530 0x84420add 0x598401c 0xc0b20590 0x5980228 0x5dd5c20 0x1f0c4f8 0x1e00020 0x590ff20 0xf5303049 0x86047e0 0x30480068 0x281ed1 0x2d480078 0x280ed1 0xfff792fc 0x2805d0 0x2000f0 0x61f80120 0x27490870 0x19204001 0x26490860 0x30e00298 0x2804d1 0x5d2001f0 0x33f90120 0x2902248 0x20490860 0x24e02148 0x780028 0x20d12048 0x880028 0x6d11a48 0x780028 0x2d15a20 0x1f08af8 0x1b480078 0x2803d0 0x592001f0 0x83f80ae0 0x18480078 0x2803d1 0x17480078 0x12802dd 0x542001f0 0x77f81420 0xf490870 0x2f20fff7 0xe7fc0ee5 0x82000020 0x38000020 0x7c100000 0x80000020 0x59000020 0x58000020 0x8e000020 0x94110000 0x68000020 0x78000020 0x5d000020 0x7c000020 0x10270000 0x74000020 0x62000020 0x3f000020 0x3c000020 0x89000020 0x2808d0 0x849c969 0x1221204 0x91438918 0x54ad161 0x6e00449 0xc9690122 0x12049143 0x14ad161 0x70470000 0x240 0x348c069 0x1210904 0x88430149 0xc8617047 0x240 0x1460029 0x8d00129 0x15d10c48 0x684207 0x520f0b48 0xd0407047 0x8480068 0x8006400f 0x2801d1 0x748f6e7 0x4480068 0x8006420f 0x348d040 0xefe70248 0xede70000 0x240 0x24f400 0x127a00 0x10b50520 0xf098f8 0x2801d0 0x12010bd 0x20fce7 0x10b50920 0xf08ef8 0x2801d0 0x12010bd 0x20fce7 0x348c069 0xc003c00f 0x1214840 0x70470000 0x240 0x704710b5 0x1208007 0xf090fa 0xc4b26406 0x640e2046 0x10bd0000 0x4498969 0x89088900 0x8207920f 0x1143014a 0x91617047 0x140 0x5498969 0xc229143 0x82000c23 0x1a401143 0x14a9161 0x70470000 0x140 0x70b50b48 0x856b0024 0xee00120 0xa0402840 0x2808d0 0xa0000749 0x8580028 0x3d0a100 0x44a5058 0x8047641c 0x102ceed3 0x70bd0000 0x140 0xac000020 0x102804da 0x1218140 0x34a9163 0x3e00021 0xc943014a 0x91637047 0x140 0x10b50246 0x102a01da 0x104800e0 0x10bd00bf 0x72b600bf 0x290ad1 0x3690124 0x9440a343 0x3618368 0x1249440 0x23438360 0x9e08368 0x1249440 0x23438360 0x3690124 0x94402343 0x36100bf 0x62b600bf 0xbfdfe7 0x140 0x148806b 0x70470000 0x140 0x10b50146 0x102901da 0xa4a01e0 0x2010bd 0xbf72b6 0xbf1068 0x1248c40 0x20400028 0x1d00120 0xe00020 0x34600bf 0x62b600bf 0x1846ece7 0x140 0xffb581b0 0x4461546 0x1e461148 0x4700120 0xf494870 0x891c02a8 0xfef7bef9 0xc488571 0xc11d3046 0xfef7b8f9 0x948c01d 0xfef7aaf9 0x900748 0x81790098 0xfef799f9 0x44800f0 0x4ff80746 0xf09df8 0x384605b0 0xf0bd0000 0x11010020 0x10b500bf 0x1f480068 0x40084000 0x1d490860 0x8460068 0x4218843 0x1a490860 0xbf0020 0x19498969 0x3229205 0x91438205 0x3239b05 0x1a401143 0x144a9161 0xbf00bf 0x11468969 0x9a009143 0x2069b00 0x1a401143 0xe4a9161 0xbf0221 0xc2000f0 0x3bf90221 0xb2000f0 0x37f90021 0xc2000f0 0x69f90021 0xb2000f0 0x65f90021 0xc20fff7 0x4fff0021 0xb20fff7 0x4bff10bd 0xc00040 0x140 0x70b50446 0xfef764fd 0x21784906 0x80efef7 0xbbfc0128 0x3d1fef7 0x73fd0120 0x70bd0025 0xde0a01c 0xfef73ef9 0x465d3046 0xfef7acfc 0x12803d1 0xfef764fd 0x120efe7 0x6d1c6078 0xa842eed8 0xfef716fd 0x21784900 0x491cc8b2 0xfef79afc 0x12803d1 0xfef752fd 0x120dde7 0x2517e0 0xe01dfef7 0x1df90646 0xa079401e 0xa84201d1 0x12000e0 0x200146 0x3046fef7 0x3fce01d 0xfef70ef9 0x461ce11d 0x3046fef7 0x13f96d1c 0xa079a842 0xe4d8fef7 0x31fd0020 0xbce77047 0x70b50546 0xfef712fd 0x29784906 0x80efef7 0x69fc0128 0x3d1fef7 0x21fd0120 0x70bd0024 0xde0a81c 0xfef7ecf8 0x65d3046 0xfef75afc 0x12803d1 0xfef712fd 0x120efe7 0x641c6878 0xa042eed8 0x240de0 0xe81dfef7 0xd9f8065d 0x3046fef7 0x47fc0128 0x3d1fef7 0xfffc0120 0xdce7641c 0xa879a042 0xeed8fef7 0xf7fc0020 0xd4e70000 0x37b50446 0xb480470 0x1200a49 0x4870891c 0x1a8fef7 0xc5f80220 0x6498871 0xc91d02a8 0xfef7bef8 0x348fff7 0xb1ff0546 0xfff7adff 0x28463ebd 0x11010020 0xf8b50546 0xe461746 0x102d01da 0x364c00e0 0xf8bd0021 0x2846fff7 0x91fe002e 0x6d0012e 0xfd0022e 0x18d0032e 0x2cd120e0 0xa06a0121 0xa9408843 0xa062206b 0x121a940 0x88432063 0x21e0a06a 0x121a940 0x843a062 0x206b0121 0xa9408843 0x206316e0 0xa06a0121 0xa9408843 0xa062206b 0x121a940 0x8432063 0xbe0a06a 0x121a940 0x843a062 0x206b0121 0xa9400843 0x206300e0 0xc4e700bf 0xa8001849 0xf50e16b 0x120a840 0x8143e163 0x206a0121 0xa9400843 0x20621120 0x280cdb 0x11490968 0xc306db0e 0x1229a40 0x11400029 0x1d00121 0x2e00021 0xe00021 0x290dd1 0x11200028 0x5dbc206 0xd20e0121 0x9140064a 0x116000bf 0x211120 0xfef7faf9 0xbf93e7 0x140 0xac000020 0xe100e0 0x10b50246 0x102a01da 0x174800e0 0x10bd0029 0x4d00129 0xdd00229 0x21d115e0 0x436c0124 0x94402343 0x4364836c 0x1249440 0xa3438364 0x16e0436c 0x1249440 0xa3434364 0x836c0124 0x94402343 0x83640be0 0x436c0124 0x9440a343 0x4364836c 0x1249440 0xa3438364 0xe000bf 0xbf00bf 0xd2e70000 0x140 0x10b50246 0x102a01da 0xb4800e0 0x10bd00bf 0x72b600bf 0x12905d1 0x43680124 0x94402343 0x436004e0 0x44680123 0x93409c43 0x446000bf 0x62b600bf 0xbfe9e7 0x140 0x10b50120 0x8107c860 0x1480068 0x804710bd 0x4000020 0x10b50120 0x249c860 0x2480068 0x804710bd 0x100040 0x8000020 0x1464868 0x70470146 0x868c007 0xc00f7047 0xf8b50446 0xe461546 0x120fff7 0x19fd7d21 0xc9000090 0xfdf776ff 0x70430746 0xa7606760 0x20c043 0xe0602068 0x8218843 0x8302060 0xc8068442 0x9d10a48 0x5600221 0x820fef7 0x9bf90820 0xfef750f9 0x8e00648 0x5600221 0x920fef7 0x91f90920 0xfef746f9 0xf8bd0000 0x4000020 0x8000020 0x1684908 0x4900491c 0x1607047 0x10b5fff7 0xe9fd10bd 0xd484168 0xd4bc901 0xed54168 0xc9030bd4 0x21c943 0x4160416f 0x82159143 0x4167084a 0x215170 0xd1601970 0x1978044a 0x89000832 0x52580249 0x10470000 0xc00040 0xc000020 0xec000020 0x1210d4a 0xb488904 0x1160bff3 0x4f8fbff3 0x6f8f5117 0x4160416f 0x82159143 0x41670021 0x81600168 0x49084900 0x1600168 0x4229143 0x1607047 0xc00040 0x80e100e0 0xc480d49 0x896b0029 0x8d00b49 0x896b3f22 0x12021140 0x90a094a 0x11610ae0 0x8494160 0x8490160 0x81683f22 0x12021140 0x90a034a 0x11617047 0x300040 0x240 0xe00040 0x2000080 0x14f4c46 0xf348c069 0x1210904 0x8843f149 0xc8610846 0xc0691021 0x8843ee49 0xc861fff7 0xcdff00f0 0x2bfafef7 0x81fb00f0 0x35fe00f0 0x26fafff7 0x7fff0020 0xfff7a6f8 0x12000f0 0x3fa5320 0xf0a4fd 0x5462d07 0x2d0f002d 0x1d10a24 0x11e0012d 0x1d13c24 0xde0022d 0x1d18224 0x9e0032d 0x1d1aa24 0x5e0042d 0x2d1ff24 0x53400e0 0xa24322c 0xbdb782c 0x9dad548 0xd5490860 0x420d549 0x8700220 0xd4490870 0x34e0782c 0xbdba02c 0x9dad248 0xce490860 0x620ce49 0x8700120 0xcf490870 0x26e0a02c 0xbdbfa2c 0x9dacd48 0xc7490860 0x620c749 0x8700120 0xc8490870 0x18e0fa2c 0xddbff20 0xaf308442 0x9dac648 0xbf490860 0x620bf49 0x8700220 0xc0490870 0x8e0c248 0xba490860 0x420ba49 0x8700220 0xb9490870 0xb7490878 0xc10f0918 0x4910bc4a 0x11701046 0x780821 0x840c010 0xb9490870 0x10460078 0x4210840 0x8010b749 0x8701046 0x780221 0x8404010 0xb4490870 0x10460078 0xc007c00f 0xb2490870 0xf06efc 0xf084fc 0xf094fb 0xf06afb 0x20fff7 0x3f800bf 0xfff77df8 0xf088fc 0x28f9d0 0xf079fe 0x15e000f0 0x7bfea748 0x780028 0x1d000f0 0x25fca548 0x780128 0x4d1a448 0x780128 0xd105e0 0xa2480078 0x2800d1 0xe0e8e7 0xbf0120 0x9f490870 0xfef751ff 0x522000f0 0x69fc0546 0x1209c49 0x870002d 0x1d100f0 0x5fc00f0 0x53fe5e20 0xf05cfc 0x546022d 0x1d000f0 0xfbfb00f0 0x49fefff7 0x8f800f0 0x45fe9248 0x7800f0 0x4dfc0546 0x22d01d0 0xf0ecfb 0xf03afe 0xf038fe 0x8b480078 0x2803d0 0xfef74aff 0x89490860 0xfef7efff 0x86480078 0x2803d0 0x2c20fef7 0x1bffc6b2 0x552e25dd 0xfa2c05db 0x14208249 0x8708249 0x8708ae0 0xa02c05db 0xf207e49 0x8707e49 0x87082e0 0x782c05db 0xf207a49 0x8707a49 0x8707ae0 0x322c05db 0xa207649 0x8707649 0x87072e0 0xa207349 0x8707349 0x8706ce0 0x4b2e25dd 0xfa2c05db 0x1e206e49 0x8706e49 0x87062e0 0xa02c05db 0x19206a49 0x8706a49 0x8705ae0 0x782c05db 0x14206649 0x8706649 0x87052e0 0x322c05db 0xa206249 0x8706249 0x8704ae0 0xa205f49 0x8705f49 0x87044e0 0x322e25dd 0xfa2c05db 0x28205a49 0x8705a49 0x8703ae0 0xa02c05db 0x28205649 0x8705649 0x87032e0 0x782c05db 0x1e205249 0x8705249 0x8702ae0 0x322c05db 0xf204e49 0x8704e49 0x87022e0 0xa204b49 0x8704b49 0x8701ce0 0xa02c05db 0x3f204749 0x8704749 0x87014e0 0x782c05db 0x32204349 0x8704349 0x8700ce0 0x322c05db 0x18203f49 0x8703f49 0x87004e0 0x14203c49 0x8703c49 0x870fef7 0x50fffff7 0x1bfb5820 0xf096fb 0x1203849 0x8703048 0x780028 0x24d122e0 0xf080fd 0x34480068 0x280ad1 0x582000f0 0x85fb0028 0x1d100f0 0x25fb3048 0x2e490860 0x11e02f48 0x780028 0xdd12048 0x780028 0x3d12348 0x780128 0x2dd5420 0xf0dafa 0x14202749 0x870dbe7 0xce000f0 0x5bfd1748 0x780028 0x3d11a48 0x780128 0x2dd5420 0xf0c8fa 0xfff7d2fa 0x128eed0 0xfef744ff 0x240 0x1c320000 0x2c000020 0x30000020 0x8e000020 0x38320000 0x36000020 0x62320000 0x8c320000 0x320000 0x31000020 0x32000020 0x33000020 0x34000020 0x35000020 0x3c000020 0x56000020 0x51000020 0x87000020 0x57000020 0x89000020 0x4d000020 0x38000020 0x81000020 0x82000020 0x3e000020 0x70000020 0x70170000 0x74000020 0x2809d0 0xa490978 0x2905d1 0xbf62b6 0xbf0749 0x8700ae0 0x2808d1 0x4490978 0x2904d0 0xbf72b6 0xbf0149 0x8707047 0xa4000020 0x704710b5 0xfff734fa 0xf016fa 0xf0ecf9 0xf0f4f9 0xf0caf9 0xfef7dafd 0x10bd0000 0x70b50646 0x1c4d1d4c 0x120fff7 0x79fa062e 0xbd1e069 0x1214904 0x88434018 0xe061e069 0x89008843 0x4018e061 0x16e06968 0x901890e 0x10221143 0x89053f22 0x92051140 0x8466968 0x91430143 0x6960e069 0x1214904 0x8843e061 0xe0698900 0x8843e061 0x69688905 0x890e1022 0x11430901 0x3f221201 0x11400846 0x69689143 0x1436960 0x70bd0000 0x700040 0x240 0x70b50646 0x174c184d 0x120fff7 0x45fa072e 0x6d1e869 0x1218904 0x88434018 0xe86112e0 0x61680901 0x890e2022 0x11438905 0x3f229205 0x11400846 0x61689143 0x1436160 0xe8690121 0x89048843 0xe8616168 0x8905890e 0x20221143 0x9013f22 0x12011140 0x8466168 0x91430143 0x616070bd 0x700040 0x240 0x70b50246 0x31493248 0x1300fdf7 0xfbfd0805 0x6070809 0xa1a344a 0xbf00bf 0xbf00bf 0xbf4c68 0xa405a40e 0x1259540 0xac432401 0x3f252d01 0x2c402346 0x4c68ac43 0x1c434c60 0x42e04c68 0xa405a40e 0x951e0126 0xae40b443 0x24013f25 0x2d012c40 0x23464c68 0xac431c43 0x4c60c369 0x1246404 0xa343c361 0xc369a400 0xa343c361 0x28e04c68 0xa405a40e 0x951e0126 0xae40b443 0x24013f25 0x2d012c40 0x23464c68 0xac431c43 0x4c60c369 0x124a404 0xa343c361 0x12e04b68 0x3f242401 0xa3434b60 0xc3690124 0x6404a343 0xc361c369 0xa400a343 0xc361c369 0x6410a343 0xc36100bf 0xbf70bd 0x700040 0x240 0x70b50546 0x3c4c2b00 0xfdf792fd 0x91a2a49 0x4a696e6a 0x6f067300 0x60683f21 0x89058843 0x1f21c905 0x40186060 0x60683f21 0x9010843 0x60600120 0xfff784f9 0x120fff7 0x8df959e0 0x61688905 0x890e0122 0xaa401143 0x9013f22 0x12011140 0x8466168 0x91430143 0x616049e0 0x61680901 0x890e0122 0xaa401143 0x89053f22 0x92051140 0x8466168 0x91430143 0x61606168 0x8905890e 0x122aa40 0x11430901 0x3f221201 0x11400846 0x61689143 0x1436160 0x2ae000bf 0x61680901 0x890e0122 0xaa401143 0x89053f22 0x92051140 0x8466168 0x91430143 0x61606168 0x8905890e 0x122aa40 0x11430901 0x3f221201 0x11400846 0x61689143 0x1436160 0xae000bf 0x2846fff7 0xadfe05e0 0xbf2846 0xfff7e8fe 0xe000bf 0xbf70bd 0x700040 0x7480849 0x9780129 0xd17047 0x121054a 0x11700549 0x41600021 0xc943c160 0xbff4e7 0x700040 0x20 0x10c0000 0x649ca68 0xca604023 0x1340002b 0x4d00020 0xe0401c 0x528fcd9 0x70470000 0x700040 0x70b50446 0x1e4d082c 0x1db0020 0x70bd2046 0xfff752ff 0xbf1a48 0x684008 0x4000401c 0x17490860 0xbf6423 0x220421 0x284600f0 0x2bfb0028 0x22d02046 0xfff7d4fe 0x62c09d1 0xa01e8100 0x28461030 0x40588605 0xb60d0a20 0x464311e0 0x72c09d1 0xa01e8100 0x28461030 0x40588605 0xb60d0620 0x464305e0 0xa1002846 0x10304058 0x8605b60d 0x3046c7e7 0x20c5e7 0x700040 0x10b50021 0x420fff7 0xf9f810bd 0x10b50021 0x420fff7 0x5fb0121 0x420fff7 0xeff810bd 0x10b50446 0x2c04d0 0x1210420 0xfff7f8fa 0x3e00021 0x420fff7 0xf3fa10bd 0x10b50021 0xa20fff7 0xb7fa0021 0xa20fff7 0xd7f810bd 0x10b50021 0x520fff7 0xd1f810bd 0x10b50021 0x520fff7 0xddfa0121 0x520fff7 0xc7f810bd 0x10b50446 0x2c04d0 0x1210520 0xfff7d0fa 0x3e00021 0x520fff7 0xcbfa10bd 0x10b50021 0x920fff7 0xb3f810bd 0x10b50021 0x920fff7 0xbffa0121 0x920fff7 0xa9f810bd 0x10b50446 0x2c04d0 0x1210920 0xfff7b2fa 0x3e00021 0x920fff7 0xadfa10bd 0x30b50346 0x10480478 0x10480078 0x984201dd 0xe480370 0xe480170 0xe480270 0x914200da 0xa460a48 0x789042 0x2dd0748 0x27003e0 0x6480078 0x44d2870 0x3480078 0x844201d0 0x52030bd 0x20fce7 0x81000020 0x82000020 0x58000020 0x59000020 0x2480169 0x2690a43 0x2617047 0xa00040 0x10b50446 0xf084fa 0x20fef7 0xadfffff7 0x87ff2046 0xf088f8 0xf02af8 0x10bd0000 0x70b50446 0x20fef7 0xbfff6043 0x54600bf 0xb480c49 0x86000bf 0xb480560 0x45600320 0x9498860 0x9480068 0x40218843 0x40300749 0x86000bf 0x200349 0x86000bf 0x70bd0000 0x51e5cc1a 0x8c0040 0x800040 0x240 0xbf00bf 0xbf00bf 0xbfbff3 0x4f8f00bf 0xbf00bf 0x6480749 0xc86000bf 0xbf00bf 0xbff34f8f 0xbf00bf 0xbf00bf 0xbffde7 0x400fa05 0xed00e0 0x10b50748 0x780228 0x9d00548 0x780128 0x3d10220 0x2490870 0x1e0fff7 0xd5ff10bd 0x89000020 0x10b50024 0xfff704ff 0xbf0de0 0x20fff7 0x9ff0120 0xfef704fc 0x120fff7 0x3ff0320 0xfef7fefb 0x601cc4b2 0x1e2cefdb 0x10bd0000 0x10b5034a 0x1218807 0xfff730fa 0x10bd0000 0xe9030000 0x10b50120 0x8007fff7 0x5bfa10bd 0x10b50120 0x8007fff7 0x1cfa10bd 0xfeb50546 0x2700f0 0xeff90195 0x203e49 0x870fff7 0x15fffef7 0xbbfb0020 0xfff71aff 0xfef7a3fb 0x120fff7 0x15ff0024 0x1fe03748 0x780028 0x3d0582d 0x1d1fff7 0xddfe00f0 0xd3f900bf 0x30480078 0x28fbd0 0xf0ccf9 0x620011b 0x1980841 0xc007c00f 0x900098 0xfff7f8fe 0x202849 0x870601c 0xc4b2072c 0xdddb00f0 0xb9f90024 0x28e02448 0x780028 0x3d0582d 0x1d1fff7 0xb7fe00f0 0xadf900bf 0x1d480078 0x28fbd0 0xf0a6f9 0x2c03d1 0xfff7c8fe 0xfef774fb 0x201749 0x870fef7 0x15ff0646 0x62c07d0 0x2c05d0 0x520011b 0x30468840 0x3843c7b2 0x601cc4b2 0x72cd4db 0xf08af9 0xbf0c48 0x780028 0xfbd000f0 0x83f9fff7 0xadfefef7 0x53fb0020 0xfff7b2fe 0x200549 0x870fef7 0x38fbfef7 0x36fb00f0 0x73f93846 0xfebd0000 0x3d000020 0x3c000020 0xfeb50546 0x2700f0 0x67f90195 0x203c49 0x870fff7 0x8dfefef7 0x33fb0020 0xfff792fe 0xfef71bfb 0x120fff7 0x8dfe0024 0x1fe03548 0x780028 0x3d0582d 0x1d1fff7 0x55fe00f0 0x4bf900bf 0x2e480078 0x28fbd0 0xf044f9 0x620011b 0x1980841 0xc007c00f 0x900098 0xfff770fe 0x202649 0x870601c 0xc4b2072c 0xdddb00f0 0x31f90024 0x24e02248 0x780028 0x3d0582d 0x1d1fff7 0x2ffe00f0 0x25f900bf 0x1b480078 0x28fbd0 0xf01ef9 0x2c03d1 0xfff740fe 0xfef7ecfa 0x201549 0x870fef7 0x8dfe0646 0x620011b 0x30468840 0x3843c7b2 0x601cc4b2 0x72cd8db 0xf006f9 0xbf0c48 0x780028 0xfbd000f0 0xfff8fff7 0x29fefef7 0xcffa0020 0xfff72efe 0x200549 0x870fef7 0xb4fafef7 0xb2fa00f0 0xeff83846 0xfebd0000 0x3d000020 0x3c000020 0x202949 0x8702949 0x8702949 0x8702949 0x8700120 0x28490870 0x204870 0x88702749 0x8702749 0x8702749 0x8702749 0x8700320 0x26490870 0x202649 0x8702649 0x8702649 0x8702649 0x880401e 0x25490880 0x202549 0x8702549 0x8703f20 0x24490870 0x24490870 0x202449 0x8702449 0x8702449 0x8703f20 0x23490870 0x23490870 0x1202349 0x8702349 0x8700020 0x22490870 0x22490870 0x2202249 0x8700320 0x21490870 0x202149 0x8702149 0x8702149 0x8707047 0x3c000020 0x3e000020 0x3f000020 0x48000020 0x10020 0x49000020 0x4b000020 0x4c000020 0x4d000020 0x4e000020 0x4f000020 0x50000020 0x51000020 0x52000020 0x54000020 0x56000020 0x57000020 0x58000020 0x59000020 0x5a000020 0x5d000020 0x80000020 0x81000020 0x82000020 0x83000020 0x84000020 0x85000020 0x86000020 0x87000020 0x88000020 0x89000020 0x8e000020 0x36000020 0xf8b500bf 0xbf00bf 0xbf0720 0xfef732f9 0x4000ff30 0xff300230 0x7d21c900 0x48430746 0x1049fdf7 0x3f80446 0x620fef7 0x23f94000 0xff30ff30 0x2307d21 0xc9004843 0x7460949 0xfcf7f4ff 0x546641b 0x6426c820 0x90b442 0x1da0020 0xf8bd0098 0x844201dd 0x220f9e7 0x120f7e7 0xff030000 0x78b50446 0xd461e46 0x7d20c000 0x70430090 0xbf2068 0x28409042 0x1d10120 0x78bd0098 0x401e0090 0xfef7c0f9 0x980028 0xf1d100bf 0xf4e710b5 0x120fff7 0x89fd10bd 0xbf0748 0x7490860 0xbf00bf 0x1200649 0xc86000bf 0xbf0020 0x2490860 0xbf7047 0x51e5cc1a 0x8c0040 0x800040 0x01 0x1010001 0x101 0x1000000 0x10001 0x10100 0x10100 0x100 0x1000001 0x101 0x1000000 0x10001 0x10100 0x10100 0x10001 0x01 0x101 0x1000000 0x1010100 0x10100 0x1000001 0x01 0x10001 0x1000101 0x01 0x10000 0x10001 0x100 0x101 0x1000001 0x1000100 0x10000 0x10001 0x10100 0x1010000 0x10001 0x01 0x10000 0x1000000 0x1010100 0x10100 0x1000001 0x01 0x10101 0x1000101 0x00 0xd8320000 0x20 0xac000000 0x1c060000 0x84330000 0xac000020 0x74040000 0x2c060000 0x00 0x00 0x00 0x00 0x00 0x45070000 0xfd060000 0x3d060000 0x7d060000 0xad060000 0x6d070000 0x00 0x00 0x00 0x00 0x00 0x00 0x00 0x00 0x00 0x00 0x00 0x00 0x00 0x00 0x00 0x00 0x00 0x00 0x00 0x00 0x00 0x00 0x00 0x00 0x00 0x00 0x00 0x00 0x00 0x20001 0x8010400 0xb345534>;
				qcom,vooc-low-temp = <0x00>;
				qcom,vooc-high-temp = <0x1ae>;
				qcom,vooc-low-soc = <0x01>;
				qcom,vooc-high-soc = <0x5a>;
				qcom,vooc-little-cool-temp = <0xa0>;
				qcom,vooc-cool-temp = <0x78>;
				qcom,vooc-little-cool-to-normal-temp = <0xb4>;
				qcom,vooc-normal-to-little-cool-current = <0x05>;
				qcom,vooc_cool_bat_volt = <0xd7a>;
				qcom,vooc_little_cool_bat_volt = <0xd48>;
				qcom,vooc_normal_bat_volt = <0xd16>;
				qcom,vooc_warm_bat_volt = <0xce4>;
				qcom,vooc_cool_bat_suspend_volt = <0xd7a>;
				qcom,vooc_little_cool_bat_suspend_volt = <0xd48>;
				qcom,vooc_normal_bat_suspend_volt = <0xd16>;
				qcom,vooc_warm_bat_suspend_volt = <0xce4>;
				qcom,vooc_multistep_adjust_current_support;
				qcom,vooc_multistep_initial_batt_temp = <0x3e8>;
				qcom,vooc_strategy_normal_current = <0x0c>;
				qcom,vooc_batt_over_high_temp = <0x1b8>;
				qcom,vooc_batt_over_low_temp = <0x2d>;
				qcom,vooc_over_high_or_low_current = <0x00>;
				qcom,vooc_strategy1_batt_high_temp0 = <0x190>;
				qcom,vooc_strategy1_batt_high_temp1 = <0x1a4>;
				qcom,vooc_strategy1_batt_high_temp2 = <0x1ae>;
				qcom,vooc_strategy1_batt_low_temp2 = <0x1a4>;
				qcom,vooc_strategy1_batt_low_temp1 = <0x19a>;
				qcom,vooc_strategy1_batt_low_temp0 = <0x186>;
				qcom,vooc_strategy1_high_current0 = <0x09>;
				qcom,vooc_strategy1_high_current1 = <0x07>;
				qcom,vooc_strategy1_high_current2 = <0x05>;
				qcom,vooc_strategy1_low_current2 = <0x07>;
				qcom,vooc_strategy1_low_current1 = <0x09>;
				qcom,vooc_strategy1_low_current0 = <0x0c>;
				qcom,vooc_strategy2_batt_up_temp1 = <0x177>;
				qcom,vooc_strategy2_batt_up_down_temp2 = <0x17c>;
				qcom,vooc_strategy2_batt_up_temp3 = <0x186>;
				qcom,vooc_strategy2_batt_up_down_temp4 = <0x190>;
				qcom,vooc_strategy2_batt_up_temp5 = <0x19a>;
				qcom,vooc_strategy2_batt_up_temp6 = <0x19f>;
				qcom,vooc_strategy2_high0_current = <0x09>;
				qcom,vooc_strategy2_high1_current = <0x07>;
				qcom,vooc_strategy2_high2_current = <0x05>;
				qcom,vooc_strategy2_high3_current = <0x03>;
				qcom,abnormal_adapter_current = <0x00 0x00 0x09 0x09 0x07 0x07 0x05 0x05 0x03 0x03>;
				qcom,vooc_current_lvl = <0x3e8 0x5dc 0x7d0 0x9c4 0xbb8 0xdac 0xfa0 0x1194 0x1388 0x157c 0x1770 0x1964 0x1b58 0x1d4c 0x1f40 0x2134 0x2328 0x251c 0x2710 0x2904 0x2af8 0x2cec 0x2ee0 0x30d4>;
				pinctrl-names = "switch1_act_switch2_act\0switch1_sleep_switch2_sleep\0switch1_act_switch3_act\0switch1_sleep_switch3_sleep\0switch1_act_switch2_sleep\0switch1_sleep_switch2_act\0clock_active\0clock_sleep\0data_active\0data_sleep\0reset_active\0reset_sleep\0vooc_asic_id_active\0vooc_asic_id_sleep";
				pinctrl-0 = <0x31>;
				pinctrl-1 = <0x32>;
				pinctrl-2 = <0x31>;
				pinctrl-3 = <0x32>;
				pinctrl-4 = <0x31>;
				pinctrl-5 = <0x32>;
				pinctrl-6 = <0x33>;
				pinctrl-7 = <0x34>;
				pinctrl-8 = <0x35>;
				pinctrl-9 = <0x36>;
				pinctrl-10 = <0x37>;
				pinctrl-11 = <0x38>;
				pinctrl-12 = <0x39>;
				pinctrl-13 = <0x3a>;
				qcom,charging_switch1-gpio = <0xffffffff 0x18 0x00>;
				qcom,charging_reset-gpio = <0xffffffff 0x21 0x00>;
				qcom,charging_clock-gpio = <0xffffffff 0xb4 0x00>;
				qcom,charging_data-gpio = <0xffffffff 0xb5 0x00>;
				qcom,vooc_asic_id-gpio = <0xffffffff 0x22 0x00>;
				qcom,vooc-max-input-volt-support = <0x2710>;
				qcom,vooc-max-input-current-support = <0x1964>;

				vooc_charge_strategy_30w {

					strategy_1 {
						capacity_range = <0x00 0x4b>;
						temp_range = <0x78 0xa0>;
						input_current = <0xfa0 0x1162 0x00 0xbb8 0x1176 0x00 0x7d0 0x1180 0x00>;
					};

					strategy_2 {
						capacity_range = <0x00 0x4b>;
						temp_range = <0xa0 0x19a>;
						input_current = <0x1770 0x1068 0x384 0x1388 0x1068 0x00 0x1194 0x1162 0x00 0xfa0 0x1162 0x00 0xbb8 0x1176 0x00 0x7d0 0x1180 0x00>;
					};

					strategy_3 {
						capacity_range = <0x00 0x4b>;
						temp_range = <0x19a 0x1a4>;
						input_current = <0xfa0 0x1176 0x00 0x7d0 0x1180 0x00>;
					};

					strategy_4 {
						capacity_range = <0x00 0x4b>;
						temp_range = <0x1a4 0x1a9>;
						input_current = <0xfa0 0x1180 0x00>;
					};

					strategy_5 {
						capacity_range = <0x00 0x4b>;
						temp_range = <0x1a9 0x1b3>;
						input_current = <0xbb8 0x1180 0x00>;
					};
				};

				vooc_charge_strategy_65w {

					strategy_1 {
						capacity_range = <0x00 0x32>;
						temp_range = <0x78 0xa0>;
						input_current = <0x1770 0x1068 0x00 0xfa0 0x1166 0x00 0x7d0 0x118e 0x00 0x5dc 0x1194 0x00>;
					};

					strategy_2 {
						capacity_range = <0x00 0x32>;
						temp_range = <0xa0 0x172>;
						input_current = <0x1964 0x1068 0x00 0x1770 0x109a 0x12c 0x157c 0x10cc 0x190 0x1194 0x1166 0x30c 0xdac 0x1166 0x00 0x7d0 0x118e 0x00 0x5dc 0x1194 0x00>;
					};

					strategy_3 {
						capacity_range = <0x00 0x5a>;
						temp_range = <0x172 0x1ae>;
						input_current = <0x1964 0x1068 0x00 0x1770 0x109a 0x12c 0x157c 0x10cc 0x190 0x1194 0x1166 0x30c 0xdac 0x1166 0x00 0x7d0 0x118e 0x00 0x640 0x1194 0x00>;
					};
				};
			};
		};
	};

	fragment@73 {
		target = <0xffffffff>;

		__overlay__ {

			charging_switch1_active {
				phandle = <0x31>;

				pins_cmd_dat {
					pinmux = <0x1800>;
					slew-rate = <0x01>;
					output-high;
				};
			};

			charging_switch1_sleep {
				phandle = <0x32>;

				pins_cmd_dat {
					pinmux = <0x1800>;
					slew-rate = <0x01>;
					output-low;
				};
			};

			charging_clock_active {
				phandle = <0x33>;

				pins_cmd_dat {
					pinmux = <0xb400>;
					slew-rate = <0x00>;
					bias-pull-up;
				};
			};

			charging_clock_sleep {
				phandle = <0x34>;

				pins_cmd_dat {
					pinmux = <0xb400>;
					slew-rate = <0x00>;
					bias-pull-down;
				};
			};

			charging_data_active {
				phandle = <0x35>;

				pins_cmd_dat {
					pinmux = <0xb500>;
					slew-rate = <0x00>;
					bias-pull-down;
				};
			};

			charging_data_sleep {
				phandle = <0x36>;

				pins_cmd_dat {
					pinmux = <0xb500>;
					slew-rate = <0x00>;
					bias-pull-down;
				};
			};

			charging_reset_active {
				phandle = <0x37>;

				pins_cmd_dat {
					pinmux = <0x2100>;
					slew-rate = <0x01>;
					bias-disable;
				};
			};

			charging_reset_sleep {
				phandle = <0x38>;

				pins_cmd_dat {
					pinmux = <0x2100>;
					slew-rate = <0x01>;
					bias-disable;
				};
			};

			vooc_asic_id_active {
				phandle = <0x39>;

				pins_cmd_dat {
					pinmux = <0x2200>;
					input-enable;
					slew-rate = <0x00>;
					bias-pull-up = <0x66>;
				};
			};

			vooc_asic_id_sleep {
				phandle = <0x3a>;

				pins_cmd_dat {
					pinmux = <0x2200>;
					input-enable;
					slew-rate = <0x00>;
					bias-pull-down = <0x66>;
				};
			};
		};
	};

	fragment@74 {
		target = <0xffffffff>;

		__overlay__ {
			status = "okay";
			clock-frequency = <0x186a0>;
			scl-gpio-id = <0xbf>;
			sda-gpio-id = <0xc0>;

			charge_pump-divider@68 {
				status = "okay";
				compatible = "oplus,charge_pump-divider";
				reg = <0x68>;
				oplus,charge_pump-hwid-gpio = <0xffffffff 0x1e 0x00>;
				pinctrl-names = "charge_pump_hwid_active\0charge_pump_hwid_sleep\0charge_pump_hwid_default";
				pinctrl-0 = <0x3b>;
				pinctrl-1 = <0x3c>;
				pinctrl-2 = <0x3d>;
			};

			mp2650-charger@5c {
				status = "okay";
				compatible = "oplus,mp2650-charger";
				reg = <0x5c>;
				qcom,mps_otg_en-gpio = <0xffffffff 0x6b 0x00>;
				pinctrl-names = "mps_otg_en_active\0mps_otg_en_sleep\0mps_otg_en_default";
				pinctrl-0 = <0x3e>;
				pinctrl-1 = <0x3f>;
				pinctrl-2 = <0x40>;
			};
		};
	};

	fragment@75 {
		target = <0xffffffff>;

		__overlay__ {

			charge_pump_hwid_active {
				phandle = <0x3b>;

				pins_cmd_dat {
					pinmux = <0x1e00>;
					input-enable;
					slew-rate = <0x00>;
					bias-pull-up = <0x66>;
				};
			};

			charge_pump_hwid_sleep {
				phandle = <0x3c>;

				pins_cmd_dat {
					pinmux = <0x1e00>;
					input-enable;
					slew-rate = <0x00>;
					bias-pull-down = <0x66>;
				};
			};

			charge_pump_hwid_default {
				phandle = <0x3d>;

				pins_cmd_dat {
					pinmux = <0x1e00>;
					input-enable;
					slew-rate = <0x00>;
					bias-disable;
				};
			};

			mps_otg_en_active {
				phandle = <0x3e>;

				pins_cmd_dat {
					pinmux = <0x6b00>;
					slew-rate = <0x01>;
					bias-pull-up;
				};
			};

			mps_otg_en_sleep {
				phandle = <0x3f>;

				pins_cmd_dat {
					pinmux = <0x6b00>;
					slew-rate = <0x01>;
					bias-pull-down;
				};
			};

			mps_otg_en_default {
				phandle = <0x40>;

				pins_cmd_dat {
					pinmux = <0x6b00>;
					slew-rate = <0x01>;
					bias-pull-down;
				};
			};
		};
	};

	fragment@76 {
		target = <0xffffffff>;

		__overlay__ {
			pinctrl-names = "uart0_rx_gpio\0uart0_tx_gpio";
			pinctrl-0 = <0x41>;
			pinctrl-1 = <0x42>;
			status = "okay";
		};
	};

	fragment@77 {
		target = <0xffffffff>;

		__overlay__ {
			status = "disabled";
		};
	};

	fragment@78 {
		target = <0xffffffff>;

		__overlay__ {

			uart0_rx_gpio {
				phandle = <0x41>;

				pins_cmd_dat {
					pinmux = <0xb300>;
					input-enable;
					slew-rate = <0x00>;
					bias-disable;
				};
			};

			uart0_tx_gpio {
				phandle = <0x42>;

				pins_cmd_dat {
					pinmux = <0xb200>;
					input-enable;
					slew-rate = <0x00>;
					bias-disable;
				};
			};
		};
	};

	fragment@79 {
		target = <0xffffffff>;

		__overlay__ {
			regulator-always-on;
		};
	};

	fragment@80 {
		target = <0xffffffff>;

		__overlay__ {
			status = "disabled";
		};
	};

	fragment@81 {
		target = <0xffffffff>;

		__overlay__ {
			status = "disabled";
		};
	};

	fragment@82 {
		target = <0xffffffff>;

		__overlay__ {
			status = "disabled";
		};
	};

	fragment@83 {
		target = <0xffffffff>;

		__overlay__ {

			usbphy_tuning {
				compatible = "mediatek,phy_tuning";
				u2_vrt_ref = <0x06>;
				u2_term_ref = <0x06>;
				u2_enhance = <0x03>;
				u2_discth = <0x0c>;
				host_u2_vrt_ref = <0x06>;
				host_u2_term_ref = <0x06>;
				host_u2_enhance = <0x03>;
				host_u2_discth = <0x0c>;
				phandle = <0xa3>;
			};
		};
	};

	fragment@84 {
		target = <0xffffffff>;

		__overlay__ {
			pinctrl-names = "i2c-state\0output-low-state";
			pinctrl-0 = <0x43>;
			pinctrl-1 = <0x44>;
		};
	};

	fragment@85 {
		target = <0xffffffff>;

		__overlay__ {

			i2c7_sda_i2c_state {
				phandle = <0x43>;

				pins_cmd_dat {
					pinmux = <0x8701>;
					slew-rate = <0x00>;
					bias-disable;
					bias-pull-up;
				};
			};

			i2c7_sda_output_low_state {
				phandle = <0x44>;

				pins_cmd_dat {
					pinmux = <0x8700>;
					slew-rate = <0x01>;
					output-low;
				};
			};
		};
	};

	fragment@86 {
		target = <0xffffffff>;

		__overlay__ {
			status = "disabled";
		};
	};

	fragment@87 {
		target = <0xffffffff>;

		__overlay__ {
			status = "disabled";
		};
	};

	fragment@88 {
		target = <0xffffffff>;

		__overlay__ {
			clock-frequency = <0x61a80>;
			pinctrl-names = "default\0ts_int_active\0ts_reset_active\0ts_int_suspend\0ts_reset_suspend\0ts_i2c_mode";
			pinctrl-0 = <0x45>;
			pinctrl-1 = <0x46>;
			pinctrl-2 = <0x47>;
			pinctrl-3 = <0x48>;
			pinctrl-4 = <0x49>;
			pinctrl-5 = <0x4a>;

			gt9886@5d {
				compatible = "goodix,gt9886";
				reg = <0x5d>;
				status = "ok";
				interrupt-parent = <0xffffffff>;
				interrupts = <0x0e 0x02 0x0e 0x00>;
				vtouch-supply = <0xffffffff>;
				goodix,irq-gpio = <0xffffffff 0x0e 0x00>;
				goodix,reset-gpio = <0xffffffff 0x0f 0x00>;
				goodix,irq-flags = <0x02>;
				goodix,panel-max-id = <0x0a>;
				goodix,panel-max-x = <0x438>;
				goodix,panel-max-y = <0x8e8>;
				goodix,panel-max-w = <0x100>;
				goodix,panel-max-p = <0x100>;
				goodix,input-max-x = <0x438>;
				goodix,input-max-y = <0x8e8>;
				goodix,panel-key-map = <0x9e 0xac 0xd9>;
				goodix,power-on-delay-us = <0x2710>;
				goodix,power-off-delay-us = <0x1388>;
				goodix,firmware-version = "6877v01";
				goodix,config-version = "6877v01";
				goodix,pen-enable;
				goodix,key-of-pen = <0x14b 0x14c>;
				tpd-filter-enable = <0x00>;
				tpd-filter-pixel-density = <0xa1>;
				tpd-filter-custom-prameters = <0x00 0x00 0x00 0x00 0x00 0x00 0x00 0x00 0x00 0x00 0x00 0x00>;
				tpd-filter-custom-speed = <0x00 0x00 0x00>;
			};
		};
	};

	fragment@89 {
		target = <0xffffffff>;

		__overlay__ {
			status = "okay";
			#address-cells = <0x01>;
			#size-cells = <0x00>;
			pinctrl-names = "default\0gt9896s_int_active\0gt9896s_reset_active\0gt9896s_int_suspend\0gt9896s_reset_suspend\0gt9896s_spi_mode";
			pinctrl-0 = <0x4b>;
			pinctrl-1 = <0x4c>;
			pinctrl-2 = <0x4d>;
			pinctrl-3 = <0x4e>;
			pinctrl-4 = <0x4f>;
			pinctrl-5 = <0x50>;

			gt9896s@0 {
				compatible = "goodix,gt9896s";
				reg = <0x00>;
				spi-max-frequency = <0xf4240>;
				goodix,avdd-name = "vtouch";
				vtouch-supply = <0xffffffff>;
				goodix,irq-gpio = <0xffffffff 0x0e 0x00>;
				goodix,reset-gpio = <0xffffffff 0x0f 0x00>;
				goodix,irq-flags = <0x02>;
				goodix,panel-max-id = <0x0a>;
				goodix,panel-max-x = <0x438>;
				goodix,panel-max-y = <0x8fc>;
				goodix,panel-max-w = <0x100>;
				goodix,panel-max-p = <0x100>;
				goodix,input-max-x = <0x438>;
				goodix,input-max-y = <0x8fc>;
				goodix,panel-key-map = <0x9e 0xac 0xd9>;
				goodix,power-on-delay-us = <0x2710>;
				goodix,power-off-delay-us = <0x1388>;
				goodix,firmware-version = "6877v01";
				goodix,config-version = "6877v01";
				goodix,pen-enable;
				tpd-filter-enable = <0x00>;
				tpd-filter-pixel-density = <0xa1>;
				tpd-filter-custom-prameters = <0x00 0x00 0x00 0x00 0x00 0x00 0x00 0x00 0x00 0x00 0x00 0x00>;
				tpd-filter-custom-speed = <0x00 0x00 0x00>;
			};
		};
	};

	fragment@90 {
		target = <0xffffffff>;

		__overlay__ {

			eintdefault {
				phandle = <0x45>;
			};

			pins_default {
				phandle = <0x4b>;
			};

			int_active {
				phandle = <0x46>;

				pins_cmd_dat {
					pinmux = <0xe00>;
					input-enable;
				};
			};

			reset_active {
				phandle = <0x47>;

				pins_cmd_dat {
					pinmux = <0xf00>;
					output-high;
				};
			};

			int_suspend {
				phandle = <0x48>;

				pins_cmd_dat {
					pinmux = <0xe00>;
					output-low;
				};
			};

			reset_suspend {
				phandle = <0x49>;

				pins_cmd_dat {
					pinmux = <0xf00>;
					output-low;
				};
			};

			i2cmode_default {
				phandle = <0x4a>;

				pins_cmd_dat {
					pinmux = <0x4001 0x4101>;
				};
			};

			int_high {
				phandle = <0xa4>;

				pins_cmd_dat {
					pinmux = <0xe00>;
					output-high;
				};
			};

			int1_active {
				phandle = <0x4c>;

				pins_cmd_dat {
					pinmux = <0xe00>;
					input-enable;
				};
			};

			reset1_active {
				phandle = <0x4d>;

				pins_cmd_dat {
					pinmux = <0xf00>;
					output-high;
				};
			};

			int1_suspend {
				phandle = <0x4e>;

				pins_cmd_dat {
					pinmux = <0xe00>;
					output-low;
				};
			};

			reset1_suspend {
				phandle = <0x4f>;

				pins_cmd_dat {
					pinmux = <0xf00>;
					output-low;
				};
			};

			spimode_default {
				phandle = <0x50>;

				pins_cmd_dat {
					pinmux = <0xc02 0xd02 0x4002 0x4102>;
					drive-strength = <0x02>;
				};
			};
		};
	};

	fragment@91 {
		target = <0xffffffff>;

		__overlay__ {

			cam0@0 {
				phandle = <0x52>;

				pins_cmd_dat {
					pinmux = <0x9d00>;
					slew-rate = <0x01>;
					output-low;
				};
			};

			cam0@1 {
				phandle = <0x53>;

				pins_cmd_dat {
					pinmux = <0x9d00>;
					slew-rate = <0x01>;
					output-high;
				};
			};

			cam1@0 {
				phandle = <0x54>;

				pins_cmd_dat {
					pinmux = <0x9b00>;
					slew-rate = <0x01>;
					output-low;
				};
			};

			cam1@1 {
				phandle = <0x55>;

				pins_cmd_dat {
					pinmux = <0x9b00>;
					slew-rate = <0x01>;
					output-high;
				};
			};

			cam2@0 {
				phandle = <0x56>;

				pins_cmd_dat {
					pinmux = <0x9f00>;
					slew-rate = <0x01>;
					output-low;
				};
			};

			cam2@1 {
				phandle = <0x57>;

				pins_cmd_dat {
					pinmux = <0x9f00>;
					slew-rate = <0x01>;
					output-high;
				};
			};

			cam3@0 {
				phandle = <0x58>;

				pins_cmd_dat {
					pinmux = <0xa100>;
					slew-rate = <0x01>;
					output-low;
				};
			};

			cam3@1 {
				phandle = <0x59>;

				pins_cmd_dat {
					pinmux = <0xa100>;
					slew-rate = <0x01>;
					output-high;
				};
			};

			cam0@vcam0 {
				phandle = <0x5a>;

				pins_cmd_dat {
					pinmux = <0x9a00>;
					slew-rate = <0x01>;
					output-low;
				};
			};

			cam0@vcam1 {
				phandle = <0x5b>;

				pins_cmd_dat {
					pinmux = <0x9a00>;
					slew-rate = <0x01>;
					output-high;
				};
			};

			camera_pins_cam0_mclk_off {
				phandle = <0x5c>;

				pins_cmd_dat {
					pinmux = <0x9600>;
					drive-strength = <0x01>;
				};
			};

			camera_pins_cam0_mclk_2ma {
				phandle = <0x5d>;

				pins_cmd_dat {
					pinmux = <0x9601>;
					drive-strength = <0x00>;
				};
			};

			camera_pins_cam0_mclk_4ma {
				phandle = <0x5e>;

				pins_cmd_dat {
					pinmux = <0x9601>;
					drive-strength = <0x01>;
				};
			};

			camera_pins_cam0_mclk_6ma {
				phandle = <0x5f>;

				pins_cmd_dat {
					pinmux = <0x9601>;
					drive-strength = <0x02>;
				};
			};

			camera_pins_cam0_mclk_8ma {
				phandle = <0x60>;

				pins_cmd_dat {
					pinmux = <0x9601>;
					drive-strength = <0x03>;
				};
			};

			camera_pins_cam1_mclk_off {
				phandle = <0x61>;

				pins_cmd_dat {
					pinmux = <0x9900>;
					drive-strength = <0x01>;
				};
			};

			camera_pins_cam1_mclk_2ma {
				phandle = <0x62>;

				pins_cmd_dat {
					pinmux = <0x9901>;
					drive-strength = <0x00>;
				};
			};

			camera_pins_cam1_mclk_4ma {
				phandle = <0x63>;

				pins_cmd_dat {
					pinmux = <0x9901>;
					drive-strength = <0x01>;
				};
			};

			camera_pins_cam1_mclk_6ma {
				phandle = <0x64>;

				pins_cmd_dat {
					pinmux = <0x9901>;
					drive-strength = <0x02>;
				};
			};

			camera_pins_cam1_mclk_8ma {
				phandle = <0x65>;

				pins_cmd_dat {
					pinmux = <0x9901>;
					drive-strength = <0x03>;
				};
			};

			camera_pins_cam2_mclk_off {
				phandle = <0x66>;

				pins_cmd_dat {
					pinmux = <0x9500>;
					drive-strength = <0x01>;
				};
			};

			camera_pins_cam2_mclk_2ma {
				phandle = <0x67>;

				pins_cmd_dat {
					pinmux = <0x9501>;
					drive-strength = <0x00>;
				};
			};

			camera_pins_cam2_mclk_4ma {
				phandle = <0x68>;

				pins_cmd_dat {
					pinmux = <0x9501>;
					drive-strength = <0x01>;
				};
			};

			camera_pins_cam2_mclk_6ma {
				phandle = <0x69>;

				pins_cmd_dat {
					pinmux = <0x9501>;
					drive-strength = <0x02>;
				};
			};

			camera_pins_cam2_mclk_8ma {
				phandle = <0x6a>;

				pins_cmd_dat {
					pinmux = <0x9501>;
					drive-strength = <0x03>;
				};
			};

			camera_pins_cam3_mclk_off {
				phandle = <0x6b>;

				pins_cmd_dat {
					pinmux = <0x9700>;
					drive-strength = <0x01>;
				};
			};

			camera_pins_cam3_mclk_2ma {
				phandle = <0x6c>;

				pins_cmd_dat {
					pinmux = <0x9701>;
					drive-strength = <0x00>;
				};
			};

			camera_pins_cam3_mclk_4ma {
				phandle = <0x6d>;

				pins_cmd_dat {
					pinmux = <0x9701>;
					drive-strength = <0x01>;
				};
			};

			camera_pins_cam3_mclk_6ma {
				phandle = <0x6e>;

				pins_cmd_dat {
					pinmux = <0x9701>;
					drive-strength = <0x02>;
				};
			};

			camera_pins_cam3_mclk_8ma {
				phandle = <0x6f>;

				pins_cmd_dat {
					pinmux = <0x9701>;
					drive-strength = <0x03>;
				};
			};

			camdefault {
				phandle = <0x51>;
			};
		};
	};

	fragment@92 {
		target = <0xffffffff>;

		__overlay__ {
			pinctrl-names = "default\0cam0_rst0\0cam0_rst1\0cam1_rst0\0cam1_rst1\0cam2_rst0\0cam2_rst1\0cam3_rst0\0cam3_rst1\0cam0_ldo_vcamd_0\0cam0_ldo_vcamd_1\0cam0_mclk_off\0cam0_mclk_2mA\0cam0_mclk_4mA\0cam0_mclk_6mA\0cam0_mclk_8mA\0cam1_mclk_off\0cam1_mclk_2mA\0cam1_mclk_4mA\0cam1_mclk_6mA\0cam1_mclk_8mA\0cam2_mclk_off\0cam2_mclk_2mA\0cam2_mclk_4mA\0cam2_mclk_6mA\0cam2_mclk_8mA\0cam3_mclk_off\0cam3_mclk_2mA\0cam3_mclk_4mA\0cam3_mclk_6mA\0cam3_mclk_8mA";
			pinctrl-0 = <0x51>;
			pinctrl-1 = <0x52>;
			pinctrl-2 = <0x53>;
			pinctrl-3 = <0x54>;
			pinctrl-4 = <0x55>;
			pinctrl-5 = <0x56>;
			pinctrl-6 = <0x57>;
			pinctrl-7 = <0x58>;
			pinctrl-8 = <0x59>;
			pinctrl-9 = <0x5a>;
			pinctrl-10 = <0x5b>;
			pinctrl-11 = <0x5c>;
			pinctrl-12 = <0x5d>;
			pinctrl-13 = <0x5e>;
			pinctrl-14 = <0x5f>;
			pinctrl-15 = <0x60>;
			pinctrl-16 = <0x61>;
			pinctrl-17 = <0x62>;
			pinctrl-18 = <0x63>;
			pinctrl-19 = <0x64>;
			pinctrl-20 = <0x65>;
			pinctrl-21 = <0x66>;
			pinctrl-22 = <0x67>;
			pinctrl-23 = <0x68>;
			pinctrl-24 = <0x69>;
			pinctrl-25 = <0x6a>;
			pinctrl-26 = <0x6b>;
			pinctrl-27 = <0x6c>;
			pinctrl-28 = <0x6d>;
			pinctrl-29 = <0x6e>;
			pinctrl-30 = <0x6f>;
			cam0_vcamio-supply = <0xffffffff>;
			cam1_vcamio-supply = <0xffffffff>;
			cam2_vcamio-supply = <0xffffffff>;
			cam3_vcamio-supply = <0xffffffff>;
			cam0_enable_sensor = "ov64b_mipi_raw";
			cam1_enable_sensor = "imx615_mipi_raw";
			cam2_enable_sensor = "imx355_mipi_raw";
			cam3_enable_sensor = "ov02b10_mipi_raw";
			status = "okay";
		};
	};

	fragment@93 {
		target = <0xffffffff>;

		__overlay__ {

			camera_eeprom0@50 {
				compatible = "mediatek,camera_eeprom";
				reg = <0x50>;
				status = "okay";
				phandle = <0xa5>;
			};
		};
	};

	fragment@94 {
		target = <0xffffffff>;

		__overlay__ {

			camera_eeprom2@51 {
				compatible = "mediatek,camera_eeprom";
				reg = <0x51>;
				status = "okay";
				phandle = <0xa6>;
			};

			camera_eeprom3@52 {
				compatible = "mediatek,camera_eeprom";
				reg = <0x52>;
				status = "okay";
				phandle = <0xa7>;
			};

			camera_eeprom1@54 {
				compatible = "mediatek,camera_eeprom";
				reg = <0x54>;
				status = "okay";
				phandle = <0xa8>;
			};
		};
	};

	fragment@95 {
		target = <0xffffffff>;

		__overlay__ {

			fan53870@35 {
				compatible = "fan53870";
				reg = <0x35>;
				ldo1_min_vol = "\0\f5";
				ldo1_max_vol = <0x16f300>;
				ldo1_step_vol = <0x1f40>;
				en-gpios = <0xffffffff 0x6d 0x01>;
			};

			wl2868c@2f {
				compatible = "wl2868c-i2c";
				vs2-supply = <0xffffffff>;
				reg = <0x2f>;
				id_reg = <0x00>;
				id_val = <0x82>;
				vin1_vol = "\0\f5";
				vin2_vol = <0x16f300>;
				en-gpios = <0xffffffff 0x6d 0x01>;
			};
		};
	};

	__symbols__ {
		irtx_gpio_led_default = "/fragment@2/__overlay__/irtx_gpio_led_def@gpio139";
		irtx_gpio_led_set = "/fragment@2/__overlay__/irtx_gpio_led_set@gpio139";
		ctp_pins_default_t = "/fragment@7/__overlay__/eintdefault";
		ctp_ts_int_active_t = "/fragment@7/__overlay__/int_active";
		ctp_ts_reset_active_t = "/fragment@7/__overlay__/reset_active";
		ctp_ts_int_suspend_t = "/fragment@7/__overlay__/int_suspend";
		ctp_ts_reset_suspend_t = "/fragment@7/__overlay__/reset_suspend";
		mtkfb_pins_lcm_led_en1 = "/fragment@8/__overlay__/lcm_led_en1_gpio";
		mtkfb_pins_lcm_led_en0 = "/fragment@8/__overlay__/lcm_led_en0_gpio";
		mtkfb_pins_lcd_bias_enp1 = "/fragment@8/__overlay__/lcd_bias_enp1_gpio";
		mtkfb_pins_lcd_bias_enp0 = "/fragment@8/__overlay__/lcd_bias_enp0_gpio";
		mtkfb_pins_lcd_bias_enn1 = "/fragment@8/__overlay__/lcd_bias_enn1_gpio";
		mtkfb_pins_lcd_bias_enn0 = "/fragment@8/__overlay__/lcd_bias_enn0_gpio";
		mtkfb_pins_lcm_rst_out1_gpio = "/fragment@8/__overlay__/lcm_rst_out1_gpio";
		mtkfb_pins_lcm_rst_out0_gpio = "/fragment@8/__overlay__/lcm_rst_out0_gpio";
		mtkfb_pins_lcm_dsi_te = "/fragment@8/__overlay__/lcm_dsi_te";
		panel_in1 = "/fragment@11/__overlay__/panel1@0/port/endpoint";
		dsi_out = "/fragment@11/__overlay__/ports/port/endpoint";
		led0 = "/fragment@13/__overlay__/led@0";
		led1 = "/fragment@13/__overlay__/led@1";
		led2 = "/fragment@13/__overlay__/led@2";
		led3 = "/fragment@13/__overlay__/led@3";
		led4 = "/fragment@13/__overlay__/led@4";
		led5 = "/fragment@13/__overlay__/led@5";
		led6 = "/fragment@13/__overlay__/led@6";
		vibrator0 = "/fragment@13/__overlay__/vibrator@0";
		sensor_fb = "/fragment@13/__overlay__/sensor_fb";
		gsensor_1 = "/fragment@13/__overlay__/gsensor_1";
		gsensor_2 = "/fragment@13/__overlay__/gsensor_2";
		sensor_3 = "/fragment@13/__overlay__/gsensor_3";
		msensor_1 = "/fragment@13/__overlay__/msensor_1";
		msensor_2 = "/fragment@13/__overlay__/msensor_2";
		sar_1 = "/fragment@13/__overlay__/sar_1";
		proximity_1 = "/fragment@13/__overlay__/proximity_1";
		light_1 = "/fragment@13/__overlay__/light_1";
		proximity_2 = "/fragment@13/__overlay__/proximity_2";
		light_2 = "/fragment@13/__overlay__/light_2";
		rear_cct_1 = "/fragment@13/__overlay__/rear_cct_1";
		rear_cct_2 = "/fragment@13/__overlay__/rear_cct_2";
		pick_up = "/fragment@13/__overlay__/pick_up";
		lux_aod = "/fragment@13/__overlay__/lux_aod";
		alsps_arch = "/fragment@13/__overlay__/alsps_arch";
		cali_arch = "/fragment@13/__overlay__/cali_arch";
		oplus_boardid = "/fragment@13/__overlay__/oplus_boardid";
		oplus_project = "/fragment@13/__overlay__/oplus_project";
		oplus_devinfo = "/fragment@13/__overlay__/oplus_devinfo";
		kpd_volume_down = "/fragment@13/__overlay__/kpd_volume_down";
		volume_up_gpio_eint = "/fragment@15/__overlay__/volume_up@0";
		volume_down_gpio_eint = "/fragment@15/__overlay__/volume_down@0";
		gps_pins_default = "/fragment@16/__overlay__/gps_default";
		gps_l1_lna_pins_ol = "/fragment@16/__overlay__/gps_l1_lna@0";
		gps_l1_lna_pins_dsp_ctrl = "/fragment@16/__overlay__/gps_l1_lna@1";
		gps_l1_lna_pins_oh = "/fragment@16/__overlay__/gps_l1_lna@2";
		gps_l5_lna_pins_ol = "/fragment@16/__overlay__/gps_l5_lna@0";
		gps_l5_lna_pins_dsp_ctrl = "/fragment@16/__overlay__/gps_l5_lna@1";
		gps_l5_lna_pins_oh = "/fragment@16/__overlay__/gps_l5_lna@2";
		ps_enable = "/fragment@21/__overlay__/ps_enable";
		ps_disable = "/fragment@21/__overlay__/ps_disable";
		sel_up = "/fragment@21/__overlay__/sel_up";
		sel_down = "/fragment@21/__overlay__/sel_down";
		tfa98xx = "/fragment@22/__overlay__/tfa98xx@34";
		fsa_hs_det = "/fragment@23/__overlay__/fsa_hs_det";
		fsa4480 = "/fragment@24/__overlay__/fsa4480@42";
		tfa98xx_haptic = "/fragment@25/__overlay__/tfa98xx_haptic@34";
		gpio_id0_default = "/fragment@27/__overlay__/gpio_id0_default";
		oplus_fp = "/fragment@29/__overlay__/fingerprint@0";
		gpio_goodix_reset_default = "/fragment@30/__overlay__/gpio_goodix_reset_default";
		gpio_goodix_irq_default = "/fragment@30/__overlay__/gpio_goodix_irq_default";
		gpio_goodix_clk_6mA = "/fragment@30/__overlay__/gpio_goodix_clk_6mA";
		gpio_goodix_mosi_6mA = "/fragment@30/__overlay__/gpio_goodix_mosi_6mA";
		gpio_goodix_miso_6mA = "/fragment@30/__overlay__/gpio_goodix_miso_6mA";
		gpio_goodix_cs_6mA = "/fragment@30/__overlay__/gpio_goodix_cs_6mA";
		gpio_goodix_cs_func = "/fragment@30/__overlay__/gpio_goodix_cs_func";
		camera_main_mtk = "/fragment@37/__overlay__/camera_main@1a";
		camera_main_af_mtk = "/fragment@37/__overlay__/camera_main_af@72";
		camera_main_two_mtk = "/fragment@39/__overlay__/camera_main_two@11";
		camera_sub_mtk = "/fragment@39/__overlay__/camera_sub@1a";
		camera_sub_two_mtk = "/fragment@39/__overlay__/camera_sub_two@10";
		subpmic_mtk = "/fragment@40/__overlay__/subpmic@34";
		usb_type_c_mtk = "/fragment@40/__overlay__/usb_type_c@4e";
		subpmic_pmic_mtk = "/fragment@40/__overlay__/subpmic_pmic@1a";
		subpmic_ldo_mtk = "/fragment@40/__overlay__/subpmic_ldo@64";
		i2c_lcd_bias_mtk = "/fragment@41/__overlay__/i2c_lcd_bias@11";
		nfc_mtk = "/fragment@43/__overlay__/nfc@28";
		charger_pins_default = "/fragment@69/__overlay__/eint0default";
		charger_pins_eint_output0 = "/fragment@69/__overlay__/charger_gpio_as_output_low";
		charger_pins_eint_output1 = "/fragment@69/__overlay__/charger_gpio_as_output_high";
		ship_sleep_gpio = "/fragment@69/__overlay__/ship_sleep";
		ship_active_gpio = "/fragment@69/__overlay__/ship_active";
		dischg_enable = "/fragment@69/__overlay__/dischg_enable";
		dischg_disable = "/fragment@69/__overlay__/dischg_disable";
		chgvin_enable = "/fragment@69/__overlay__/chgvin_enable";
		chgvin_disable = "/fragment@69/__overlay__/chgvin_disable";
		pmic_chgfunc_enable = "/fragment@69/__overlay__/pmic_chgfunc_enable";
		pmic_chgfunc_disable = "/fragment@69/__overlay__/pmic_chgfunc_disable";
		ccdetect_active = "/fragment@69/__overlay__/ccdetect_active";
		ccdetect_sleep = "/fragment@69/__overlay__/ccdetect_sleep";
		vooc_ap_data = "/fragment@71/__overlay__/vooc_ap_data";
		vooc_ap_data_new_function = "/fragment@71/__overlay__/vooc_ap_data_new_function";
		charging_switch1_active = "/fragment@73/__overlay__/charging_switch1_active";
		charging_switch1_sleep = "/fragment@73/__overlay__/charging_switch1_sleep";
		charging_clock_active = "/fragment@73/__overlay__/charging_clock_active";
		charging_clock_sleep = "/fragment@73/__overlay__/charging_clock_sleep";
		charging_data_active = "/fragment@73/__overlay__/charging_data_active";
		charging_data_sleep = "/fragment@73/__overlay__/charging_data_sleep";
		charging_reset_active = "/fragment@73/__overlay__/charging_reset_active";
		charging_reset_sleep = "/fragment@73/__overlay__/charging_reset_sleep";
		vooc_asic_id_active = "/fragment@73/__overlay__/vooc_asic_id_active";
		vooc_asic_id_sleep = "/fragment@73/__overlay__/vooc_asic_id_sleep";
		charge_pump_hwid_active = "/fragment@75/__overlay__/charge_pump_hwid_active";
		charge_pump_hwid_sleep = "/fragment@75/__overlay__/charge_pump_hwid_sleep";
		charge_pump_hwid_default = "/fragment@75/__overlay__/charge_pump_hwid_default";
		mps_otg_en_active = "/fragment@75/__overlay__/mps_otg_en_active";
		mps_otg_en_sleep = "/fragment@75/__overlay__/mps_otg_en_sleep";
		mps_otg_en_default = "/fragment@75/__overlay__/mps_otg_en_default";
		uart0_rx_gpio_input = "/fragment@78/__overlay__/uart0_rx_gpio";
		uart0_tx_gpio_input = "/fragment@78/__overlay__/uart0_tx_gpio";
		usbphy_tuning = "/fragment@83/__overlay__/usbphy_tuning";
		i2c7_i2c_state = "/fragment@85/__overlay__/i2c7_sda_i2c_state";
		i2c7_output_low_state = "/fragment@85/__overlay__/i2c7_sda_output_low_state";
		ctp_pins_default = "/fragment@90/__overlay__/eintdefault";
		ctp_gt9896s_pins_default = "/fragment@90/__overlay__/pins_default";
		ctp_ts_int_active = "/fragment@90/__overlay__/int_active";
		ctp_ts_reset_active = "/fragment@90/__overlay__/reset_active";
		ctp_ts_int_suspend = "/fragment@90/__overlay__/int_suspend";
		ctp_ts_reset_suspend = "/fragment@90/__overlay__/reset_suspend";
		ctp_ts_i2c_mode = "/fragment@90/__overlay__/i2cmode_default";
		ctp_ts_int_as_gpio = "/fragment@90/__overlay__/int_high";
		ctp_gt9896s_int_active = "/fragment@90/__overlay__/int1_active";
		ctp_gt9896s_reset_active = "/fragment@90/__overlay__/reset1_active";
		ctp_gt9896s_int_suspend = "/fragment@90/__overlay__/int1_suspend";
		ctp_gt9896s_reset_suspend = "/fragment@90/__overlay__/reset1_suspend";
		ctp_gt9896s_spi_mode = "/fragment@90/__overlay__/spimode_default";
		camera_pins_cam0_rst_0 = "/fragment@91/__overlay__/cam0@0";
		camera_pins_cam0_rst_1 = "/fragment@91/__overlay__/cam0@1";
		camera_pins_cam1_rst_0 = "/fragment@91/__overlay__/cam1@0";
		camera_pins_cam1_rst_1 = "/fragment@91/__overlay__/cam1@1";
		camera_pins_cam2_rst_0 = "/fragment@91/__overlay__/cam2@0";
		camera_pins_cam2_rst_1 = "/fragment@91/__overlay__/cam2@1";
		camera_pins_cam3_rst_0 = "/fragment@91/__overlay__/cam3@0";
		camera_pins_cam3_rst_1 = "/fragment@91/__overlay__/cam3@1";
		camera_pins_cam0_vcamd_0 = "/fragment@91/__overlay__/cam0@vcam0";
		camera_pins_cam0_vcamd_1 = "/fragment@91/__overlay__/cam0@vcam1";
		camera_pins_cam0_mclk_off = "/fragment@91/__overlay__/camera_pins_cam0_mclk_off";
		camera_pins_cam0_mclk_2ma = "/fragment@91/__overlay__/camera_pins_cam0_mclk_2ma";
		camera_pins_cam0_mclk_4ma = "/fragment@91/__overlay__/camera_pins_cam0_mclk_4ma";
		camera_pins_cam0_mclk_6ma = "/fragment@91/__overlay__/camera_pins_cam0_mclk_6ma";
		camera_pins_cam0_mclk_8ma = "/fragment@91/__overlay__/camera_pins_cam0_mclk_8ma";
		camera_pins_cam1_mclk_off = "/fragment@91/__overlay__/camera_pins_cam1_mclk_off";
		camera_pins_cam1_mclk_2ma = "/fragment@91/__overlay__/camera_pins_cam1_mclk_2ma";
		camera_pins_cam1_mclk_4ma = "/fragment@91/__overlay__/camera_pins_cam1_mclk_4ma";
		camera_pins_cam1_mclk_6ma = "/fragment@91/__overlay__/camera_pins_cam1_mclk_6ma";
		camera_pins_cam1_mclk_8ma = "/fragment@91/__overlay__/camera_pins_cam1_mclk_8ma";
		camera_pins_cam2_mclk_off = "/fragment@91/__overlay__/camera_pins_cam2_mclk_off";
		camera_pins_cam2_mclk_2ma = "/fragment@91/__overlay__/camera_pins_cam2_mclk_2ma";
		camera_pins_cam2_mclk_4ma = "/fragment@91/__overlay__/camera_pins_cam2_mclk_4ma";
		camera_pins_cam2_mclk_6ma = "/fragment@91/__overlay__/camera_pins_cam2_mclk_6ma";
		camera_pins_cam2_mclk_8ma = "/fragment@91/__overlay__/camera_pins_cam2_mclk_8ma";
		camera_pins_cam3_mclk_off = "/fragment@91/__overlay__/camera_pins_cam3_mclk_off";
		camera_pins_cam3_mclk_2ma = "/fragment@91/__overlay__/camera_pins_cam3_mclk_2ma";
		camera_pins_cam3_mclk_4ma = "/fragment@91/__overlay__/camera_pins_cam3_mclk_4ma";
		camera_pins_cam3_mclk_6ma = "/fragment@91/__overlay__/camera_pins_cam3_mclk_6ma";
		camera_pins_cam3_mclk_8ma = "/fragment@91/__overlay__/camera_pins_cam3_mclk_8ma";
		camera_pins_default = "/fragment@91/__overlay__/camdefault";
		mtk_camera_eeprom0 = "/fragment@93/__overlay__/camera_eeprom0@50";
		mtk_camera_eeprom2 = "/fragment@94/__overlay__/camera_eeprom2@51";
		mtk_camera_eeprom3 = "/fragment@94/__overlay__/camera_eeprom3@52";
		mtk_camera_eeprom1 = "/fragment@94/__overlay__/camera_eeprom1@54";
	};

	__fixups__ {
		chosen = "/fragment@0:target:0";
		irtx_pwm = "/fragment@1:target:0";
		pio = "/fragment@2:target:0\0/fragment@3/__overlay__:mt6360,intr_gpio:0\0/fragment@5/__overlay__:mt6360pd,intr_gpio:0\0/fragment@6/__overlay__/Focaltech20181@38:interrupt-parent:0\0/fragment@6/__overlay__/Focaltech20181@38:irq-gpio:0\0/fragment@6/__overlay__/Focaltech20181@38:reset-gpio:0\0/fragment@7:target:0\0/fragment@8:target:0\0/fragment@11/__overlay__/panel1@0:pm-enable-gpios:0\0/fragment@11/__overlay__/panel1@0:reset-gpios:0\0/fragment@11/__overlay__/panel1@0:bias-gpios:0\0/fragment@13/__overlay__/kpd_volume_down:interrupt-parent:0\0/fragment@14/__overlay__:keypad,volume-up:0\0/fragment@14/__overlay__:keypad,volume-down:0\0/fragment@15:target:0\0/fragment@16:target:0\0/fragment@21:target:0\0/fragment@23:target:0\0/fragment@24/__overlay__/fsa4480@42:fsa4480,hs-det-gpio:0\0/fragment@25/__overlay__/tfa98xx_haptic@34:reset-gpio:0\0/fragment@26/__overlay__:oplus,fp_gpio_0:0\0/fragment@27:target:0\0/fragment@28/__overlay__:goodix,gpio_irq:0\0/fragment@28/__overlay__:goodix,gpio_reset:0\0/fragment@28/__overlay__:goodix,gpio_cs:0\0/fragment@30:target:0\0/fragment@47/__overlay__:GPIO_FDD_BAND_SUPPORT_DETECT_1ST_PIN:0\0/fragment@47/__overlay__:GPIO_FDD_BAND_SUPPORT_DETECT_2ND_PIN:0\0/fragment@47/__overlay__:GPIO_FDD_BAND_SUPPORT_DETECT_3RD_PIN:0\0/fragment@47/__overlay__:GPIO_FDD_BAND_SUPPORT_DETECT_4TH_PIN:0\0/fragment@47/__overlay__:GPIO_RF_PWREN_RST_PIN:0\0/fragment@47/__overlay__:GPIO_SIM2_SIO:0\0/fragment@47/__overlay__:GPIO_SIM2_SCLK:0\0/fragment@47/__overlay__:GPIO_SIM2_SRST:0\0/fragment@47/__overlay__:GPIO_SIM1_SRST:0\0/fragment@47/__overlay__:GPIO_SIM1_SCLK:0\0/fragment@47/__overlay__:GPIO_SIM1_SIO:0\0/fragment@47/__overlay__:GPIO_SIM1_HOT_PLUG:0\0/fragment@47/__overlay__:GPIO_SIM2_HOT_PLUG:0\0/fragment@49/__overlay__:interrupt-parent:0\0/fragment@50/__overlay__:interrupt-parent:0\0/fragment@51/__overlay__:interrupt-parent:0\0/fragment@52/__overlay__:interrupt-parent:0\0/fragment@53/__overlay__:interrupt-parent:0\0/fragment@53/__overlay__:deb-gpios:0\0/fragment@54/__overlay__:interrupt-parent:0\0/fragment@55/__overlay__:interrupt-parent:0\0/fragment@64:target:0\0/fragment@65/__overlay__:mt6360,intr_gpio:0\0/fragment@66/__overlay__:mt6360pd,intr_gpio:0\0/fragment@68/__overlay__:qcom,chargerid_switch-gpio:0\0/fragment@68/__overlay__:qcom,ship-gpio:0\0/fragment@68/__overlay__:qcom,dischg-gpio:0\0/fragment@68/__overlay__:qcom,ccdetect-gpio:0\0/fragment@68/__overlay__:qcom,chgvin:0\0/fragment@68/__overlay__:qcom,pmic_chgfunc:0\0/fragment@69:target:0\0/fragment@72/__overlay__/sy6610_fastcg@06:qcom,charging_switch1-gpio:0\0/fragment@72/__overlay__/sy6610_fastcg@06:qcom,charging_reset-gpio:0\0/fragment@72/__overlay__/sy6610_fastcg@06:qcom,charging_clock-gpio:0\0/fragment@72/__overlay__/sy6610_fastcg@06:qcom,charging_data-gpio:0\0/fragment@72/__overlay__/sy6610_fastcg@06:qcom,vooc_asic_id-gpio:0\0/fragment@73:target:0\0/fragment@74/__overlay__/charge_pump-divider@68:oplus,charge_pump-hwid-gpio:0\0/fragment@74/__overlay__/mp2650-charger@5c:qcom,mps_otg_en-gpio:0\0/fragment@75:target:0\0/fragment@78:target:0\0/fragment@85:target:0\0/fragment@88/__overlay__/gt9886@5d:interrupt-parent:0\0/fragment@88/__overlay__/gt9886@5d:goodix,irq-gpio:0\0/fragment@88/__overlay__/gt9886@5d:goodix,reset-gpio:0\0/fragment@89/__overlay__/gt9896s@0:goodix,irq-gpio:0\0/fragment@89/__overlay__/gt9896s@0:goodix,reset-gpio:0\0/fragment@90:target:0\0/fragment@91:target:0\0/fragment@95/__overlay__/fan53870@35:en-gpios:0\0/fragment@95/__overlay__/wl2868c@2f:en-gpios:0";
		mt6360_pmu = "/fragment@3:target:0\0/fragment@65:target:0";
		mt6360_pmic = "/fragment@4:target:0";
		mt6360_typec = "/fragment@5:target:0\0/fragment@66:target:0";
		i2c0 = "/fragment@6:target:0\0/fragment@35:target:0\0/fragment@88:target:0";
		mt_pmic_vtp_ldo_reg = "/fragment@6/__overlay__/Focaltech20181@38:vdd_2v8-supply:0\0/fragment@59:target:0\0/fragment@61/__overlay__:vtouch-supply:0\0/fragment@88/__overlay__/gt9886@5d:vtouch-supply:0\0/fragment@89/__overlay__/gt9896s@0:vtouch-supply:0";
		mtkfb = "/fragment@9:target:0";
		dispsys_config = "/fragment@10:target:0";
		dsi0 = "/fragment@11:target:0";
		mt_pmic_vmc_ldo_reg = "/fragment@11/__overlay__/panel1@0:ldo3-supply:0";
		disp_leds = "/fragment@12:target:0";
		odm = "/fragment@13:target:0\0/fragment@71:target:0\0/fragment@83:target:0";
		auxadc = "/fragment@13/__overlay__/oplus_devinfo:io-channels:0\0/fragment@32:target:0\0/fragment@33/__overlay__:io-channels:0\0/fragment@68/__overlay__:io-channels:0\0/fragment@68/__overlay__:io-channels:8\0/fragment@68/__overlay__:io-channels:16";
		keypad = "/fragment@14:target:0\0/fragment@62:target:0";
		gps = "/fragment@17:target:0";
		accdet = "/fragment@18:target:0";
		ps5169 = "/fragment@19:target:0\0/fragment@81:target:0";
		fusb340 = "/fragment@20:target:0\0/fragment@82:target:0";
		i2c6 = "/fragment@22:target:0\0/fragment@24:target:0\0/fragment@41:target:0";
		i2c9 = "/fragment@25:target:0\0/fragment@44:target:0\0/fragment@63:target:0";
		oplus_fp_common = "/fragment@26:target:0";
		goodix_fp = "/fragment@28:target:0";
		spi5 = "/fragment@29:target:0";
		mt_pmic_vmch_ldo_reg = "/fragment@29/__overlay__/fingerprint@0:dvdd-supply:0";
		swtp = "/fragment@31:target:0\0/fragment@53:target:0";
		md_auxadc = "/fragment@33:target:0";
		pmic_clock_buffer_ctrl = "/fragment@34:target:0";
		i2c1 = "/fragment@36:target:0";
		i2c2 = "/fragment@37:target:0\0/fragment@93:target:0";
		i2c3 = "/fragment@38:target:0";
		i2c4 = "/fragment@39:target:0\0/fragment@94:target:0";
		i2c5 = "/fragment@40:target:0";
		i2c7 = "/fragment@42:target:0\0/fragment@72:target:0\0/fragment@84:target:0";
		i2c8 = "/fragment@43:target:0\0/fragment@95:target:0";
		i2c10 = "/fragment@45:target:0\0/fragment@74:target:0";
		i2c11 = "/fragment@46:target:0";
		gpio_usage_mapping = "/fragment@47:target:0";
		gpio = "/fragment@48:target:0";
		mrdump_ext_rst = "/fragment@49:target:0";
		subpmic_pmu_eint = "/fragment@50:target:0";
		irq_nfc = "/fragment@51:target:0";
		touch_panel = "/fragment@52:target:0";
		dsi_te = "/fragment@54:target:0";
		rt5133_eint = "/fragment@55:target:0";
		md1_sim1_hot_plug_eint = "/fragment@56:target:0";
		md1_sim2_hot_plug_eint = "/fragment@57:target:0";
		mt_pmic_vcamio_ldo_reg = "/fragment@58:target:0\0/fragment@60/__overlay__:vcamio-supply:0\0/fragment@92/__overlay__:cam0_vcamio-supply:0\0/fragment@92/__overlay__:cam1_vcamio-supply:0\0/fragment@92/__overlay__:cam2_vcamio-supply:0\0/fragment@92/__overlay__:cam3_vcamio-supply:0";
		kd_camera_hw1 = "/fragment@60:target:0\0/fragment@92:target:0";
		touch = "/fragment@61:target:0";
		lk_charger = "/fragment@67:target:0";
		charger = "/fragment@68:target:0";
		bat_gm30 = "/fragment@70:target:0";
		apuart0 = "/fragment@76:target:0";
		apuart1 = "/fragment@77:target:0";
		mt_pmic_vio28_ldo_reg = "/fragment@79:target:0";
		typec_mux_switch = "/fragment@80:target:0";
		rt5133 = "/fragment@86:target:0";
		gate_ic = "/fragment@87:target:0";
		spi4 = "/fragment@89:target:0";
		mt_pmic_vs2_buck_reg = "/fragment@95/__overlay__/wl2868c@2f:vs2-supply:0";
	};

	__local_fixups__ {

		fragment@1 {

			__overlay__ {
				pinctrl-0 = <0x00>;
				pinctrl-1 = <0x00>;
			};
		};

		fragment@9 {

			__overlay__ {
				pinctrl-0 = <0x00>;
				pinctrl-1 = <0x00>;
				pinctrl-2 = <0x00>;
				pinctrl-3 = <0x00>;
				pinctrl-4 = <0x00>;
				pinctrl-5 = <0x00>;
				pinctrl-6 = <0x00>;
				pinctrl-7 = <0x00>;
				pinctrl-8 = <0x00>;
			};
		};

		fragment@10 {

			__overlay__ {
				pinctrl-0 = <0x00>;
				pinctrl-1 = <0x00>;
				pinctrl-2 = <0x00>;
			};
		};

		fragment@11 {

			__overlay__ {

				panel1@0 {

					port {

						endpoint {
							remote-endpoint = <0x00>;
						};
					};
				};

				ports {

					port {

						endpoint {
							remote-endpoint = <0x00>;
						};
					};
				};
			};
		};

		fragment@14 {

			__overlay__ {
				pinctrl-0 = <0x00>;
				pinctrl-1 = <0x00>;
			};
		};

		fragment@17 {

			__overlay__ {
				pinctrl-0 = <0x00>;
				pinctrl-1 = <0x00>;
				pinctrl-2 = <0x00>;
				pinctrl-3 = <0x00>;
				pinctrl-4 = <0x00>;
				pinctrl-5 = <0x00>;
				pinctrl-6 = <0x00>;
			};
		};

		fragment@19 {

			__overlay__ {
				pinctrl-0 = <0x00>;
				pinctrl-1 = <0x00>;
			};
		};

		fragment@20 {

			__overlay__ {
				pinctrl-0 = <0x00>;
				pinctrl-1 = <0x00>;
			};
		};

		fragment@24 {

			__overlay__ {

				fsa4480@42 {
					pinctrl-0 = <0x00>;
				};
			};
		};

		fragment@26 {

			__overlay__ {
				pinctrl-0 = <0x00>;
			};
		};

		fragment@28 {

			__overlay__ {
				pinctrl-0 = <0x00 0x04>;
				pinctrl-1 = <0x00 0x04 0x08 0x0c>;
				pinctrl-2 = <0x00>;
			};
		};

		fragment@68 {

			__overlay__ {
				pinctrl-0 = <0x00>;
				pinctrl-1 = <0x00>;
				pinctrl-2 = <0x00>;
				pinctrl-3 = <0x00>;
				pinctrl-4 = <0x00>;
				pinctrl-5 = <0x00>;
				pinctrl-6 = <0x00>;
				pinctrl-7 = <0x00>;
				pinctrl-8 = <0x00>;
				pinctrl-9 = <0x00>;
				pinctrl-10 = <0x00>;
				pinctrl-11 = <0x00>;
				pinctrl-12 = <0x00>;
			};
		};

		fragment@72 {

			__overlay__ {

				sy6610_fastcg@06 {
					pinctrl-0 = <0x00>;
					pinctrl-1 = <0x00>;
					pinctrl-2 = <0x00>;
					pinctrl-3 = <0x00>;
					pinctrl-4 = <0x00>;
					pinctrl-5 = <0x00>;
					pinctrl-6 = <0x00>;
					pinctrl-7 = <0x00>;
					pinctrl-8 = <0x00>;
					pinctrl-9 = <0x00>;
					pinctrl-10 = <0x00>;
					pinctrl-11 = <0x00>;
					pinctrl-12 = <0x00>;
					pinctrl-13 = <0x00>;
				};
			};
		};

		fragment@74 {

			__overlay__ {

				charge_pump-divider@68 {
					pinctrl-0 = <0x00>;
					pinctrl-1 = <0x00>;
					pinctrl-2 = <0x00>;
				};

				mp2650-charger@5c {
					pinctrl-0 = <0x00>;
					pinctrl-1 = <0x00>;
					pinctrl-2 = <0x00>;
				};
			};
		};

		fragment@76 {

			__overlay__ {
				pinctrl-0 = <0x00>;
				pinctrl-1 = <0x00>;
			};
		};

		fragment@84 {

			__overlay__ {
				pinctrl-0 = <0x00>;
				pinctrl-1 = <0x00>;
			};
		};

		fragment@88 {

			__overlay__ {
				pinctrl-0 = <0x00>;
				pinctrl-1 = <0x00>;
				pinctrl-2 = <0x00>;
				pinctrl-3 = <0x00>;
				pinctrl-4 = <0x00>;
				pinctrl-5 = <0x00>;
			};
		};

		fragment@89 {

			__overlay__ {
				pinctrl-0 = <0x00>;
				pinctrl-1 = <0x00>;
				pinctrl-2 = <0x00>;
				pinctrl-3 = <0x00>;
				pinctrl-4 = <0x00>;
				pinctrl-5 = <0x00>;
			};
		};

		fragment@92 {

			__overlay__ {
				pinctrl-0 = <0x00>;
				pinctrl-1 = <0x00>;
				pinctrl-2 = <0x00>;
				pinctrl-3 = <0x00>;
				pinctrl-4 = <0x00>;
				pinctrl-5 = <0x00>;
				pinctrl-6 = <0x00>;
				pinctrl-7 = <0x00>;
				pinctrl-8 = <0x00>;
				pinctrl-9 = <0x00>;
				pinctrl-10 = <0x00>;
				pinctrl-11 = <0x00>;
				pinctrl-12 = <0x00>;
				pinctrl-13 = <0x00>;
				pinctrl-14 = <0x00>;
				pinctrl-15 = <0x00>;
				pinctrl-16 = <0x00>;
				pinctrl-17 = <0x00>;
				pinctrl-18 = <0x00>;
				pinctrl-19 = <0x00>;
				pinctrl-20 = <0x00>;
				pinctrl-21 = <0x00>;
				pinctrl-22 = <0x00>;
				pinctrl-23 = <0x00>;
				pinctrl-24 = <0x00>;
				pinctrl-25 = <0x00>;
				pinctrl-26 = <0x00>;
				pinctrl-27 = <0x00>;
				pinctrl-28 = <0x00>;
				pinctrl-29 = <0x00>;
				pinctrl-30 = <0x00>;
			};
		};
	};
};
